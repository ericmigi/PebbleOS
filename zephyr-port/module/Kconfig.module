## zephyr-port/module/Kconfig.module
```kconfig
rsource "drivers/serial/Kconfig"
rsource "drivers/display/Kconfig"
rsource "drivers/input/Kconfig"
rsource "drivers/flash/Kconfig"
rsource "drivers/rtc/Kconfig"
```

## zephyr-port/module/boards/pebble/qemu_emery/Kconfig.qemu_emery
```kconfig
# SPDX-FileCopyrightText: 2026 Core Devices LLC
# SPDX-License-Identifier: Apache-2.0

config BOARD_QEMU_EMERY
	select SOC_PEBBLE_QEMU
	select QEMU_TARGET
```

## zephyr-port/module/boards/pebble/qemu_emery/board.yml
```yaml
board:
  name: qemu_emery
  full_name: Pebble Emery (qemu-pebble)
  vendor: pebble
  socs:
  - name: pebble_qemu
```

## zephyr-port/module/boards/pebble/qemu_emery/qemu_emery_defconfig
```kconfig
# SPDX-FileCopyrightText: 2026 Core Devices LLC
# SPDX-License-Identifier: Apache-2.0

CONFIG_ARM_MPU=y
CONFIG_CONSOLE=y
CONFIG_UART_CONSOLE=y
CONFIG_SERIAL=y
CONFIG_QEMU_ICOUNT=n
```

## zephyr-port/module/drivers/display/Kconfig
```kconfig
# SPDX-FileCopyrightText: 2026 Core Devices LLC
# SPDX-License-Identifier: Apache-2.0

config DISPLAY_PEBBLE
	bool "Pebble QEMU display driver"
	default y
	depends on DISPLAY && DT_HAS_PEBBLE_DISPLAY_ENABLED
	help
	  Driver for the corresponding device in qemu-pebble machines.
```

## zephyr-port/module/drivers/flash/Kconfig
```kconfig
# SPDX-FileCopyrightText: 2026 Core Devices LLC
# SPDX-License-Identifier: Apache-2.0

config FLASH_PEBBLE_EXTFLASH
	bool "Pebble QEMU flash driver"
	default y
	depends on DT_HAS_PEBBLE_EXTFLASH_ENABLED && FLASH
	select FLASH_HAS_DRIVER_ENABLED
	select FLASH_HAS_EXPLICIT_ERASE
	select FLASH_HAS_PAGE_LAYOUT
	help
	  Driver for the corresponding device in qemu-pebble machines.
```

## zephyr-port/module/drivers/input/Kconfig
```kconfig
# SPDX-FileCopyrightText: 2026 Core Devices LLC
# SPDX-License-Identifier: Apache-2.0

config INPUT_PEBBLE_BUTTONS
	bool "Pebble QEMU input driver"
	default y
	depends on DT_HAS_PEBBLE_BUTTONS_ENABLED && INPUT
	help
	  Driver for the corresponding device in qemu-pebble machines.
```

## zephyr-port/module/drivers/rtc/Kconfig
```kconfig
# SPDX-FileCopyrightText: 2026 Core Devices LLC
# SPDX-License-Identifier: Apache-2.0

config RTC_PEBBLE
	bool "Pebble QEMU rtc driver"
	default y
	depends on DT_HAS_PEBBLE_RTC_ENABLED && RTC
	help
	  Driver for the corresponding device in qemu-pebble machines.
```

## zephyr-port/module/drivers/serial/Kconfig
```kconfig
# SPDX-FileCopyrightText: 2026 Core Devices LLC
# SPDX-License-Identifier: Apache-2.0

config UART_PEBBLE_SIMPLE
	bool "Pebble QEMU simple UART driver"
	default y
	depends on DT_HAS_PEBBLE_SIMPLE_UART_ENABLED
	select SERIAL_HAS_DRIVER
	help
	  Driver for the pebble-simple-uart device in qemu-pebble machines.
```

## zephyr-port/module/dts/bindings/display/pebble,display.yaml
```yaml
description: Pebble QEMU display (pebble-display device in qemu-pebble)

compatible: "pebble,display"

include: [base.yaml, display-controller.yaml]

properties:
  reg:
    required: true
    description: Two entries - control registers, framebuffer

  interrupts:
    required: true
```

## zephyr-port/module/dts/bindings/flash_controller/pebble,extflash.yaml
```yaml
description: Pebble QEMU external flash controller (pebble-extflash device)

compatible: "pebble,extflash"

include: flash-controller.yaml

properties:
  reg:
    required: true
    description: Two entries - control registers, XIP window
```

## zephyr-port/module/dts/bindings/input/pebble,buttons.yaml
```yaml
description: Pebble QEMU buttons (pebble-gpio device in qemu-pebble)

compatible: "pebble,buttons"

include: base.yaml

properties:
  reg:
    required: true

  interrupts:
    required: true
```

## zephyr-port/module/dts/bindings/rtc/pebble,rtc.yaml
```yaml
description: Pebble QEMU RTC (pebble-rtc device in qemu-pebble)

compatible: "pebble,rtc"

include: base.yaml

properties:
  reg:
    required: true

  interrupts:
    required: true
```

## zephyr-port/module/dts/bindings/serial/pebble,simple-uart.yaml
```yaml
description: Pebble QEMU simple UART (pebble-simple-uart device in qemu-pebble)

compatible: "pebble,simple-uart"

include: uart-controller.yaml

properties:
  reg:
    required: true

  interrupts:
    required: true
```

## zephyr-port/module/soc/pebble/qemu/Kconfig
```kconfig
# SPDX-FileCopyrightText: 2026 Core Devices LLC
# SPDX-License-Identifier: Apache-2.0

config SOC_PEBBLE_QEMU
	select ARM
	select CPU_CORTEX_M33
	select CPU_HAS_ARM_MPU
```

## zephyr-port/module/soc/pebble/qemu/Kconfig.defconfig
```kconfig
# SPDX-FileCopyrightText: 2026 Core Devices LLC
# SPDX-License-Identifier: Apache-2.0

if SOC_PEBBLE_QEMU

config NUM_IRQS
	default 32

config SYS_CLOCK_HW_CYCLES_PER_SEC
	default 64000000

endif # SOC_PEBBLE_QEMU
```

## zephyr-port/module/soc/pebble/qemu/Kconfig.soc
```kconfig
# SPDX-FileCopyrightText: 2026 Core Devices LLC
# SPDX-License-Identifier: Apache-2.0

config SOC_PEBBLE_QEMU
	bool
	help
	  Generic Pebble machine in qemu-pebble (Cortex-M33)

config SOC
	default "pebble_qemu" if SOC_PEBBLE_QEMU
```
