// SPDX-FileCopyrightText: 2026 Core Devices LLC
// SPDX-License-Identifier: Apache-2.0

// xteinkx4's 240x400, twice as large: the whole 480x800 panel. For Flint (see
// qemu_esp32c3.conf): width 144, height 168, scale 3.
&display {
	width = <240>;
	height = <400>;
	scale = <2>;
};

&flash0 {
	reg = <0x0 0x1000000>;

	partitions {
		/delete-node/ partition@0;

#include "esp32c3-flash-16m.dtsi"
	};
};
