// SPDX-FileCopyrightText: 2026 Core Devices LLC
// SPDX-License-Identifier: Apache-2.0

// Folio's 240x400, twice as large: the whole 480x800 panel
&display {
	width = <240>;
	height = <400>;
	scale = <2>;
};

&flash0 {
	partitions {
		/delete-node/ partition@0;

#include "esp32c3-flash-16m.dtsi"
	};
};
