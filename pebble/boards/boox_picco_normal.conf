## pebble/boards/t_deck_pro.conf
```kconfig
# Firmware settings for the T-Deck Pro.

CONFIG_PLATFORM_TDECKPRO=y

CONFIG_ACCEL_SIM=y
CONFIG_ALS_SIM=y
CONFIG_AUDIO_SIM_MIC=y
CONFIG_TEMP_SIM=y
CONFIG_VIBE_SIM=y

CONFIG_OTP_MCU=y
CONFIG_WATCHDOG=y

CONFIG_PLATFORM_ANIMATION_INSTANT=y
CONFIG_WATCHFACE_BEZEL=y

CONFIG_CHARGER_SIM=y
CONFIG_BACKLIGHT_POSIX=y
CONFIG_BT_VENDOR_NAME="LilyGO"

CONFIG_RTC_RETAINED=y
```

## pebble/platforms/Kconfig.cyberdeck
```kconfig
# SPDX-FileCopyrightText: 2026 Core Devices LLC
# SPDX-License-Identifier: Apache-2.0

if PLATFORM_CYBERDECK

config PLATFORM_NAME
    default "cyberdeck"

config PLATFORM_DISPLAY_WIDTH
    default 400

config PLATFORM_DISPLAY_HEIGHT
    default 240

config PLATFORM_MICROPHONE
    default y

config PLATFORM_HEALTH
    default y

config PLATFORM_SPEAKER
    default y

# Legacy apps get the whole display rather than a 144x168 window.

config PLATFORM_LEGACY_2X_DISPLAY_WIDTH
    default 400

config PLATFORM_LEGACY_2X_DISPLAY_HEIGHT
    default 240

config PLATFORM_LEGACY_3X_DISPLAY_WIDTH
    default 400

config PLATFORM_LEGACY_3X_DISPLAY_HEIGHT
    default 240

# RAM of an app and of its runtime.

config APP_RAM_4X_SEGMENT_SIZE
    default 67584

config APP_RAM_4X_RUNTIME_SIZE
    default 30720

endif # PLATFORM_CYBERDECK
```

## pebble/platforms/Kconfig.tdeckpro
```kconfig
# SPDX-License-Identifier: Apache-2.0

if PLATFORM_TDECKPRO
config PLATFORM_NAME
    default "tdeckpro"

config PLATFORM_ABI
    default "xtensa"

config PLATFORM_DISPLAY_WIDTH
    default 240

config PLATFORM_DISPLAY_HEIGHT
    default 320

config PLATFORM_MAX_APP_MEMORY_SIZE
    default 63488

config PLATFORM_MAX_WORKER_MEMORY_SIZE
    default 7552

config APP_RAM_4X_SEGMENT_SIZE
    default 67584

config APP_RAM_4X_RUNTIME_SIZE
    default 30720
endif
```

## pebble/services/boot_splash/Kconfig
```kconfig
# SPDX-FileCopyrightText: 2026 Core Devices LLC
# SPDX-License-Identifier: Apache-2.0

config SERVICE_BOOT_SPLASH
    bool "Boot splash"
    help
      Boot splash screen service.

if SERVICE_BOOT_SPLASH

config SERVICE_BOOT_SPLASH_POWER_OFF
    bool "Logo on power-off"
    help
      Draw the logo before the display is disabled at power-off, for a
      panel that keeps its image unpowered, e.g. e-paper.

config SERVICE_BOOT_SPLASH_THREAD_STACK_SIZE
    int "Boot splash thread stack size in bytes"
    default 2048

config SERVICE_BOOT_SPLASH_THREAD_PRIO
    int "Boot splash thread priority"
    default 3

endif
```

## pebble/services/compositor/Kconfig
```kconfig
# SPDX-FileCopyrightText: 2026 Core Devices LLC
# SPDX-License-Identifier: Apache-2.0

config SERVICE_COMPOSITOR
    bool "Compositor"
    help
      UI compositor and window transitions.

if SERVICE_COMPOSITOR

config SERVICE_COMPOSITOR_DIRECT_SCREEN_SWITCH
    bool "Present app and modal screen changes directly"
    default y if BOARD_XTEINK_X4_PRO
    help
      Skip shell transition animations. On slow panels a partial wipe
      can stay visible while the destination screen is ready to display.

config SERVICE_COMPOSITOR_COALESCE_FRAMES
    bool "Let app rendering continue during e-paper refresh"
    depends on DISPLAY_SSD1677
    default y if BOARD_XTEINK_X4 || BOARD_XTEINK_X4_PRO
    help
      During a panel refresh, let newer app drawings replace the pending
      frame. When the panel is ready, acquire the latest finished app
      framebuffer for composition.

config SERVICE_COMPOSITOR_PARTIAL_FRAMES
    bool "Composite app frames from their dirty rectangle"
    default y
    help
      Copy only what an app frame changed into the system framebuffer and
      push only those rows to the display, while the framebuffer still
      holds the previous frame. Disable to composite every app frame in
      full.

config SERVICE_COMPOSITOR_PARTIAL_FRAMES_WHOLE_SCREEN
    bool "Compare the whole screen rather than the dirty rectangle"
    depends on SERVICE_COMPOSITOR_PARTIAL_FRAMES
    help
      Compare every row of an app frame against the previous one instead
      of only the rows within the rectangle the app's drawing marked. For
      compatibility with apps that write pixels into their framebuffer
      without marking them, which the SDK does not support but used to
      show on the next frame, at the cost of comparing the whole screen
      on every frame.

module = SERVICE_COMPOSITOR
module-str = Compositor
source "subsys/logging/Kconfig.template.log_level"

endif
```

## soc/espressif/Kconfig
```kconfig
# SPDX-FileCopyrightText: 2026 Core Devices LLC
# SPDX-License-Identifier: Apache-2.0

config SOC_FAMILY_ESPRESSIF
    bool
    help
      Espressif family, selected by its SoCs.

orsource "*/Kconfig"
```

## soc/espressif/esp32c3/Kconfig
```kconfig
# SPDX-FileCopyrightText: 2026 Core Devices LLC
# SPDX-License-Identifier: Apache-2.0

config SOC_ESP32C3_POWER_LATCH
    bool "Drive the power latch high at reset"
    default $(dt_has_nodelabel,power_latch)
    depends on SOC_ESP32C3
    help
      Drive the pin of the board's power_latch node high as the first
      thing the early init does, before there are devices: a board that
      powers itself from the battery through it stays on once the power
      button is released. The device that owns the pin keeps it high.

config SOC_ESP32C3_POWER_OFF
    bool "Power off by dropping the power latch"
    default y
    depends on SOC_ESP32C3_POWER_LATCH && $(dt_has_nodelabel,charger)
    select SOC_HAS_POWER_OFF
    help
      Power off by driving the power latch low, which disconnects the
      battery once the power button is up. The input of the charger
      node tells USB power, which keeps the board on regardless: then
      the chip resets instead, as without this.

config SOC_ESP32C3_LIGHT_SLEEP
    bool "Light sleep idle state"
    default n
    depends on SOC_ESP32C3 && CPU_IDLE && TIMER_ESP32C3_SYSTIMER
    depends on SOC_ESP32C3_POWER_LATCH && $(dt_has_nodelabel,charger)
    select SOC_HAS_IDLE_STATES
    help
      Add light sleep as a deeper CPU idle state for idle periods of at
      least 5 ms. The clocks of the digital domain stop while the crystal
      and BBPLL stay powered. Refused while USB is present, in the first
      30 s after boot, while the RTC watchdog is already armed, or before
      the slow clock is calibrated.

config SOC_ESP32C3_FLASH_CLOCK_DIV
    int "Flash clock divider"
    range 1 4
    default 4
    depends on SOC_ESP32C3
    help
      The flash's clock, and so the speed of code and data run in place,
      is the 80 MHz of the PLL divided by this: 4 is the 20 MHz the boot
      leaves, 2 is 40 MHz and 1 is 80 MHz. Applies with the CPU on the
      PLL only. The early init reads the image's first 16 KiB back at the
      new clock and returns to the old one if it reads differently.
```

## soc/espressif/esp32c3/Kconfig.soc
```kconfig
# SPDX-FileCopyrightText: 2026 Core Devices LLC
# SPDX-License-Identifier: Apache-2.0

config SOC_ESP32C3
    bool "Espressif ESP32-C3"
    select SOC_FAMILY_ESPRESSIF
    select CPU_RV32IMC
    select RAMFUNC
    select RISCV_PCCR
    select SOC_HAS_RESET
    select TIMER_ESP32C3_SYSTIMER
    help
      Espressif ESP32-C3, a single RV32IMC core booted by its ROM straight
      into the flash, with the code at 0x42000000 and the read-only data
      read through 0x3c000000.
```
