## dts/bindings/display/qemu,esp-rgb.yaml
```yaml
# SPDX-License-Identifier: (GPL-2.0-only OR BSD-2-Clause)
%YAML 1.2
---
$id: http://devicetree.org/schemas/display/qemu,esp-rgb.yaml#
$schema: http://devicetree.org/meta-schemas/core.yaml#

title: QEMU ESP RGB display

maintainers:
  - Eric Migicovsky <eric@repebble.com>

description:
  Virtual RGB framebuffer of Espressif's QEMU machines (display.esp.rgb), a
  window of up to 800x600 pixels shown from its video memory. The firmware
  emulates the panel described here in that window, as the panel's controller
  scans it, with the framebuffer scaled up and centred on the panel.

properties:
  compatible:
    const: qemu,esp-rgb

  reg:
    items:
      - description: Registers
      - description: Video memory

  reg-names:
    items:
      - const: regs
      - const: vram

  width:
    $ref: /schemas/types.yaml#/definitions/uint32
    description: Framebuffer width, in pixels.

  height:
    $ref: /schemas/types.yaml#/definitions/uint32
    description: Framebuffer height, in pixels.

  panel-width:
    $ref: /schemas/types.yaml#/definitions/uint32
    description: Panel width as mounted, in pixels.

  panel-height:
    $ref: /schemas/types.yaml#/definitions/uint32
    description: Panel height as mounted, in pixels.

  scale:
    $ref: /schemas/types.yaml#/definitions/uint32
    description: Panel pixels per framebuffer pixel, in each direction.
    minimum: 1
    default: 1

  bits-per-pixel:
    $ref: /schemas/types.yaml#/definitions/uint32
    description: 1 for monochrome, white set, or 16 for RGB565.
    enum: [1, 16]

  rotation:
    $ref: /schemas/types.yaml#/definitions/uint32
    description:
      Mounting rotation of the panel, counter-clockwise, in degrees. At 90 or
      270 the window is panel-height wide and panel-width tall.
    enum: [0, 90, 180, 270]
    default: 0

required:
  - compatible
  - reg
  - reg-names
  - width
  - height
  - panel-width
  - panel-height
  - bits-per-pixel

additionalProperties: false

examples:
  - |
    display@21000000 {
        compatible = "qemu,esp-rgb";
        reg = <0x21000000 0x1c>, <0x20000000 0x1d4c00>;
        reg-names = "regs", "vram";
        width = <480>;
        height = <800>;
        panel-width = <480>;
        panel-height = <800>;
        bits-per-pixel = <1>;
        rotation = <90>;
    };
```

## dts/bindings/display/solomon,ssd1677.yaml
```yaml
# SPDX-License-Identifier: (GPL-2.0-only OR BSD-2-Clause)
%YAML 1.2
---
$id: http://devicetree.org/schemas/display/solomon,ssd1677.yaml#
$schema: http://devicetree.org/meta-schemas/core.yaml#

title: Solomon Systech SSD1677 e-paper controller

maintainers:
  - Eric Migicovsky <eric@repebble.com>

description:
  Black and white e-paper controller of up to 960x680 pixels, an SPI device
  with a data/command line and a BUSY output, high while it works. The
  framebuffer is scaled up by a whole number, centred on the panel and turned
  by the mounting rotation, as for qemu,esp-rgb. The panel's own size, as its
  controller scans it, is panel-width by panel-height, swapped at 90 or 270.

allOf:
  - $ref: /schemas/spi/spi-peripheral-props.yaml#

properties:
  compatible:
    const: solomon,ssd1677

  reg:
    maxItems: 1

  dc-gpios:
    maxItems: 1
    description: Data/command select, high for data.

  reset-gpios:
    maxItems: 1

  busy-gpios:
    maxItems: 1
    description: BUSY, active while the controller works.

  width:
    $ref: /schemas/types.yaml#/definitions/uint32
    description: Framebuffer width, in pixels.

  height:
    $ref: /schemas/types.yaml#/definitions/uint32
    description: Framebuffer height, in pixels.

  panel-width:
    $ref: /schemas/types.yaml#/definitions/uint32
    description: Panel width as mounted, in pixels.

  panel-height:
    $ref: /schemas/types.yaml#/definitions/uint32
    description: Panel height as mounted, in pixels.

  scale:
    $ref: /schemas/types.yaml#/definitions/uint32
    description: Panel pixels per framebuffer pixel, in each direction.
    minimum: 1
    default: 1

  rotation:
    $ref: /schemas/types.yaml#/definitions/uint32
    description: Mounting rotation of the panel, counter-clockwise, in degrees.
    enum: [0, 90, 180, 270]
    default: 0

  full-refresh-interval:
    $ref: /schemas/types.yaml#/definitions/uint32
    description:
      Updates from one full refresh to the next, the others fast ones; 0 for
      fast refreshes only, after the first.
    default: 20

  fast-frames:
    $ref: /schemas/types.yaml#/definitions/uint32
    description:
      Main phase of the fast refresh waveform, in frames of 20 ms. 0 runs the
      panel's own OTP waveform, which has 16, plus 5 frames of the other
      phases. Fewer frames refresh faster and draw a lighter black; the
      periodic full refresh clears what they leave behind.
    maximum: 255
    default: 0

required:
  - compatible
  - reg
  - dc-gpios
  - reset-gpios
  - busy-gpios
  - width
  - height
  - panel-width
  - panel-height

unevaluatedProperties: false

examples:
  - |
    #include <dt-bindings/gpio/gpio.h>

    spi {
        #address-cells = <1>;
        #size-cells = <0>;

        display@0 {
            compatible = "solomon,ssd1677";
            reg = <0>;
            spi-max-frequency = <10000000>;
            dc-gpios = <&gpio 4 GPIO_ACTIVE_HIGH>;
            reset-gpios = <&gpio 5 GPIO_ACTIVE_LOW>;
            busy-gpios = <&gpio 6 GPIO_ACTIVE_HIGH>;
            width = <480>;
            height = <800>;
            panel-width = <480>;
            panel-height = <800>;
            rotation = <270>;
        };
    };
```

## dts/bindings/gpio/esp,esp32c3-gpio.yaml
```yaml
# SPDX-License-Identifier: (GPL-2.0-only OR BSD-2-Clause)
%YAML 1.2
---
$id: http://devicetree.org/schemas/gpio/esp,esp32c3-gpio.yaml#
$schema: http://devicetree.org/meta-schemas/core.yaml#

title: Espressif ESP32-C3 GPIO matrix

maintainers:
  - Eric Migicovsky <eric@repebble.com>

description:
  The GPIO matrix of the ESP32-C3, with the levels, output enables and
  interrupts of its 22 pins. Each pin is also an interrupt source, all on
  the one GPIO interrupt.

properties:
  compatible:
    const: esp,esp32c3-gpio

  reg:
    maxItems: 1

  interrupts:
    maxItems: 1

  gpio-controller: true

  '#gpio-cells':
    const: 2

  ngpios:
    const: 22

  esp,io-mux:
    $ref: /schemas/types.yaml#/definitions/phandle
    description: IO_MUX, whose pads the pins are.

  interrupt-controller: true

  '#interrupt-cells':
    const: 2

required:
  - compatible
  - reg
  - interrupts
  - gpio-controller
  - '#gpio-cells'
  - ngpios
  - esp,io-mux
  - interrupt-controller
  - '#interrupt-cells'

additionalProperties: false

examples:
  - |
    gpio@60004000 {
        compatible = "esp,esp32c3-gpio";
        reg = <0x60004000 0x1000>;
        interrupts = <16>;
        gpio-controller;
        #gpio-cells = <2>;
        ngpios = <22>;
        esp,io-mux = <&io_mux>;
        interrupt-controller;
        #interrupt-cells = <2>;
    };
```
