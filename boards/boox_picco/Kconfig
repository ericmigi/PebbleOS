## boards/boox_picco/Kconfig
```kconfig
# SPDX-FileCopyrightText: 2026 Core Devices LLC
# SPDX-License-Identifier: Apache-2.0

config BOARD_BOOX_PICCO
    bool
    default y
    select REGULATOR
    select SOC_ESP32S3_OCTAL_MEMORY
```

## boards/native_folio/Kconfig.defconfig
```kconfig
# SPDX-FileCopyrightText: 2026 Core Devices LLC
# SPDX-License-Identifier: Apache-2.0

config RESOURCES_BOARD
    default "qemu_flint"

config DISPLAY_SDL_WIDTH
    default 240

config DISPLAY_SDL_HEIGHT
    default 400

config DISPLAY_SDL_MONO
    default y


config DISPLAY_SDL_PANEL_SCALE
    default 2
```

## boards/native_xteinkx4/Kconfig.defconfig
```kconfig
# SPDX-FileCopyrightText: 2026 Core Devices LLC
# SPDX-License-Identifier: Apache-2.0

config RESOURCES_BOARD
    default "qemu_flint"

config DISPLAY_SDL_WIDTH
    default 480 if FRAMEBUFFER_SCALE2
    default 240

config DISPLAY_SDL_HEIGHT
    default 800 if FRAMEBUFFER_SCALE2
    default 400

config DISPLAY_SDL_MONO
    default y


config DISPLAY_SDL_PANEL_SCALE
    default 1 if FRAMEBUFFER_SCALE2
    default 2
```

## boards/qemu_esp32c3/Kconfig
```kconfig
# SPDX-FileCopyrightText: 2026 Core Devices LLC
# SPDX-License-Identifier: Apache-2.0

config BOARD_QEMU_ESP32C3
    bool
    default y
```

## boards/t_deck_pro/Kconfig
```kconfig
# SPDX-License-Identifier: Apache-2.0

config BOARD_T_DECK_PRO
    bool
    default y
    select I2C
```

## boards/t_deck_pro/Kconfig.defconfig
```kconfig
# SPDX-FileCopyrightText: 2026 Core Devices LLC
# SPDX-License-Identifier: Apache-2.0

config RESOURCES_BOARD
    default "qemu_flint"

config ESP32C3_BT_CONTROLLER_IN_FLASH
    default y if ESP32C3_BT

config ESP32C3_BT_ARMED_BY_DEFAULT
    default y if ESP32C3_BT

choice NIMBLE_HCI
    default NIMBLE_HCI_ESP32C3 if ESP32C3_BT
endchoice
```

## boards/xteink_x4_pro/Kconfig
```kconfig
# SPDX-FileCopyrightText: 2026 Core Devices LLC
# SPDX-License-Identifier: Apache-2.0

config BOARD_XTEINK_X4_PRO
    bool
    default y
    select REGULATOR
    select I2C
    select SOC_ESP32S3_OCTAL_MEMORY
    select SOC_HAS_POWER_OFF
```

## drivers/adc/Kconfig
```kconfig
# SPDX-FileCopyrightText: 2026 Core Devices LLC
# SPDX-License-Identifier: Apache-2.0

menuconfig ADC
    bool "ADCs"
    help
      Analog-to-digital converter class (pbl/drivers/adc.h), selected by the
      drivers that read analog inputs.

if ADC

config ADC_SHELL
    bool "Shell commands"
    default DRIVER_SHELL
    depends on SHELL && DEVICE_NAMES
    help
      The adc shell command, to list the ADCs and convert a channel.

config ADC_ESP32C3
    bool "Espressif ESP32-C3 SAR ADC"
    default y
    depends on DT_HAS_ESP_ESP32C3_ADC_ENABLED
    select PINCTRL
    help
      SAR ADC1 of the ESP32-C3, one-shot conversions of GPIO0 to GPIO4,
      with the factory calibration in its eFuse.

config ADC_SF32LB57_GPADC
    bool "SiFli SF32LB57 GPADC"
    default y
    depends on DT_HAS_SIFLI_SF32LB57_GPADC_ENABLED
    select CLK
    select NVMEM
    help
      General purpose ADC of the SiFli SF32LB57, read one channel at a
      time, with the factory calibration in its eFuse.

module = DRIVER_ADC
module-str = ADC
source "subsys/logging/Kconfig.template.log_level"

endif # ADC
```

## drivers/charger/Kconfig
```kconfig
# SPDX-FileCopyrightText: 2026 Core Devices LLC
# SPDX-License-Identifier: Apache-2.0

menuconfig CHARGER
    bool "Charger"
    help
      Battery charger class (pbl/drivers/charger.h).

if CHARGER

config CHARGER_SHELL
    bool "Shell commands"
    default DRIVER_SHELL
    depends on SHELL
    help
      The charger shell command, to show whether external power is
      present, the charge status and the battery measurements.

config CHARGER_HIGH_LOAD
    bool
    help
      The charger driver limits the discharge current, and lifts the
      limit on pbl_charger_high_load_request().

config CHARGER_NPM1300
    bool "Nordic nPM1300"
    default y
    depends on DT_HAS_NORDIC_NPM1300_ENABLED
    select CHARGER_HIGH_LOAD
    select MFD
    select MFD_NPM1300
    help
      Support for the charger of the Nordic nPM1300 PMIC.

config CHARGER_ADC
    bool "Presence pin and ADC"
    default y
    depends on DT_HAS_COREDEVICES_ADC_CHARGER_ENABLED
    depends on ADC
    help
      A charger seen only through a presence pin and the battery voltage
      on an ADC channel (coredevices,adc-charger).

config CHARGER_X4_PRO
    bool "X4 Pro CW2017 fuel gauge and charge status"
    default y
    depends on DT_HAS_XTEINK_X4_PRO_CHARGER_ENABLED && SOC_ESP32S3
    select I2C

config CHARGER_SIM
    bool "Simulator"
    default y if SOC_QEMU_PEBBLE || SOC_POSIX
    help
      Simulated charger, set through its simulator API
      (pbl/drivers/charger/sim.h).

module = DRIVER_CHARGER
module-str = Charger
source "subsys/logging/Kconfig.template.log_level"

endif # CHARGER
```

## drivers/display/Kconfig
```kconfig
# SPDX-FileCopyrightText: 2026 Core Devices LLC
# SPDX-License-Identifier: Apache-2.0

menuconfig DISPLAY
    bool "Display"
    help
      Display Drivers

if DISPLAY

config DISPLAY_SF32LB_LCDC
    bool "SiFli SF32LB LCD controller"
    default y
    depends on DT_HAS_SIFLI_SF32LB52_LCDC_ENABLED
    select CLK
    select PANEL
    select PINCTRL
    select RESET
    help
      Support for the SiFli SF32LB LCD controller, driving a JDI
      memory-in-pixel panel.

config DISPLAY_SF32LB_LCDC_IRQ_PRIO
    int "Interrupt priority"
    default 0
    depends on DISPLAY_SF32LB_LCDC
    help
      Priority of the controller interrupt.

config DISPLAY_SF32LB57_LCDC
    bool "SiFli SF32LB57 LCD controller"
    default y
    depends on DT_HAS_SIFLI_SF32LB57_LCDC_ENABLED
    select CLK
    select MIPI_DBI
    select PANEL
    select PINCTRL
    select RESET
    help
      Support for the SiFli SF32LB57 LCD controller, driving a panel with
      frame memory over quad SPI.

config DISPLAY_SF32LB57_LCDC_IRQ_PRIO
    int "Interrupt priority"
    default 0
    depends on DISPLAY_SF32LB57_LCDC
    help
      Priority of the controller interrupt.

choice DISPLAY_SF32LB57_LCDC_FORMAT
    prompt "Framebuffer format"
    default DISPLAY_SF32LB57_LCDC_FORMAT_ARGB2222
    depends on DISPLAY_SF32LB57_LCDC
    help
      Format of the framebuffers the display takes, whatever the one its
      panel is written in.

config DISPLAY_SF32LB57_LCDC_FORMAT_ARGB2222
    bool "ARGB2222"
    help
      8 bits per pixel, the Pebble color format.

config DISPLAY_SF32LB57_LCDC_FORMAT_RGB565
    bool "RGB565"
    help
      16 bits per pixel.

endchoice

config DISPLAY_SHARP_MEMORY
    bool "Sharp memory LCDs"
    default y
    depends on DT_HAS_SHARP_LS010B7DH04_ENABLED || \
               DT_HAS_SHARP_LS011B7DH03_ENABLED || \
               DT_HAS_SHARP_LS012B7DD01_ENABLED || \
               DT_HAS_SHARP_LS013B7DH01_ENABLED || \
               DT_HAS_SHARP_LS013B7DH03_ENABLED || \
               DT_HAS_SHARP_LS013B7DH05_ENABLED || \
               DT_HAS_SHARP_LS027B7DH01_ENABLED || \
               DT_HAS_SHARP_LS027B7DH01A_ENABLED || \
               DT_HAS_SHARP_LS044Q7DH01_ENABLED
    select GPIO
    select PWM
    select SPI
    help
      Support for the Sharp memory LCDs addressing their lines with 8 bits:
      LS010B7DH04, LS011B7DH03, LS012B7DD01, LS013B7DH01, LS013B7DH03,
      LS013B7DH05, LS027B7DH01, LS027B7DH01A and LS044Q7DH01.

config DISPLAY_SSD1677
    bool "Solomon SSD1677 e-paper controller"
    default y
    depends on DT_HAS_SOLOMON_SSD1677_ENABLED
    select GPIO
    select SPI
    help
      Support for the SSD1677 e-paper controller on SPI, with a
      data/command line and a BUSY input.

config DISPLAY_SSD1677_FRAME_COPY
    bool "SSD1677 keeps a copy of the frame shown"
    depends on DISPLAY_SSD1677
    default y
    help
      Keep the frame shown, and which of its pixels the fast refreshes
      changed, in RAM: twice the framebuffer's size. Without, the driver
      keeps a CRC per row, re-syncs the controller's planes from the
      framebuffer after each refresh, and tops up whole rows; text
      detail needs the copy.

config DISPLAY_SSD1677_DETAIL_CELLS
    int "SSD1677 framebuffer pixels drawn at panel resolution"
    depends on DISPLAY_SSD1677
    range 0 65535
    default TEXT_DETAIL_CELLS if TEXT_DETAIL
    default 0
    help
      Pixels of the frame shown whose detail (text edges, see struct
      pbl_display_detail) the driver keeps, at 2 bytes each, for a panel
      at twice the framebuffer's size; 0 for none. A frame with more
      draws the rows that do not fit as plain pixels.

config DISPLAY_SSD1677_GREY
    bool "SSD1677 4-level overlay (experimental)"
    depends on DISPLAY_SSD1677
    help
      pbl_display_ssd1677_grey(): the panel's 4-level overlay over a B/W
      image, as the X4's stock firmware draws anti-aliased text.

config DISPLAY_QEMU
    bool "QEMU Framebuffer Display"
    default y
    depends on DT_HAS_QEMU_PEBBLE_DISPLAY_ENABLED
    help
      Support for the QEMU framebuffer display peripheral.

config DISPLAY_QEMU_ESP_RGB
    bool "QEMU ESP RGB display"
    default y
    depends on DT_HAS_QEMU_ESP_RGB_ENABLED
    help
      Support for the RGB framebuffer of Espressif's QEMU machines.

config DISPLAY_SDL
    bool "SDL window"
    default y if SOC_POSIX
    select SDL
    help
      Display shown in an SDL window on the host of a native build.

if DISPLAY_SDL

config DISPLAY_SDL_WIDTH
    int "SDL display width"
    help
      Width of the SDL display, in pixels.

config DISPLAY_SDL_HEIGHT
    int "SDL display height"
    help
      Height of the SDL display, in pixels.

config DISPLAY_SDL_MONO
    bool "SDL display is monochrome"
    help
      The SDL display takes a 1-bit framebuffer, 8-bit color otherwise.

config DISPLAY_SDL_PANEL_SCALE
    int "SDL panel pixels per display pixel"
    range 1 2
    default 1
    help
      Show each display pixel as this many panel pixels in each
      direction, as a panel driven at twice the display's resolution
      does; at 2 the window also shows text detail at panel resolution.

config DISPLAY_SDL_ROUND
    bool "SDL display is round"
    help
      The SDL display hides the pixels outside the circle of the
      LS013B7DD02 panel.

endif # DISPLAY_SDL

config DISPLAY_SHELL
    bool "Shell commands"
    default DRIVER_SHELL
    depends on SHELL
    help
      The display shell command, to show the display and turn its panel on
      or off.

module = DRIVER_DISPLAY
module-str = Display
source "subsys/logging/Kconfig.template.log_level"

endif # DISPLAY
```

## drivers/input/Kconfig
```kconfig
# SPDX-FileCopyrightText: 2026 Core Devices LLC
# SPDX-License-Identifier: Apache-2.0

menu "Input"

config INPUT_ADC_KEYS
    bool "ADC keys"
    default y
    depends on DT_HAS_ADC_KEYS_IRQ_ENABLED || DT_HAS_ADC_KEYS_ENABLED
    depends on INPUT
    select ADC
    select GPIO
    help
      Keys on a resistor ladder read through an ADC channel, polled or on
      an interrupt that a press or release raises.

if INPUT_ADC_KEYS

config INPUT_ADC_KEYS_IDLE_POLL_MS
    int "Idle poll period for polled ADC keys (ms)"
    default 80
    range 0 1000
    help
      Poll period in milliseconds for polled ladders once no key has been
      pressed for INPUT_ADC_KEYS_IDLE_DELAY_MS, letting the CPU stay asleep
      longer between scans. 0 keeps the devicetree's poll-interval.

config INPUT_ADC_KEYS_IDLE_DELAY_MS
    int "Quiet time before slowing polled ADC keys (ms)"
    default 2000
    range 0 60000
    help
      Milliseconds without key activity before a polled ladder slows to
      INPUT_ADC_KEYS_IDLE_POLL_MS.

endif # INPUT_ADC_KEYS

config INPUT_GPIO_KEYS
    bool "GPIO keys"
    default y
    depends on DT_HAS_GPIO_KEYS_ENABLED
    depends on INPUT
    select GPIO
    help
      Keys on GPIOs with interrupts, debounced in software.

config INPUT_SDL
    bool "SDL keyboard"
    default y if SOC_POSIX
    depends on INPUT
    select SDL
    help
      Watch buttons driven by the keyboard, through SDL, in a native build.

endmenu
```

## drivers/mcu/Kconfig
```kconfig
# SPDX-FileCopyrightText: 2026 Core Devices LLC
# SPDX-License-Identifier: Apache-2.0

menuconfig MCU
    bool "MCU information"
    help
      MCU information (pbl/drivers/mcu.h), such as the unique ID.

if MCU

config MCU_NRF5
    bool "Nordic nRF5"
    default y if SOC_NRF52
    help
      Support for Nordic nRF5 MCU information.

config MCU_SF32LB
    bool "SiFli SF32LB"
    default y if SOC_SF32LB52
    depends on SOC_SF32LB52
    select NVMEM
    help
      Support for SiFli SF32LB MCU information.

config MCU_ESP32C3
    bool "Espressif ESP32-C3"
    default y if SOC_ESP32C3
    depends on SOC_ESP32C3
    help
      Support for ESP32-C3 MCU information: the unique ID is the factory
      MAC address in eFuse, read without writing anything.

config MCU_QEMU
    bool "QEMU"
    default y if SOC_QEMU_PEBBLE
    help
      QEMU MCU information. QEMU emulates no unique ID, so it reports a
      fixed serial.

config MCU_POSIX
    bool "POSIX"
    default y if SOC_POSIX
    help
      MCU information for a native build.

endif # MCU
```

## drivers/otp/Kconfig
```kconfig
# SPDX-FileCopyrightText: 2026 Core Devices LLC
# SPDX-License-Identifier: Apache-2.0

menuconfig OTP
    bool "OTP Storage"
    help
      One-Time Programmable storage for serial numbers, HW revision, etc.

if OTP

config OTP_FLASH
    bool "Flash security registers"
    default y
    depends on FLASH_OTP
    help
      OTP slots in the cells the board lays out in the flash OTP area
      (security registers on SPI NOR parts). Driver: otp_flash.c.

config OTP_QEMU
    bool "QEMU"
    default y if SOC_QEMU_PEBBLE
    help
      QEMU OTP. QEMU emulates none, so all slots read as locked and empty.

config OTP_MCU
    bool "MCU unique ID"
    depends on MCU
    help
      No OTP: the serial number is the last 6 bytes of the MCU's unique
      ID in hex (the eFuse MAC on the ESP32-C3), so units differ; the
      other slots read as locked and empty.

config OTP_POSIX
    bool "POSIX"
    default y if SOC_POSIX
    help
      No OTP on the host: all slots read as locked and empty.

endif # OTP
```

## drivers/sdmmc/Kconfig
```kconfig
# SPDX-License-Identifier: Apache-2.0
config SDMMC_ESP32S3
    bool "ESP32-S3 SD card reader"
    default y
    depends on SHELL && DT_HAS_ESP_ESP32S3_SDMMC_ENABLED
    select PINCTRL
    select GPIO
    help
      Native one-bit SDMMC card identification and read-only FAT access with the sd shell command.
```
