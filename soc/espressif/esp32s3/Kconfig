## soc/espressif/esp32s3/Kconfig
```kconfig
# SPDX-FileCopyrightText: 2026 Core Devices LLC
# SPDX-License-Identifier: Apache-2.0

config SOC_ESP32S3_POWER_LATCH
    bool "Drive the power latch high at reset"
    default $(dt_has_nodelabel,power_latch)
    depends on SOC_ESP32S3
    help
      Drive the pin of the board's power_latch node high as the first
      thing early init does, before devices initialize, so a battery-powered
      board stays on once the power button is released.
```

## soc/espressif/esp32s3/Kconfig.soc
```kconfig
# SPDX-FileCopyrightText: 2026 Core Devices LLC
# SPDX-License-Identifier: Apache-2.0

config SOC_ESP32S3
    bool "Espressif ESP32-S3"
    select SOC_FAMILY_ESPRESSIF
    select CPU_XTENSA_LX7
    select RAMFUNC
    select SOC_HAS_RESET
    select TIMER_ESP32C3_SYSTIMER
    help
      Espressif ESP32-S3, dual-core Xtensa LX7 (running on Core 0) booted
      from flash via a 4 KiB 0xE9 IRAM XIP trampoline header, with code at
      0x42001000 and read-only data through 0x3c000000.
```

## subsys/samsa/Kconfig
```kconfig
# SPDX-FileCopyrightText: 2026 Core Devices LLC
# SPDX-License-Identifier: Apache-2.0

config SAMSA
    bool "Run third-party apps with the Samsa Thumb-2 interpreter"
    depends on !CPU_CORTEX_M
    # The thunks are generated from the SDK built for apps.
    select REQUIRES_ARM_TOOLCHAIN
    select UZLIB
    help
      Interpret the ARM code of third-party apps and workers with Samsa,
      so a native build can install and run .pbw files.

if SAMSA

# What the interpreter keeps per process for the firmware objects apps see.
# The defaults suit a 64-bit host, where objects with pointers are twice the
# size an app expects; a small target trades them for RAM.

config SAMSA_APP_SCRATCH_SIZE
    int "App scratch for the app's views of firmware objects (bytes)"
    default 262144

config SAMSA_APP_ARENA_SIZE
    int "App arena for host copies of app objects (bytes)"
    default 262144

config SAMSA_WORKER_SCRATCH_SIZE
    int "Worker scratch (bytes)"
    default 32768

config SAMSA_WORKER_ARENA_SIZE
    int "Worker arena (bytes)"
    default 32768

config SAMSA_MAX_HANDLES
    int "Firmware objects a process can address"
    default 4096

config SAMSA_HOST_STACK_SIZE
    int "Stack of the interpreter and the firmware it calls (bytes)"
    depends on !SOC_POSIX
    default 8192
    help
      On a firmware, the task of a process Samsa runs gets this stack in
      the process's RAM, besides the stack its ARM code runs on.

config SAMSA_MAX_OBJS
    int "Converted objects a process can have"
    default 1024

config SAMSA_CACHE_ENTRIES
    int "Decoded instructions a process keeps"
    range 0 1024
    default 0
    help
      Thumb instructions kept decoded per process, by address: a power of
      two, or 0 to decode every instruction each time it runs. Each entry
      takes about 12 bytes of each process's interpreter state.

config SAMSA_RAMFUNC
    bool "Run the interpreter's hot path from RAM"
    depends on RAMFUNC
    help
      Link the code Samsa runs on every interpreted instruction (its loop,
      the common instruction handlers and their helpers, about 7 KiB)
      into RAM, for SoCs that run code in place from flash through a small
      cache, where the interpreter otherwise waits on cache misses. Costs
      that much RAM.

module = SAMSA
module-str = Samsa
source "subsys/logging/Kconfig.template.log_level"

endif
```

## third_party/espressif_bt/Kconfig
```kconfig
# SPDX-FileCopyrightText: 2026 Core Devices LLC
# SPDX-License-Identifier: Apache-2.0

menuconfig ESP32C3_BT
    bool "Espressif ESP32-C3 Bluetooth LE controller"
    depends on SOC_ESP32C3
    select CRC
    select MCU
    select RNG
    help
      Link Espressif's Bluetooth LE controller and PHY libraries, from
      the esp32c3-bt-lib and esp-phy-lib submodules, with the glue that
      runs them on PebbleOS. Nothing starts the controller unless asked
      to: the btc shell command, or NimBLE's HCI transport once armed
      (or at every boot, with ESP32C3_BT_ARMED_BY_DEFAULT).
      Each bring-up arms the RTC watchdog until btc confirm proves the
      USB console alive, and a bring-up that never completed keeps the
      controller off at the following boots.

if ESP32C3_BT

config ESP32C3_BT_CONTROLLER_IN_FLASH
    bool "Controller linked whole in flash"
    help
      Link the controller library built to run from flash
      (libbtdm_app_flash.a) rather than the one that patches the
      controller in ROM (libbtdm_app.a). It saves about 23 KiB of RAM
      code, but its interrupt handlers then run from flash through the
      cache: on the Xteink X4 an advertising event's handler took over
      3 ms and the events were scheduled too late to go on air.

config ESP32C3_BT_CONTROLLER_PRIO
    int "Controller thread priority"
    default 4
    help
      Priority of the controller's thread, above the NimBLE host's, as
      ESP-IDF runs it two below its highest.

config ESP32C3_BT_CONTROLLER_STACK_SIZE
    int "Controller thread stack size in bytes"
    default 3584
    help
      ESP-IDF gives the controller task 3584 bytes.

config ESP32C3_BT_BLE_MAX_ACT
    int "BLE activities"
    range 1 10
    default 3
    help
      Advertising, scanning, connection and initiating instances the
      controller allocates for: each costs heap. The watch advertises
      and keeps one connection.

config ESP32C3_BT_CONFIRM_TIMEOUT_S
    int "Seconds to confirm a bring-up"
    range 5 3600
    default 30
    help
      The RTC watchdog resets the chip this long after a bring-up starts
      unless btc confirm stops it.

config ESP32C3_BT_ARMED_BY_DEFAULT
    bool "Use the controller without btc arm"
    help
      NimBLE's HCI transport brings the controller up at every boot, not
      only once btc arm asked for it. A bring-up that failed or hung
      still keeps the controller off at the following boots, on the fake
      HCI, until btc clear.

config ESP32C3_BT_REQUIRE_CONFIRM
    bool "Require a confirmation of every bring-up"
    default n if ESP32C3_BT_ARMED_BY_DEFAULT
    default y
    help
      Keep the RTC watchdog armed after a bring-up until btc confirm,
      typed on the console, proves the USB console alive; without it,
      the chip resets. Turn it off once the radio is proven on a board,
      e.g. for test runs that restart the watch: the watchdog then only
      covers the bring-up itself.

config ESP32C3_BT_SHELL
    bool "Shell commands"
    default y
    depends on SHELL
    help
      The btc command: start, confirm, arm and clear the controller,
      send it raw HCI packets, dump clock and power registers.

module = ESP32C3_BT
module-str = ESP32-C3 Bluetooth controller
source "subsys/logging/Kconfig.template.log_level"

endif # ESP32C3_BT
```
