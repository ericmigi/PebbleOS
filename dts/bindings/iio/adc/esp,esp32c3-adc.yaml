## dts/bindings/iio/adc/esp,esp32c3-adc.yaml
```yaml
# SPDX-License-Identifier: (GPL-2.0-only OR BSD-2-Clause)
%YAML 1.2
---
$id: http://devicetree.org/schemas/iio/adc/esp,esp32c3-adc.yaml#
$schema: http://devicetree.org/meta-schemas/core.yaml#

title: Espressif ESP32-C3 SAR ADC1

maintainers:
  - Eric Migicovsky <eric@repebble.com>

description:
  SAR ADC1 of the ESP32-C3, read one channel at a time through the one-shot
  conversions of its digital controller (APB_SARADC). Channel N is GPIO N,
  for N from 0 to 4. The factory calibration comes from eFuse BLOCK2. ADC2 is
  not supported.

properties:
  compatible:
    const: esp,esp32c3-adc

  reg:
    maxItems: 1

  interrupts:
    maxItems: 1

  "#io-channel-cells":
    const: 1

  esp,attenuation:
    $ref: /schemas/types.yaml#/definitions/uint32-array
    minItems: 5
    maxItems: 5
    items:
      enum: [0, 1, 2, 3]
    description:
      Input attenuation of channels 0 to 4, 0, 1, 2 or 3 for 0, 2.5, 6 or
      11 dB. With 11 dB the input reaches about 3 V, past which it reads
      full scale.

  pinctrl-0: true
  pinctrl-names: true

required:
  - compatible
  - reg
  - "#io-channel-cells"
  - esp,attenuation

additionalProperties: false

examples:
  - |
    adc@60040000 {
        compatible = "esp,esp32c3-adc";
        reg = <0x60040000 0x1000>;
        interrupts = <43>;
        #io-channel-cells = <1>;
        esp,attenuation = <3 3 3 3 3>;
    };
```

## dts/bindings/interrupt-controller/esp,esp32c3-intmatrix.yaml
```yaml
# SPDX-License-Identifier: (GPL-2.0-only OR BSD-2-Clause)
%YAML 1.2
---
$id: http://devicetree.org/schemas/interrupt-controller/esp,esp32c3-intmatrix.yaml#
$schema: http://devicetree.org/meta-schemas/core.yaml#

title: Espressif ESP32-C3 interrupt matrix

maintainers:
  - Eric Migicovsky <eric@repebble.com>

description:
  Routes each of the 62 peripheral interrupt sources of the ESP32-C3 to one
  of the 31 interrupt lines of its CPU. The specifier is the source number.

properties:
  compatible:
    const: esp,esp32c3-intmatrix

  reg:
    maxItems: 1

  interrupt-controller: true

  "#interrupt-cells":
    const: 1

required:
  - compatible
  - reg
  - interrupt-controller
  - "#interrupt-cells"

additionalProperties: false

examples:
  - |
    interrupt-controller@600c2000 {
        compatible = "esp,esp32c3-intmatrix";
        reg = <0x600c2000 0x800>;
        interrupt-controller;
        #interrupt-cells = <1>;
    };
```

## dts/bindings/interrupt-controller/esp,esp32s3-intmatrix.yaml
```yaml
# SPDX-License-Identifier: (GPL-2.0-only OR BSD-2-Clause)
%YAML 1.2
---
$id: http://devicetree.org/schemas/interrupt-controller/esp,esp32s3-intmatrix.yaml#
$schema: http://devicetree.org/meta-schemas/core.yaml#

title: Espressif ESP32-S3 interrupt matrix

maintainers:
  - Eric Migicovsky <eric@repebble.com>

description:
  Routes each of the 99 peripheral interrupt sources of the ESP32-S3 to one
  of the 32 interrupt lines of Core 0. The specifier is the source number.

properties:
  compatible:
    const: esp,esp32s3-intmatrix

  reg:
    maxItems: 1

  interrupt-controller: true

  "#interrupt-cells":
    const: 1

required:
  - compatible
  - reg
  - interrupt-controller
  - "#interrupt-cells"

additionalProperties: false

examples:
  - |
    interrupt-controller@600c2000 {
        compatible = "esp,esp32s3-intmatrix";
        reg = <0x600c2000 0x800>;
        interrupt-controller;
        #interrupt-cells = <1>;
    };
```

## dts/bindings/mmc/esp,esp32s3-sdmmc.yaml
```yaml
# SPDX-License-Identifier: (GPL-2.0-only OR BSD-2-Clause)
%YAML 1.2
---
$id: http://devicetree.org/schemas/mmc/esp,esp32s3-sdmmc.yaml#
$schema: http://devicetree.org/meta-schemas/core.yaml#

title: Espressif ESP32-S3 native SDMMC controller

maintainers:
  - Core Devices <firmware@repebble.com>

properties:
  compatible:
    const: esp,esp32s3-sdmmc
  reg:
    maxItems: 1
  pinctrl-0: true
  pinctrl-names:
    const: default
  power-gpios:
    maxItems: 1

required: [compatible, reg, pinctrl-0]
additionalProperties: false
```

## dts/bindings/mtd/esp,esp32c3-flash.yaml
```yaml
# SPDX-License-Identifier: (GPL-2.0-only OR BSD-2-Clause)
%YAML 1.2
---
$id: http://devicetree.org/schemas/mtd/esp,esp32c3-flash.yaml#
$schema: http://devicetree.org/meta-schemas/core.yaml#

title: Espressif ESP32-C3 flash

maintainers:
  - Eric Migicovsky <eric@repebble.com>

description:
  The SPI flash the ESP32-C3 boots and runs from, mapped by the cache at
  0x42000000 for instructions and 0x3c000000 for data. reg is its range in
  flash offsets.

properties:
  compatible:
    const: esp,esp32c3-flash

  reg:
    maxItems: 1

  partitions:
    type: object

required:
  - compatible
  - reg

additionalProperties: false

examples:
  - |
    flash@0 {
        compatible = "esp,esp32c3-flash";
        reg = <0x0 0x400000>;
    };
```

## dts/bindings/nvmem/esp,esp32c3-efuse.yaml
```yaml
# SPDX-License-Identifier: (GPL-2.0-only OR BSD-2-Clause)
%YAML 1.2
---
$id: http://devicetree.org/schemas/nvmem/esp,esp32c3-efuse.yaml#
$schema: http://devicetree.org/meta-schemas/core.yaml#

title: Espressif ESP32-C3 eFuse controller

maintainers:
  - Eric Migicovsky <eric@repebble.com>

description:
  The eFuse controller of the ESP32-C3, whose read registers mirror the
  blocks programmed at the factory: the MAC address, chip revision and
  calibration.

properties:
  compatible:
    const: esp,esp32c3-efuse

  reg:
    maxItems: 1

required:
  - compatible
  - reg

additionalProperties: false

examples:
  - |
    efuse@60008800 {
        compatible = "esp,esp32c3-efuse";
        reg = <0x60008800 0x200>;
    };
```

## dts/bindings/pinctrl/esp,esp32c3-pinctrl.yaml
```yaml
# SPDX-License-Identifier: (GPL-2.0-only OR BSD-2-Clause)
%YAML 1.2
---
$id: http://devicetree.org/schemas/pinctrl/esp,esp32c3-pinctrl.yaml#
$schema: http://devicetree.org/meta-schemas/core.yaml#

title: Espressif ESP32-C3 pin controller (IO_MUX and GPIO matrix)

maintainers:
  - Eric Migicovsky <eric@repebble.com>

description: |
  Configures the pads of the ESP32-C3 and routes peripheral signals to them
  through the GPIO matrix. A pinmux cell, ESP32C3_PINMUX(pad, in, out) of
  <dt-bindings/pinctrl/esp32c3-pinctrl.h>, gives a pad and the numbers of the
  matrix's input signal reading it and output signal driving it, or
  ESP32C3_NOSIG. Pin configuration states are children of the controller,
  holding groups of pins that share a pad configuration.

properties:
  compatible:
    const: esp,esp32c3-pinctrl

  reg:
    maxItems: 1

  esp,gpio-matrix:
    $ref: /schemas/types.yaml#/definitions/phandle
    description: GPIO matrix, which routes the signals.

patternProperties:
  '-state$':
    type: object
    description: A pin configuration state, referenced from pinctrl-N.

    patternProperties:
      '^(.+-)?pins$':
        type: object
        description: A group of pins sharing their pad configuration.
        allOf:
          - $ref: /schemas/pinctrl/pincfg-node.yaml#

        properties:
          pinmux:
            $ref: /schemas/types.yaml#/definitions/uint32-array

          bias-disable: true
          bias-pull-up: true
          bias-pull-down: true
          drive-push-pull: true
          drive-open-drain: true

          drive-strength:
            enum: [5, 10, 20, 40]

        required:
          - pinmux

        additionalProperties: false

    additionalProperties: false

required:
  - compatible
  - reg
  - esp,gpio-matrix

additionalProperties: false

examples:
  - |
    pinctrl@60009000 {
        compatible = "esp,esp32c3-pinctrl";
        reg = <0x60009000 0x1000>;
        esp,gpio-matrix = <&gpio>;

        spi2-default-state {
            sck-pins {
                pinmux = <((8) | (0x1ff << 6) | (63 << 15))>;
                drive-strength = <20>;
            };
        };
    };
```

## dts/bindings/power/supply/coredevices,adc-charger.yaml
```yaml
# SPDX-License-Identifier: (GPL-2.0-only OR BSD-2-Clause)
%YAML 1.2
---
$id: http://devicetree.org/schemas/power/supply/coredevices,adc-charger.yaml#
$schema: http://devicetree.org/meta-schemas/core.yaml#

title: Charger seen through a presence pin and an ADC channel

maintainers:
  - Eric Migicovsky <eric@repebble.com>

description: |
  A charger the firmware cannot talk to, such as a TP4056 with its status
  pins not connected: a GPIO is high while external power is present, and an
  ADC channel reads the battery through a resistor divider, given as with
  voltage-divider.

properties:
  compatible:
    const: coredevices,adc-charger

  gpios:
    maxItems: 1
    description: High while external power is present.

  io-channels:
    maxItems: 1
    description: ADC channel on the divider's output.

  output-ohms:
    description: Resistance across which the ADC reads.

  full-ohms:
    description: Resistance of the whole divider.

required:
  - compatible
  - gpios
  - io-channels
  - output-ohms
  - full-ohms

additionalProperties: false

examples:
  - |
    #include <dt-bindings/gpio/gpio.h>

    charger {
        compatible = "coredevices,adc-charger";
        gpios = <&gpio 20 GPIO_ACTIVE_HIGH>;
        io-channels = <&adc 0>;
        output-ohms = <10000>;
        full-ohms = <20000>;
    };
```

## dts/bindings/riscv/esp,riscv.yaml
```yaml
# SPDX-License-Identifier: (GPL-2.0-only OR BSD-2-Clause)
%YAML 1.2
---
$id: http://devicetree.org/schemas/riscv/esp,riscv.yaml#
$schema: http://devicetree.org/meta-schemas/core.yaml#

title: Espressif RISC-V CPU

maintainers:
  - Eric Migicovsky <eric@repebble.com>

description:
  The RV32IMC core of the ESP32-C3. It has no mie CSR; its interrupt lines
  are enabled in the interrupt matrix.

allOf:
  - $ref: /schemas/cpu.yaml#

properties:
  compatible:
    const: esp,riscv

  reg:
    maxItems: 1

  clock-frequency:
    description:
      CPU clock the early init sets, 160, 80, 40 or 20 MHz, and the rate the
      cycle counter (the PCCR CSR) counts at.

required:
  - compatible
  - device_type
  - reg

unevaluatedProperties: false

examples:
  - |
    cpus {
        #address-cells = <1>;
        #size-cells = <0>;

        cpu@0 {
            compatible = "esp,riscv";
            device_type = "cpu";
            reg = <0>;
            clock-frequency = <160000000>;
        };
    };
```

## dts/bindings/riscv/espressif.yaml
```yaml
# SPDX-License-Identifier: (GPL-2.0-only OR BSD-2-Clause)
%YAML 1.2
---
$id: http://devicetree.org/schemas/riscv/espressif.yaml#
$schema: http://devicetree.org/meta-schemas/core.yaml#

title: Espressif ESP32-C3 boards

maintainers:
  - Eric Migicovsky <eric@repebble.com>

properties:
  $nodename:
    const: "/"
  compatible:
    oneOf:
      - description: Espressif's QEMU esp32c3 machine
        items:
          - const: qemu,esp32c3
          - const: esp,esp32c3
      - description: Xteink X4 e-reader
        items:
          - const: xteink,x4
          - const: esp,esp32c3

additionalProperties: true
```

## dts/bindings/rng/esp,esp32c3-rng.yaml
```yaml
# SPDX-License-Identifier: (GPL-2.0-only OR BSD-2-Clause)
%YAML 1.2
---
$id: http://devicetree.org/schemas/rng/esp,esp32c3-rng.yaml#
$schema: http://devicetree.org/meta-schemas/core.yaml#

title: Espressif ESP32-C3 random number generator

maintainers:
  - Eric Migicovsky <eric@repebble.com>

description:
  The RNG_DATA register of the APB controller. Its generator takes entropy
  from the noise of the SAR ADC or the radio while either is on, and is only
  a pseudo-random sequence otherwise.

properties:
  compatible:
    const: esp,esp32c3-rng

  reg:
    maxItems: 1

required:
  - compatible
  - reg

additionalProperties: false

examples:
  - |
    rng@600260b0 {
        compatible = "esp,esp32c3-rng";
        reg = <0x600260b0 0x4>;
    };
```

## dts/bindings/serial/esp,esp32c3-uart.yaml
```yaml
# SPDX-License-Identifier: (GPL-2.0-only OR BSD-2-Clause)
%YAML 1.2
---
$id: http://devicetree.org/schemas/serial/esp,esp32c3-uart.yaml#
$schema: http://devicetree.org/meta-schemas/core.yaml#

title: Espressif ESP32-C3 UART controller

maintainers:
  - Eric Migicovsky <eric@repebble.com>

allOf:
  - $ref: /schemas/serial/serial.yaml#

properties:
  compatible:
    const: esp,esp32c3-uart

  reg:
    maxItems: 1

  interrupts:
    maxItems: 1

  clocks:
    maxItems: 1
    description: Function clock, the APB clock.

  current-speed:
    $ref: /schemas/types.yaml#/definitions/uint32
    description: Initial baud rate, in bits per second.

required:
  - compatible
  - reg
  - interrupts
  - clocks

unevaluatedProperties: false

examples:
  - |
    serial@60000000 {
        compatible = "esp,esp32c3-uart";
        reg = <0x60000000 0x1000>;
        interrupts = <21>;
        clocks = <&clk_apb>;
    };
```

## dts/bindings/serial/esp,esp32c3-usb-serial-jtag.yaml
```yaml
# SPDX-License-Identifier: (GPL-2.0-only OR BSD-2-Clause)
%YAML 1.2
---
$id: http://devicetree.org/schemas/serial/esp,esp32c3-usb-serial-jtag.yaml#
$schema: http://devicetree.org/meta-schemas/core.yaml#

title: Espressif ESP32-C3 USB-Serial-JTAG controller

maintainers:
  - Eric Migicovsky <eric@repebble.com>

description:
  USB device controller on the chip's USB pins, giving the host a CDC-ACM
  serial port and a JTAG adapter. Set up by the ROM, which also resets the
  chip through it.

properties:
  compatible:
    const: esp,esp32c3-usb-serial-jtag

  reg:
    maxItems: 1

  interrupts:
    maxItems: 1

required:
  - compatible
  - reg
  - interrupts

additionalProperties: false

examples:
  - |
    serial@60043000 {
        compatible = "esp,esp32c3-usb-serial-jtag";
        reg = <0x60043000 0x1000>;
        interrupts = <26>;
    };
```

## dts/bindings/soc/espressif/esp,esp32c3-rtc-cntl.yaml
```yaml
# SPDX-License-Identifier: (GPL-2.0-only OR BSD-2-Clause)
%YAML 1.2
---
$id: http://devicetree.org/schemas/soc/espressif/esp,esp32c3-rtc-cntl.yaml#
$schema: http://devicetree.org/meta-schemas/core.yaml#

title: Espressif ESP32-C3 RTC control

maintainers:
  - Eric Migicovsky <eric@repebble.com>

description:
  The always-on domain of the ESP32-C3, with its power, sleep and reset control,
  the RTC watchdog and the super watchdog.

properties:
  compatible:
    const: esp,esp32c3-rtc-cntl

  reg:
    maxItems: 1

  interrupts:
    maxItems: 1

required:
  - compatible
  - reg

additionalProperties: false

examples:
  - |
    rtc@60008000 {
        compatible = "esp,esp32c3-rtc-cntl";
        reg = <0x60008000 0x1000>;
        interrupts = <27>;
    };
```

## dts/bindings/soc/espressif/esp,esp32c3-system.yaml
```yaml
# SPDX-License-Identifier: (GPL-2.0-only OR BSD-2-Clause)
%YAML 1.2
---
$id: http://devicetree.org/schemas/soc/espressif/esp,esp32c3-system.yaml#
$schema: http://devicetree.org/meta-schemas/core.yaml#

title: Espressif ESP32-C3 system registers

maintainers:
  - Eric Migicovsky <eric@repebble.com>

description:
  Clock, reset and peripheral enables of the ESP32-C3, and the four
  interrupts the CPU raises in software.

properties:
  compatible:
    const: esp,esp32c3-system

  reg:
    maxItems: 1

required:
  - compatible
  - reg

additionalProperties: false

examples:
  - |
    syscon@600c0000 {
        compatible = "esp,esp32c3-system";
        reg = <0x600c0000 0x1000>;
    };
```

## dts/bindings/soc/espressif/esp,esp32s3-rtc-cntl.yaml
```yaml
# SPDX-License-Identifier: (GPL-2.0-only OR BSD-2-Clause)
%YAML 1.2
---
$id: http://devicetree.org/schemas/soc/espressif/esp,esp32s3-rtc-cntl.yaml#
$schema: http://devicetree.org/meta-schemas/core.yaml#

title: Espressif ESP32-S3 RTC controller

maintainers:
  - Eric Migicovsky <eric@repebble.com>

properties:
  compatible:
    const: esp,esp32s3-rtc-cntl

  reg:
    maxItems: 1

  interrupts:
    maxItems: 1

required:
  - compatible
  - reg

additionalProperties: false
```
