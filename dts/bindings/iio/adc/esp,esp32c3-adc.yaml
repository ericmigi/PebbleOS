## pebble/Kconfig
```kconfig
# SPDX-FileCopyrightText: 2026 Core Devices LLC
# SPDX-License-Identifier: Apache-2.0

mainmenu "Pebble Firmware Configuration"

# Defaults for options of PebbleOS that depend on the build type (release,
# MFG), on what the architecture offers or on the devicetree, which a .conf
# file cannot express. Anything else belongs in prj*.conf or boards/*.conf.

choice FIRMWARE_AREA
    default FIRMWARE_AREA_RECOVERY if RECOVERY_FW && !MFG
endchoice

# PBLBOOT runs the image in place from its slot. The recovery image has to fit
# the partition it is stored in.
config FLASH_OFFSET
    default $(dt_partition_offset,safe-firmware) if PBLBOOT && FIRMWARE_AREA_RECOVERY
    default $(dt_partition_offset,firmware-slot-1) if PBLBOOT && FIRMWARE_SLOT = 1
    default $(dt_partition_offset,firmware-slot-0) if PBLBOOT

config FW_FLASH_SIZE
    default $(dt_partition_size,safe-firmware) if FIRMWARE_AREA_RECOVERY && $(dt_has_partition,safe-firmware)
    default $(dt_partition_size,firmware-slot-1) if PBLBOOT && FIRMWARE_SLOT = 1
    default $(dt_partition_size,firmware-slot-0) if PBLBOOT

config CONSOLE
    default y if !RELEASE || MFG

config CONSOLE_IMAGING
    default y
    depends on CONSOLE

config COREDUMP
    default y
    depends on ARCH_HAS_COREDUMP

config DEBUGGER_AWARE
    default y if !RELEASE
    depends on ARCH_HAS_DEBUGGER_DETECT

# MFG writes the flash security registers from the shell.
config FLASH_SHELL
    default y if MFG
    depends on FLASH && SHELL

config FLASH_SHELL_TEST
    default y if MFG
    depends on FLASH_SHELL

# Apps are built soft-float and call into the firmware.
config FP_SOFTFP_ABI
    default y
    depends on CPU_HAS_FPU

config GH3X2X_ALGO
    default n if RECOVERY_FW && !MFG
    depends on HRM_GH3X2X

config HRM_GH3X2X_FACTORY_TEST
    default y if MFG
    depends on HRM && GH3X2X_ALGO

config KERNEL_STACK_GUARD
    default y
    depends on ARCH_HAS_STACK_GUARD

config PP_TRANSPORT_CONSOLE
    default y
    depends on PP && CONSOLE

config PP_TRANSPORT_GATT
    default y
    depends on PP && BT

config SHELL
    default y
    depends on CONSOLE

config USERSPACE
    default y
    depends on ARCH_HAS_USERSPACE

# The SDK platform, and what follows from it.
rsource "Kconfig.platform"

config APP_NATIVE_RISCV32
    bool "Run riscv32 apps natively"
    depends on CPU_RISCV && PLATFORM_ABI = "riscv32"
    default y
    help
      Run third-party apps built for the platform's riscv32 ABI from app
      RAM, through the instruction-bus window of the RAM. Nothing protects
      the system from them: this port has no userspace or PMP, so an app
      runs privileged, as a built-in app does, and can write any memory.

# RAM of the apps of the legacy SDK execution environments. 2.x apps are
# rectangular; 3.x apps are those of the frozen platform of the same shape
# and colour depth. A platform states the RAM of its own, 4.x, apps.

config APP_RAM_2X_SEGMENT_SIZE
    default 0 if PLATFORM_ROUND
    default 25952

config APP_RAM_2X_RUNTIME_SIZE
    default 0 if PLATFORM_ROUND
    default 6820

config APP_RAM_3X_SEGMENT_SIZE
    default 67584 if PLATFORM_ROUND || PLATFORM_COLOR
    default 25952

config APP_RAM_3X_RUNTIME_SIZE
    default 30720 if PLATFORM_ROUND || PLATFORM_COLOR
    default 6820

source "Kconfig.pebbleos"

config SCREEN_COLOR_DEPTH_BITS
    int
    default 8 if PLATFORM_COLOR
    default 1

config FIRMWARE_UPDATE
    bool "Firmware updates from the phone"
    default n if SOC_ESP32C3
    default y
    help
      Take a new firmware, recovery firmware or system resources from the
      phone. Without it, a firmware update start is answered as cancelled
      and those PutBytes objects are refused. Off where no bootloader can
      install or fall back from an update, e.g. the ESP32-C3, whose ROM
      boots the code partition directly.

config RECOVERY_FW
    bool "Recovery firmware (PRF)"
    help
      Build the recovery firmware variant. Set via prj_prf.conf when
      configuring with --variant=prf; do not set manually.

config MFG
    bool "Manufacturing firmware"
    depends on RECOVERY_FW
    help
      Enable manufacturing-only functionality in the PRF build, which
      MFG firmwares are built on.

rsource "apps/Kconfig"
rsource "kernel/Kconfig"
rsource "services/Kconfig"

menu "Software Features"

config SETTINGS_ICONS
    bool "Settings menu icons"
    help
      Show icons next to entries in the system Settings menu.

config BACKLIGHT_STANDARD_INTENSITY
    int "Standard backlight preset intensity (%)"
    range 1 100
    default 50
    help
      Logical brightness used by the Standard backlight preset and fresh
      shell preferences. The light service scales it to the board hardware
      maximum. Saved brightness preferences take precedence.

config DYNAMIC_BACKLIGHT
    bool "Dynamic backlight"
    help
      Adjust backlight intensity based on ambient light readings.
      Requires an ambient light sensor.

config ACCEL_SENSITIVITY
    bool "Accelerometer sensitivity setting"
    help
      Expose the accelerometer tap/shake sensitivity adjustment in
      Settings.

config APP_SCALING
    bool "App scaling"
    help
      Scale legacy lower-resolution apps to the current display via
      the compositor.

config WATCHFACE_BEZEL
    bool "Watchfaces at 144x168 in a black bezel"
    depends on !PLATFORM_ROUND
    help
      Give watchfaces a 144x168 framebuffer, which the compositor
      centres on the display in a black bezel, for displays whose pixels
      are small enough that a watchface drawn to the whole display would
      be too large. A watchface built for this display, or for every
      display, keeps the whole of it.

choice SYSTEM_UI_FONT_CHOICE
    prompt "Typeface of the system UI"
    default SYSTEM_UI_FONT_ATKINSON_NEXT if PLATFORM_XTEINKX4
    default SYSTEM_UI_FONT_GOTHIC
    help
      The system's own windows and the built-in apps that fill the display
      draw their Gothic text in this typeface, on Gothic's line heights.
      Third-party apps and framed watchfaces keep Gothic, as their layouts
      are made for its metrics.

config SYSTEM_UI_FONT_GOTHIC
    bool "Gothic"

config SYSTEM_UI_FONT_ATKINSON_NEXT
    bool "Atkinson Hyperlegible Next, at panel resolution"
    select SYSTEM_UI_FONT
    select SYSTEM_UI_FONT_SCALE2

config SYSTEM_UI_FONT_LITERATA_ATKINSON
    bool "Literata text with Atkinson Hyperlegible Next titles, at panel resolution"
    select SYSTEM_UI_FONT
    select SYSTEM_UI_FONT_SCALE2
    help
      Regular text (bodies, subtitles) in Literata, bold text (titles,
      menus) in Atkinson Hyperlegible Next.

config SYSTEM_UI_FONT_LOCAL_BOOKERLY_ATKINSON
    bool "Local: Bookerly text, Atkinson Hyperlegible Next titles (development only)"
    select SYSTEM_UI_FONT
    select SYSTEM_UI_FONT_SCALE2
    select SYSTEM_UI_FONT_LOCAL
    help
      Bookerly is proprietary (Amazon / Dalton Maag): its files come
      from SYSTEM_UI_FONT_LOCAL_DIR on this machine, are never in the
      tree, and a build with them must not leave the machine.

config SYSTEM_UI_FONT_LOCAL_BOOKERLY
    bool "Local: Bookerly for all text (development only)"
    select SYSTEM_UI_FONT
    select SYSTEM_UI_FONT_SCALE2
    select SYSTEM_UI_FONT_LOCAL
    help
      As SYSTEM_UI_FONT_LOCAL_BOOKERLY_ATKINSON, with Bookerly Bold for
      titles too.

config SYSTEM_UI_FONT_NOTO_SANS_CONDENSED
    bool "Noto Sans Condensed"
    select SYSTEM_UI_FONT

config SYSTEM_UI_FONT_PLEX_SANS_CONDENSED
    bool "IBM Plex Sans Condensed"
    select SYSTEM_UI_FONT

endchoice

config SYSTEM_UI_FONT
    bool
    help
      The system UI has a typeface of its own, the UI_SANS_* fonts.

config SYSTEM_UI_FONT_LOCAL
    bool

config SYSTEM_UI_FONT_LOCAL_DIR
    string "Directory of the local, non-redistributable UI fonts"
    depends on SYSTEM_UI_FONT_LOCAL
    default "~/dev/pebbleos-local-fonts/bookerly"
    help
      Holds Bookerly-Regular.ttf and Bookerly-Bold.ttf. Development only:
      do not commit these fonts or anything built from them.

config SYSTEM_UI_FONT_SCALE2
    bool
    help
      The UI_SANS_* fonts are stored at twice their resolution, for a
      display scaled by two.

config FRAMEBUFFER_SCALE2
    bool "Framebuffers at twice the display's resolution"
    depends on SCREEN_COLOR_DEPTH_BITS = 1
    help
      Each pixel of the display's size (PBL_DISPLAY_WIDTH by
      PBL_DISPLAY_HEIGHT, the size layouts use) is 2x2 pixels in every
      framebuffer, and the display gets the framebuffer at that resolution.
      Text in fonts stored at panel resolution is drawn at it; everything
      else is drawn as 2x2 blocks.

config FRAMEBUFFER_SCALE2_SHAPES
    bool "Draw shapes at twice the display's resolution"
    default y
    depends on FRAMEBUFFER_SCALE2
    help
      Slanted lines, circles, arcs and paths, and the PDC icons made of
      them, at the framebuffer's resolution rather than as 2x2 blocks.
      Costs about 0.7 M instructions on a launcher frame with its icons
      (about 20 %).

config TEXT_DETAIL
    bool "Text edges at panel resolution and in grey"
    default y
    depends on SYSTEM_UI_FONT_SCALE2 && !RECOVERY_FW && !FRAMEBUFFER_SCALE2
    help
      Record the edge pixels of the system UI's text, so a display that
      shows each pixel as 2x2 panel pixels can draw them at panel
      resolution (sub-pixel edges) or in grey, without a frame at panel
      resolution. Choose with the console's "text mode" command.

if TEXT_DETAIL

config TEXT_DETAIL_CELLS
    int "Edge pixels recorded"
    range 8 16376
    default 10400
    help
      Edge pixels of text on the display that get their detail; the pool
      takes 2.25 bytes each, plus 2 bytes per display row. A full
      notification takes about 8,500 with grey edges, packed in rows of
      8. A frame whose text does not fit is shown without detail.

config TEXT_DETAIL_DEFAULT_MODE
    int "Mode at boot (0 none, 1 grey, 2 sub-pixel edges, 3 both)"
    range 0 3
    default 3

endif # TEXT_DETAIL

config ORIENTATION_MANAGER
    bool "Orientation manager UI"
    help
      Expose the device-orientation / rotation prefs in shell and
      Settings. Independent of CONFIG_SERVICE_ORIENTATION_MANAGER,
      which controls whether the underlying service is built.

config MODDABLE_XS
    bool "Moddable XS JavaScript engine"
    depends on USERSPACE && !RECOVERY_FW
    help
      Build Moddable XS support for running JavaScript apps.

config RAMFUNC_DRAWING
    bool "Run the hottest drawing code from RAM"
    depends on RAMFUNC
    help
      Link the functions most of a UI redraw runs (about 16 KiB: raster
      and text primitives, the heap, memset and memcpy) into RAM, for
      SoCs that run in place from flash through a small cache, where a
      redraw otherwise waits on cache misses. Costs that much RAM.

config MMAP_RESOURCES
    bool "Memory-mapped (zero-copy) resource reads"
    help
      Serve read-only system resources as direct pointers into
      memory-mapped flash instead of copying them out.

endmenu

choice
    prompt "Shell"
    default SHELL_NORMAL

config SHELL_NORMAL
    bool "Normal shell"

config SHELL_SDK
    bool "SDK shell"
    help
      Use the SDK shell instead of the normal shell.

endchoice

menu "Debug & instrumentation"

config QEMU_SERIAL
    bool "QEMU serial protocol"
    help
      The Pebble protocol and the emulator's controls (battery, taps,
      time format, ...) over the board's QEMU_UART, framed as libpebble2's
      QEMU transport expects.

if QEMU_SERIAL

module = QEMU_SERIAL
module-str = QEMU serial protocol
source "subsys/logging/Kconfig.template.log_level"

endif # QEMU_SERIAL

config NO_WATCH_TIMEOUT
    bool "Disable watchface idle timeout"

config UI_DEBUG
    bool "UI debug commands"
    help
      Enable the window dump and layer nudge CLI commands.

config MALLOC_INSTRUMENTATION
    bool "Malloc instrumentation"
    help
      Track the caller PC of every heap allocation.

config PERFORMANCE_TESTS
    bool "Performance test instrumentation"
    select PROFILER

endmenu
```
