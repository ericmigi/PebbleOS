## dts/bindings/soc/espressif/esp,esp32s3-system.yaml
```yaml
# SPDX-License-Identifier: (GPL-2.0-only OR BSD-2-Clause)
%YAML 1.2
---
$id: http://devicetree.org/schemas/soc/espressif/esp,esp32s3-system.yaml#
$schema: http://devicetree.org/meta-schemas/core.yaml#

title: Espressif ESP32-S3 system controller

maintainers:
  - Eric Migicovsky <eric@repebble.com>

properties:
  compatible:
    const: esp,esp32s3-system

  reg:
    maxItems: 1

required:
  - compatible
  - reg

additionalProperties: false
```

## dts/bindings/spi/esp,esp32c3-spi.yaml
```yaml
# SPDX-License-Identifier: (GPL-2.0-only OR BSD-2-Clause)
%YAML 1.2
---
$id: http://devicetree.org/schemas/spi/esp,esp32c3-spi.yaml#
$schema: http://devicetree.org/meta-schemas/core.yaml#

title: Espressif ESP32-C3 general purpose SPI controller (GPSPI2)

maintainers:
  - Eric Migicovsky <eric@repebble.com>

description:
  The ESP32-C3's general purpose SPI controller as a master, clocked from the
  APB clock. Chip selects are GPIOs, from cs-gpios; SCLK, MOSI and MISO are
  routed through the GPIO matrix by the default pin state.

allOf:
  - $ref: /schemas/spi/spi-controller.yaml#

properties:
  compatible:
    const: esp,esp32c3-spi

  reg:
    maxItems: 1

  interrupts:
    maxItems: 1

  clocks:
    maxItems: 1
    description: APB clock.

  pinctrl-0: true

  pinctrl-names:
    const: default

required:
  - compatible
  - reg
  - clocks
  - pinctrl-0
  - pinctrl-names

unevaluatedProperties: false

examples:
  - |
    spi@60024000 {
        compatible = "esp,esp32c3-spi";
        reg = <0x60024000 0x1000>;
        interrupts = <19>;
        clocks = <&clk_apb>;
        pinctrl-0 = <&spi2_default>;
        pinctrl-names = "default";
        cs-gpios = <&gpio 21 0>, <&gpio 12 0>;
        #address-cells = <1>;
        #size-cells = <0>;
    };
```

## dts/bindings/timer/esp,esp32c3-systimer.yaml
```yaml
# SPDX-License-Identifier: (GPL-2.0-only OR BSD-2-Clause)
%YAML 1.2
---
$id: http://devicetree.org/schemas/timer/esp,esp32c3-systimer.yaml#
$schema: http://devicetree.org/meta-schemas/core.yaml#

title: Espressif ESP32-C3 system timer

maintainers:
  - Eric Migicovsky <eric@repebble.com>

description:
  Two 52-bit counters of a fixed 16 MHz, from XTAL_CLK, and three
  comparators, each with its interrupt.

properties:
  compatible:
    const: esp,esp32c3-systimer

  reg:
    maxItems: 1

  interrupts:
    items:
      - description: Comparator 0
      - description: Comparator 1
      - description: Comparator 2

required:
  - compatible
  - reg
  - interrupts

additionalProperties: false

examples:
  - |
    timer@60023000 {
        compatible = "esp,esp32c3-systimer";
        reg = <0x60023000 0x1000>;
        interrupts = <37>, <38>, <39>;
    };
```

## dts/bindings/timer/esp,esp32c3-timg.yaml
```yaml
# SPDX-License-Identifier: (GPL-2.0-only OR BSD-2-Clause)
%YAML 1.2
---
$id: http://devicetree.org/schemas/timer/esp,esp32c3-timg.yaml#
$schema: http://devicetree.org/meta-schemas/core.yaml#

title: Espressif ESP32-C3 timer group

maintainers:
  - Eric Migicovsky <eric@repebble.com>

description:
  A general-purpose 54-bit timer and a watchdog, which the boot ROM may
  leave armed.

properties:
  compatible:
    const: esp,esp32c3-timg

  reg:
    maxItems: 1

  interrupts:
    items:
      - description: Timer
      - description: Watchdog

required:
  - compatible
  - reg

additionalProperties: false

examples:
  - |
    timer@6001f000 {
        compatible = "esp,esp32c3-timg";
        reg = <0x6001f000 0x1000>;
        interrupts = <32>, <33>;
    };
```

## dts/bindings/xtensa/esp,xtensa-lx7.yaml
```yaml
# SPDX-License-Identifier: (GPL-2.0-only OR BSD-2-Clause)
%YAML 1.2
---
$id: http://devicetree.org/schemas/xtensa/esp,xtensa-lx7.yaml#
$schema: http://devicetree.org/meta-schemas/core.yaml#

title: Espressif Xtensa LX7 CPU

maintainers:
  - Eric Migicovsky <eric@repebble.com>

description:
  Xtensa LX7 core of the ESP32-S3 with 64 windowed address registers,
  single-precision FPU and CCOUNT cycle counter.

allOf:
  - $ref: /schemas/cpu.yaml#

properties:
  compatible:
    const: esp,xtensa-lx7

  reg:
    maxItems: 1

  clock-frequency:
    description:
      CPU clock set by early init (240, 160, 80 or 40 MHz) and the rate
      the CCOUNT cycle counter ticks at.

required:
  - compatible
  - device_type
  - reg

unevaluatedProperties: false

examples:
  - |
    cpus {
        #address-cells = <1>;
        #size-cells = <0>;

        cpu@0 {
            compatible = "esp,xtensa-lx7";
            device_type = "cpu";
            reg = <0>;
            clock-frequency = <240000000>;
        };
    };
```

## kernel/arch/riscv/Kconfig
```kconfig
# SPDX-FileCopyrightText: 2026 Core Devices LLC
# SPDX-License-Identifier: Apache-2.0

config CPU_RISCV
	bool
	help
	  RISC-V core running in machine mode only. Selected through the CPU
	  the SoC selects.

config CPU_RV32IMC
	bool
	select CPU_RISCV
	help
	  RV32IMC core with the Zicsr and Zifencei extensions, and no atomics:
	  read-modify-write atomics are emulated with interrupts masked.

config RISCV_ISA
	string
	default "rv32imc_zicsr_zifencei" if CPU_RV32IMC
	help
	  -march the code is built for.

config RISCV_ABI
	string
	default "ilp32" if CPU_RV32IMC
	help
	  -mabi the code is built for.

config RISCV_PCCR
	bool
	help
	  The cycle counter is the Espressif PCCR CSR (0x7e2), which must be
	  enabled, rather than mcycle.

config RISCV_CODE_ALIAS_OFFSET
	hex
	default 0x0
	help
	  Offset from the FLASH addresses the code is loaded at to those it
	  runs at, for SoCs whose data bus can't read the instruction-bus
	  window of the flash, nor fetch from the data-bus one.
```

## kernel/arch/xtensa/Kconfig
```kconfig
# SPDX-FileCopyrightText: 2026 Core Devices LLC
# SPDX-License-Identifier: Apache-2.0

config CPU_XTENSA
	bool
	help
	  Xtensa core running with the windowed ABI. Selected through the CPU
	  the SoC selects.

config CPU_XTENSA_LX7
	bool
	select CPU_XTENSA
	help
	  Xtensa LX7 core with 64 windowed address registers, zero-overhead
	  loops, single-precision FPU and CCOUNT cycle counter.

config XTENSA_CODE_ALIAS_OFFSET
	hex
	default 0x0
	help
	  Offset from the FLASH addresses the code is loaded at to those it
	  runs at, for SoCs whose data bus cannot read the instruction-bus
	  window of the flash, nor fetch from the data-bus one.
```
