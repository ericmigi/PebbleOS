## CMakeLists.txt
```
# SPDX-License-Identifier: Apache-2.0

cmake_minimum_required(VERSION 3.20.0)

set(USER_CACHE_DIR "${CMAKE_BINARY_DIR}/.cache" CACHE PATH "Zephyr cache directory")
find_package(Zephyr REQUIRED HINTS $ENV{ZEPHYR_BASE})
project(pebbleos_zephyr_notif)

get_filename_component(PEBBLEOS_ROOT "${CMAKE_CURRENT_SOURCE_DIR}/../.." ABSOLUTE)
set(GFX "${PEBBLEOS_ROOT}/src/fw/applib/graphics")

target_include_directories(app PRIVATE
  "${CMAKE_CURRENT_SOURCE_DIR}/include"
  "${PEBBLEOS_ROOT}/zephyr-port-apps/kernel/include"
  "${PEBBLEOS_ROOT}/zephyr-port-apps/gfx/include"
  "${PEBBLEOS_ROOT}/src/fw"
  "${PEBBLEOS_ROOT}/src/fw/applib/vendor/uPNG"
  "${PEBBLEOS_ROOT}/src/fw/applib/vendor/tinflate"
  "${PEBBLEOS_ROOT}/include"
  "${CMAKE_BINARY_DIR}/include/generated"
)

target_compile_definitions(app PRIVATE
  CONFIG_BOARD_OBELIX_PVT=1
  CONFIG_PLATFORM_EMERY=1
  CONFIG_SCREEN_COLOR_DEPTH_BITS=8
  CONFIG_SOC_SF32LB52=1
)

target_compile_options(app PRIVATE
  -include string.h
  -Wno-address-of-packed-member
)

target_sources(app PRIVATE
  src/main.c
  src/port.c
  src/render.c

  # PebbleOS notification card and its shared timeline/text-node machinery.
  "${PEBBLEOS_ROOT}/src/fw/services/timeline/item.c"
  "${PEBBLEOS_ROOT}/src/fw/services/timeline/attributes_actions.c"
  "${PEBBLEOS_ROOT}/src/fw/services/timeline/attribute_group.c"
  "${PEBBLEOS_ROOT}/src/fw/services/timeline/attribute.c"
  "${PEBBLEOS_ROOT}/src/fw/services/timeline/notification_layout.c"
  "${PEBBLEOS_ROOT}/src/fw/services/timeline/layout_layer.c"
  "${PEBBLEOS_ROOT}/src/fw/services/timeline/layout_node.c"
  "${PEBBLEOS_ROOT}/src/fw/services/timeline/timeline_layout.c"
  "${PEBBLEOS_ROOT}/src/fw/apps/system/timeline/text_node.c"

  # Real Pebble layer, framebuffer, graphics, and text implementations.
  "${PEBBLEOS_ROOT}/src/fw/applib/ui/layer.c"
  "${GFX}/8_bit/bitblt_private.c"
  "${GFX}/8_bit/framebuffer.c"
  "${GFX}/arabic_shaping.c"
  "${GFX}/bitblt.c"
  "${GFX}/framebuffer.c"
  "${GFX}/gbitmap.c"
  "${GFX}/gbitmap_png.c"
  "${GFX}/gcolor_definitions.c"
  "${GFX}/graphics.c"
  "${GFX}/graphics_bitmap.c"
  "${GFX}/graphics_circle.c"
  "${GFX}/graphics_line.c"
  "${GFX}/graphics_private.c"
  "${GFX}/graphics_private_raw.c"
  "${GFX}/gtransform.c"
  "${GFX}/gtypes.c"
  "${GFX}/gpath.c"
  "${GFX}/perimeter.c"
  "${GFX}/rtl_support.c"
  "${GFX}/text_layout.c"
  "${GFX}/text_render.c"
  "${GFX}/text_resources.c"
  "${GFX}/utf8.c"
  "${PEBBLEOS_ROOT}/src/fw/applib/vendor/uPNG/upng.c"
  "${PEBBLEOS_ROOT}/src/fw/applib/vendor/tinflate/tinflate.c"
  "${PEBBLEOS_ROOT}/src/fw/applib/fonts/codepoint.c"
  "${PEBBLEOS_ROOT}/lib/util/crc32.c"
  "${PEBBLEOS_ROOT}/lib/util/hash.c"
  "${PEBBLEOS_ROOT}/lib/util/keyed_circular_cache.c"
  "${PEBBLEOS_ROOT}/lib/util/iterator.c"
  "${PEBBLEOS_ROOT}/lib/util/trig.c"
  "${PEBBLEOS_ROOT}/lib/util/math.c"
)

generate_inc_file_for_target(app
  "${PEBBLEOS_ROOT}/resources/normal/base/pbf/GOTHIC_18.pbf"
  "${CMAKE_BINARY_DIR}/include/generated/notif_gothic_18.pbf.inc"
)

# Use PebbleOS's production generic-notification artwork. The firmware resource
# build normally converts this SVG to PDC; this standalone app converts it to a
# palette PNG so the same artwork can go through the real GBitmap path.
find_program(MAGICK_EXECUTABLE magick REQUIRED)
set(NOTIF_ICON_PNG "${CMAKE_CURRENT_BINARY_DIR}/notification_generic_25.png")
add_custom_command(
  OUTPUT "${NOTIF_ICON_PNG}"
  COMMAND "${MAGICK_EXECUTABLE}"
          "${PEBBLEOS_ROOT}/resources/normal/base/images/Pebble_25x25_Generic_notification.svg"
          -background none -resize 25x25 -type Palette "PNG8:${NOTIF_ICON_PNG}"
  DEPENDS
          "${PEBBLEOS_ROOT}/resources/normal/base/images/Pebble_25x25_Generic_notification.svg"
  VERBATIM
)
generate_inc_file_for_target(app
  "${NOTIF_ICON_PNG}"
  "${CMAKE_BINARY_DIR}/include/generated/notif_generic_icon.png.inc"
)
generate_inc_file_for_target(app
  "${PEBBLEOS_ROOT}/resources/normal/base/pbf/GOTHIC_24_BOLD.pbf"
  "${CMAKE_BINARY_DIR}/include/generated/notif_gothic_24_bold.pbf.inc"
)
generate_inc_file_for_target(app
  "${PEBBLEOS_ROOT}/resources/normal/base/pbf/GOTHIC_28.pbf"
  "${CMAKE_BINARY_DIR}/include/generated/notif_gothic_28.pbf.inc"
)
generate_inc_file_for_target(app
  "${PEBBLEOS_ROOT}/resources/normal/base/pbf/GOTHIC_28_BOLD.pbf"
  "${CMAKE_BINARY_DIR}/include/generated/notif_gothic_28_bold.pbf.inc"
)
```

## prj.conf
```kconfig
CONFIG_ASSERT=y
CONFIG_BOOT_BANNER=n
CONFIG_CONSOLE=y
CONFIG_DISPLAY=y
CONFIG_SF32LB_JDI=y
CONFIG_HEAP_MEM_POOL_SIZE=32768
CONFIG_LOG=y
CONFIG_LOG_DEFAULT_LEVEL=1
CONFIG_LOG_BUFFER_SIZE=256
CONFIG_LOG_PRINTK=n
CONFIG_DISPLAY_LOG_LEVEL_ERR=y
CONFIG_MAIN_STACK_SIZE=8192
CONFIG_PRINTK=y
CONFIG_SERIAL=y
CONFIG_UART_CONSOLE=y
```

## src/main.c
```c
/* SPDX-License-Identifier: Apache-2.0 */

#include "notif_render.h"

int main(void) {
  notif_render_demo();
  return 0;
}
```

## include/font_resource_keys.auto.h
```c
/* SPDX-License-Identifier: Apache-2.0 */
#pragma once

#define FONT_KEY_GOTHIC_14 "RESOURCE_ID_GOTHIC_14"
#define FONT_KEY_GOTHIC_14_BOLD "RESOURCE_ID_GOTHIC_14_BOLD"
#define FONT_KEY_GOTHIC_18 "RESOURCE_ID_GOTHIC_18"
#define FONT_KEY_GOTHIC_18_BOLD "RESOURCE_ID_GOTHIC_18_BOLD"
#define FONT_KEY_GOTHIC_24 "RESOURCE_ID_GOTHIC_24"
#define FONT_KEY_GOTHIC_24_BOLD "RESOURCE_ID_GOTHIC_24_BOLD"
#define FONT_KEY_GOTHIC_28 "RESOURCE_ID_GOTHIC_28"
#define FONT_KEY_GOTHIC_28_BOLD "RESOURCE_ID_GOTHIC_28_BOLD"
#define FONT_KEY_GOTHIC_36 "RESOURCE_ID_GOTHIC_36"
#define FONT_KEY_GOTHIC_36_BOLD "RESOURCE_ID_GOTHIC_36_BOLD"
#define FONT_KEY_LECO_20_BOLD_NUMBERS "RESOURCE_ID_LECO_20_BOLD_NUMBERS"
#define FONT_KEY_LECO_26_BOLD_NUMBERS_AM_PM "RESOURCE_ID_LECO_26_BOLD_NUMBERS_AM_PM"
```

## include/notif_port.h
```c
/* SPDX-License-Identifier: Apache-2.0 */
#pragma once

#include <stddef.h>
#include <stdint.h>

#include "applib/graphics/gcontext.h"

void notif_port_init(GContext *context, FrameBuffer *framebuffer);
void notif_port_fonts_init(void);
uint8_t *notif_port_framebuffer_bytes(size_t *size_out, uint16_t *stride_out);
```

## include/notif_render.h
```c
/* SPDX-License-Identifier: Apache-2.0 */
#pragma once

#include <stdint.h>

// Shared PebbleOS notification render path: build the notification card via the
// real layout_create -> layer_render_tree pipeline and push the framebuffer to
// the JDI panel. Used by the standalone notif app and folded into the BLE app so
// a live CoreApp notification lands on the same display.
//
// This header stays free of PebbleOS timeline types on purpose: callers live in
// the BLE include environment (main.c, ppog_min.c) which forcibly includes
// nimble/zephyr compat headers that clash with the pebble graphics headers.
// TimelineItem handling stays inside render.c (the notif include environment).

// Idempotent: framebuffer + graphics context + fonts + generic icon.
void notif_render_init(void);

// Render a hardcoded synthetic notification (Phase 1 bring-up: proves the render
// path draws a card without any live delivery). Left up indefinitely.
void notif_render_demo(void);

// Phase 2: parse a blob_db notification value (a serialized TimelineItem:
// SerializedTimelineItemHeader followed by its payload) and render it. Returns 0
// on success. Takes raw bytes so BLE-side callers need no pebble types.
int notif_render_blob_db_value(const uint8_t *value, uint16_t value_len);
```

## src/port.c
```c
/* SPDX-License-Identifier: Apache-2.0 */

#include <stdbool.h>
#include <stddef.h>
#include <stdint.h>
#include <stdio.h>
#include <string.h>

#define sign_extend zephyr_sign_extend
#include <zephyr/kernel.h>
#undef sign_extend
#include <zephyr/sys/printk.h>

#include "applib/fonts/fonts.h"
#include "applib/graphics/framebuffer.h"
#include "applib/graphics/gbitmap_png.h"
#include "applib/graphics/gcontext.h"
#include "applib/graphics/graphics.h"
#include "applib/graphics/text_resources.h"
#include "applib/preferred_content_size.h"
#include "applib/ui/kino/kino_layer.h"
#include "kernel/pebble_tasks.h"
#include "notif_port.h"
#include "pbl/services/blob_db/pin_db.h"
#include "pbl/services/notifications/alerts_preferences_private.h"
#include "pbl/services/notifications/notification_image.h"
#include "pbl/services/timeline/attribute.h"
#include "pbl/services/timeline/layout_layer.h"
#include "pbl/services/timeline/timeline_resources.h"
#include "util/stringlist.h"
#include "process_state/app_state/app_state.h"
#include "resource/resource.h"
#include "resource/resource_ids.auto.h"
#include "shell/system_theme.h"
#include "system/passert.h"

#define FONT_GOTHIC_18_RESOURCE 1U
#define FONT_GOTHIC_24_BOLD_RESOURCE 2U
#define FONT_GOTHIC_28_RESOURCE 3U
#define FONT_GOTHIC_28_BOLD_RESOURCE 4U

static const uint8_t s_gothic_18[] __aligned(4) = {
#include "notif_gothic_18.pbf.inc"
};
static const uint8_t s_gothic_24_bold[] __aligned(4) = {
#include "notif_gothic_24_bold.pbf.inc"
};
static const uint8_t s_gothic_28[] __aligned(4) = {
#include "notif_gothic_28.pbf.inc"
};
static const uint8_t s_gothic_28_bold[] __aligned(4) = {
#include "notif_gothic_28_bold.pbf.inc"
};
static const uint8_t s_generic_notification_icon_png[] __aligned(4) = {
#include "notif_generic_icon.png.inc"
};

typedef struct {
  TextRenderState text_render_state;
  Layer *layer_tree_stack[LAYER_TREE_STACK_SIZE];
} NotifAppState;

typedef struct {
  KinoReel base;
} NotifIconReel;

static GContext *s_context;
static FrameBuffer *s_framebuffer;
static FontInfo s_font_gothic_18;
static FontInfo s_font_gothic_24_bold;
static FontInfo s_font_gothic_28;
static FontInfo s_font_gothic_28_bold;
static GBitmap s_generic_notification_icon;
static NotifAppState s_app_state;
static Layer *s_kernel_layer_tree_stack[LAYER_TREE_STACK_SIZE];

static const uint8_t *prv_resource_data(uint32_t resource_id, size_t *size_out) {
  const uint8_t *data = NULL;
  size_t size = 0;
  switch (resource_id) {
    case FONT_GOTHIC_18_RESOURCE:
      data = s_gothic_18;
      size = sizeof(s_gothic_18);
      break;
    case FONT_GOTHIC_24_BOLD_RESOURCE:
      data = s_gothic_24_bold;
      size = sizeof(s_gothic_24_bold);
      break;
    case FONT_GOTHIC_28_RESOURCE:
      data = s_gothic_28;
      size = sizeof(s_gothic_28);
      break;
    case FONT_GOTHIC_28_BOLD_RESOURCE:
      data = s_gothic_28_bold;
      size = sizeof(s_gothic_28_bold);
      break;
    default:
      break;
  }
  if (size_out) {
    *size_out = size;
  }
  return data;
}

void notif_port_init(GContext *context, FrameBuffer *framebuffer) {
  s_context = context;
  s_framebuffer = framebuffer;
  if (!gbitmap_init_with_png_data(&s_generic_notification_icon,
                                  s_generic_notification_icon_png,
                                  sizeof(s_generic_notification_icon_png))) {
    printk("NOTIF_ICON_FAIL\n");
    k_panic();
  }
}

void notif_port_fonts_init(void) {
  if (!text_resources_init_font(SYSTEM_APP, FONT_GOTHIC_18_RESOURCE, 0, &s_font_gothic_18) ||
      !text_resources_init_font(SYSTEM_APP, FONT_GOTHIC_24_BOLD_RESOURCE, 0,
                                &s_font_gothic_24_bold) ||
      !text_resources_init_font(SYSTEM_APP, FONT_GOTHIC_28_RESOURCE, 0, &s_font_gothic_28) ||
      !text_resources_init_font(SYSTEM_APP, FONT_GOTHIC_28_BOLD_RESOURCE, 0,
                                &s_font_gothic_28_bold)) {
    printk("NOTIF_FONT_FAIL\n");
    k_panic();
  }
}

uint8_t *notif_port_framebuffer_bytes(size_t *size_out, uint16_t *stride_out) {
  if (size_out) {
    *size_out = framebuffer_get_size_bytes(s_framebuffer);
  }
  if (stride_out) {
    *stride_out = PBL_DISPLAY_WIDTH;
  }
  return s_framebuffer->buffer;
}

void *applib_malloc(size_t size) {
  return k_malloc(size);
}

void *applib_zalloc(size_t size) {
  return k_calloc(1, size);
}

void applib_free(void *ptr) {
  k_free(ptr);
}

void *task_malloc(size_t size) {
  return applib_malloc(size);
}

void *task_malloc_check(size_t size) {
  void *ptr = task_malloc(size);
  PBL_ASSERTN(ptr);
  return ptr;
}

// Timeline deserialize only calls this for all-day/floating items; notification
// cards are neither, so an identity pass-through is correct here.
time_t time_local_to_utc(time_t local_time) {
  return local_time;
}

void *task_zalloc(size_t size) {
  return applib_zalloc(size);
}

void *task_zalloc_check(size_t size) {
  void *ptr = task_zalloc(size);
  PBL_ASSERTN(ptr);
  return ptr;
}

void task_free(void *ptr) {
  applib_free(ptr);
}

void *kernel_zalloc(size_t size) {
  return k_calloc(1, size);
}

void *kernel_zalloc_check(size_t size) {
  void *ptr = kernel_zalloc(size);
  PBL_ASSERTN(ptr);
  return ptr;
}

void *kernel_realloc(void *ptr, size_t size) {
  return k_realloc(ptr, size);
}

void kernel_free(void *ptr) {
  k_free(ptr);
}

GContext *app_state_get_graphics_context(void) {
  return s_context;
}

GContext *kernel_ui_get_graphics_context(void) {
  return s_context;
}

GContext *graphics_context_get_current_context(void) {
  return s_context;
}

TextRenderState *app_state_get_text_render_state(void) {
  return &s_app_state.text_render_state;
}

bool app_state_get_text_perimeter_debugging_enabled(void) {
  return false;
}

void app_state_set_text_perimeter_debugging_enabled(bool enabled) {
  ARG_UNUSED(enabled);
}

GBitmap *app_state_legacy2_get_2bit_framebuffer(void) {
  return NULL;
}

Heap *app_state_get_heap(void) {
  return NULL;
}

bool heap_is_allocated(Heap *heap, void *ptr) {
  ARG_UNUSED(heap);
  ARG_UNUSED(ptr);
  return false;
}

Layer **app_state_get_layer_tree_stack(void) {
  return s_app_state.layer_tree_stack;
}

Layer **kernel_applib_get_layer_tree_stack(void) {
  return s_kernel_layer_tree_stack;
}

bool process_manager_compiled_with_legacy2_sdk(void) {
  return false;
}

PebbleTask pebble_task_get_current(void) {
  return PebbleTask_KernelMain;
}

void window_schedule_render(struct Window *window) {
  ARG_UNUSED(window);
}

bool sys_resource_is_valid(ResAppNum app_num, uint32_t resource_id) {
  return app_num == SYSTEM_APP && prv_resource_data(resource_id, NULL) != NULL;
}

size_t sys_resource_size(ResAppNum app_num, uint32_t resource_id) {
  size_t size = 0;
  if (app_num == SYSTEM_APP) {
    prv_resource_data(resource_id, &size);
  }
  return size;
}

size_t sys_resource_load_range(ResAppNum app_num, uint32_t resource_id, uint32_t start_bytes,
                               uint8_t *buffer, size_t num_bytes) {
  size_t size;
  const uint8_t *data = app_num == SYSTEM_APP ? prv_resource_data(resource_id, &size) : NULL;
  if (!data || start_bytes >= size) {
    return 0;
  }
  const size_t copy_size = MIN(num_bytes, size - start_bytes);
  memcpy(buffer, data + start_bytes, copy_size);
  return copy_size;
}

uint32_t sys_resource_get_and_cache(ResAppNum app_num, uint32_t resource_id) {
  return sys_resource_is_valid(app_num, resource_id) ? resource_id : 0;
}

const uint8_t *sys_resource_read_only_bytes(ResAppNum app_num, uint32_t resource_id,
                                            size_t *num_bytes_out) {
  return app_num == SYSTEM_APP ? prv_resource_data(resource_id, num_bytes_out) : NULL;
}

bool sys_resource_bytes_are_readonly(void *bytes) {
  ARG_UNUSED(bytes);
  return true;
}

ResAppNum sys_get_current_resource_num(void) {
  return SYSTEM_APP;
}

ResourceCallbackHandle resource_watch(ResAppNum app_num, uint32_t resource_id,
                                      ResourceChangedCallback callback, void *data) {
  ARG_UNUSED(app_num);
  ARG_UNUSED(resource_id);
  ARG_UNUSED(callback);
  ARG_UNUSED(data);
  return NULL;
}

bool applib_resource_track_mmapped(const void *bytes) {
  ARG_UNUSED(bytes);
  return false;
}

bool applib_resource_is_mmapped(const void *bytes) {
  ARG_UNUSED(bytes);
  return false;
}

bool applib_resource_munmap(const void *bytes) {
  ARG_UNUSED(bytes);
  return false;
}

void *applib_resource_mmap_or_load(ResAppNum app_num, uint32_t resource_id, size_t offset,
                                   size_t length, bool use_aligned) {
  ARG_UNUSED(use_aligned);
  size_t size;
  const uint8_t *data = app_num == SYSTEM_APP ? prv_resource_data(resource_id, &size) : NULL;
  if (!data || offset > size || length > size - offset) {
    return NULL;
  }
  return (void *)(data + offset);
}

void applib_resource_munmap_or_free(void *bytes) {
  ARG_UNUSED(bytes);
}

GFont fonts_get_system_font(const char *font_key) {
  if (!strcmp(font_key, FONT_KEY_GOTHIC_24_BOLD)) {
    return &s_font_gothic_24_bold;
  }
  if (!strcmp(font_key, FONT_KEY_GOTHIC_28_BOLD)) {
    return &s_font_gothic_28_bold;
  }
  if (!strcmp(font_key, FONT_KEY_GOTHIC_28)) {
    return &s_font_gothic_28;
  }
  return &s_font_gothic_18;
}

GFont sys_font_get_system_font(const char *font_key) {
  return fonts_get_system_font(font_key);
}

void sys_font_reload_font(FontInfo *font_info) {
  ARG_UNUSED(font_info);
}

FontInfo *fonts_get_system_emoji_font_for_size(unsigned int font_height) {
  ARG_UNUSED(font_height);
  return NULL;
}

uint8_t fonts_get_font_height(GFont font) {
  return font ? font->max_height : 0;
}

int16_t fonts_get_font_cap_offset(GFont font) {
  return font ? (int16_t)((int16_t)font->max_height * 22 / 100) : 0;
}

const char *system_theme_get_font_key(TextStyleFont font) {
  switch (font) {
    case TextStyleFont_Header:
      return FONT_KEY_GOTHIC_24_BOLD;
    case TextStyleFont_Title:
      return FONT_KEY_GOTHIC_28_BOLD;
    case TextStyleFont_Body:
    case TextStyleFont_Subtitle:
      return FONT_KEY_GOTHIC_28;
    case TextStyleFont_Caption:
    case TextStyleFont_Footer:
    default:
      return FONT_KEY_GOTHIC_18;
  }
}

const char *system_theme_get_font_key_for_size(PreferredContentSize size, TextStyleFont font) {
  ARG_UNUSED(size);
  return system_theme_get_font_key(font);
}

PreferredContentSize system_theme_get_content_size(void) {
  return PreferredContentSizeLarge;
}

PreferredContentSize system_theme_get_default_content_size_for_runtime_platform(void) {
  return PreferredContentSizeLarge;
}

PreferredContentSize system_theme_convert_host_content_size_to_runtime_platform(
    PreferredContentSize size) {
  return size;
}

PreferredContentSize preferred_content_size(void) {
  return PreferredContentSizeLarge;
}

// attribute_find / attribute_get_* now come from the real attribute.c that the
// live-notification deserialize path pulls in; the former port stubs would
// collide with them.

size_t string_list_count(StringList *list) {
  ARG_UNUSED(list);
  return 0;
}

char *string_list_get_at(StringList *list, size_t index) {
  ARG_UNUSED(list);
  ARG_UNUSED(index);
  return NULL;
}

const char *i18n_get(const char *string, const void *owner) {
  ARG_UNUSED(owner);
  return string;
}

void i18n_free(const char *string, const void *owner) {
  ARG_UNUSED(string);
  ARG_UNUSED(owner);
}

void i18n_free_all(const void *owner) {
  ARG_UNUSED(owner);
}

char *string_strip_leading_whitespace(char *str) {
  while (*str == ' ') {
    ++str;
  }
  return str;
}

void clock_get_since_time(char *buffer, int buf_size, time_t timestamp) {
  ARG_UNUSED(timestamp);
  snprintf(buffer, buf_size, "Now");
}

void clock_get_until_time(char *buffer, int buf_size, time_t timestamp, int max_relative_hrs) {
  ARG_UNUSED(timestamp);
  ARG_UNUSED(max_relative_hrs);
  snprintf(buffer, buf_size, "Now");
}

status_t pin_db_get(const TimelineItemId *id, TimelineItem *pin) {
  ARG_UNUSED(id);
  ARG_UNUSED(pin);
  return -1;
}

// timeline_item_free_allocated_buffer now comes from the real item.c.

bool alerts_preferences_get_notification_alternative_design(void) {
  return false;
}

NotificationStatusBarStyle alerts_preferences_get_notification_status_bar_style(void) {
  return NotificationStatusBarStyle_Default;
}

const GBitmap *notification_image_lock(const Uuid *item_id) {
  ARG_UNUSED(item_id);
  return NULL;
}

void notification_image_unlock(void) {}

bool notification_image_is_pending(const Uuid *item_id) {
  ARG_UNUSED(item_id);
  return false;
}

bool timeline_resources_is_system(TimelineResourceId timeline_id) {
  return (timeline_id & SYSTEM_RESOURCE_FLAG) != 0;
}

void timeline_resources_get_id(const TimelineResourceInfo *timeline_res, TimelineResourceSize size,
                               AppResourceInfo *res_info_out) {
  ARG_UNUSED(timeline_res);
  ARG_UNUSED(size);
  *res_info_out = (AppResourceInfo) {
      .res_app_num = SYSTEM_APP,
      .res_id = RESOURCE_ID_NOTIFICATION_GENERIC_TINY,
  };
}

static void prv_icon_update_proc(Layer *layer, GContext *ctx) {
  GRect destination = s_generic_notification_icon.bounds;
  grect_align(&destination, &layer->bounds, GAlignCenter, false);
  graphics_context_set_compositing_mode(ctx, GCompOpSet);
  graphics_draw_bitmap_in_rect(ctx, &s_generic_notification_icon, &destination);
}

KinoReel *kino_reel_create_with_resource_system(ResAppNum app_num, uint32_t resource_id) {
  ARG_UNUSED(app_num);
  ARG_UNUSED(resource_id);
  return task_zalloc(sizeof(NotifIconReel));
}

void kino_reel_destroy(KinoReel *reel) {
  task_free(reel);
}

GSize kino_reel_get_size(KinoReel *reel) {
  return reel ? GSize(25, 25) : GSizeZero;
}

void kino_layer_init(KinoLayer *kino_layer, const GRect *frame) {
  *kino_layer = (KinoLayer) {};
  layer_init(&kino_layer->layer, frame);
  layer_set_update_proc(&kino_layer->layer, prv_icon_update_proc);
  kino_layer->alignment = GAlignCenter;
}

void kino_layer_deinit(KinoLayer *kino_layer) {
  if (kino_layer->player.reel && kino_layer->player.owns_reel) {
    kino_reel_destroy(kino_layer->player.reel);
  }
  layer_deinit(&kino_layer->layer);
}

KinoLayer *kino_layer_create(GRect frame) {
  KinoLayer *layer = task_zalloc(sizeof(*layer));
  if (layer) {
    kino_layer_init(layer, &frame);
  }
  return layer;
}

void kino_layer_destroy(KinoLayer *kino_layer) {
  if (kino_layer) {
    kino_layer_deinit(kino_layer);
    task_free(kino_layer);
  }
}

Layer *kino_layer_get_layer(KinoLayer *kino_layer) {
  return kino_layer ? &kino_layer->layer : NULL;
}

void kino_layer_set_reel(KinoLayer *kino_layer, KinoReel *reel, bool take_ownership) {
  kino_layer->player.reel = reel;
  kino_layer->player.owns_reel = take_ownership;
}

void kino_layer_set_reel_with_resource_system(KinoLayer *kino_layer, ResAppNum app_num,
                                              uint32_t resource_id, bool invert) {
  ARG_UNUSED(invert);
  kino_layer_set_reel(kino_layer, kino_reel_create_with_resource_system(app_num, resource_id),
                      true);
}

void kino_layer_set_alignment(KinoLayer *kino_layer, GAlign alignment) {
  kino_layer->alignment = alignment;
}

GAlign kino_layer_get_alignment(KinoLayer *kino_layer) {
  return kino_layer->alignment;
}

void kino_layer_play(KinoLayer *kino_layer) {
  ARG_UNUSED(kino_layer);
}

LayoutLayer *generic_layout_create(const LayoutLayerConfig *config) {
  ARG_UNUSED(config);
  return NULL;
}

bool generic_layout_verify(bool existing_attributes[]) {
  ARG_UNUSED(existing_attributes);
  return false;
}

LayoutLayer *calendar_layout_create(const LayoutLayerConfig *config) {
  ARG_UNUSED(config);
  return NULL;
}

bool calendar_layout_verify(bool existing_attributes[]) {
  ARG_UNUSED(existing_attributes);
  return false;
}

LayoutLayer *alarm_layout_create(const LayoutLayerConfig *config) {
  ARG_UNUSED(config);
  return NULL;
}

bool alarm_layout_verify(bool existing_attributes[]) {
  ARG_UNUSED(existing_attributes);
  return false;
}

LayoutLayer *health_layout_create(const LayoutLayerConfig *config) {
  ARG_UNUSED(config);
  return NULL;
}

bool health_layout_verify(bool existing_attributes[]) {
  ARG_UNUSED(existing_attributes);
  return false;
}

LayoutLayer *sports_layout_create(const LayoutLayerConfig *config) {
  ARG_UNUSED(config);
  return NULL;
}

bool sports_layout_verify(bool existing_attributes[]) {
  ARG_UNUSED(existing_attributes);
  return false;
}

LayoutLayer *weather_layout_create(const LayoutLayerConfig *config) {
  ARG_UNUSED(config);
  return NULL;
}

bool weather_layout_verify(bool existing_attributes[]) {
  ARG_UNUSED(existing_attributes);
  return false;
}

NORETURN passert_failed(const char *filename, int line_number, const char *message, ...) {
  printk("NOTIF_ASSERT %s:%d %s\n", filename, line_number, message ? message : "");
  k_panic();
  CODE_UNREACHABLE;
}

NORETURN passert_failed_no_message(const char *filename, int line_number) {
  printk("NOTIF_ASSERT %s:%d\n", filename, line_number);
  k_panic();
  CODE_UNREACHABLE;
}

NORETURN passert_failed_no_message_with_lr(const char *filename, int line_number, uint32_t lr) {
  printk("NOTIF_ASSERT %s:%d lr=%08x\n", filename, line_number, lr);
  k_panic();
  CODE_UNREACHABLE;
}

NORETURN wtf(void) {
  printk("NOTIF_ASSERT WTF\n");
  k_panic();
  CODE_UNREACHABLE;
}

NORETURN util_assertion_failed(const char *filename, int line) {
  printk("NOTIF_ASSERT %s:%d\n", filename, line);
  k_panic();
  CODE_UNREACHABLE;
}
```

## src/render.c
```c
/* SPDX-License-Identifier: Apache-2.0 */

#include <errno.h>
#include <inttypes.h>
#include <stdbool.h>
#include <stddef.h>
#include <stdint.h>

#define display_clear zephyr_display_clear
#define sign_extend zephyr_sign_extend
#include <zephyr/device.h>
#include <zephyr/drivers/display.h>
#include <zephyr/sys/printk.h>
#undef sign_extend
#undef display_clear

#include "applib/graphics/framebuffer.h"
#include "applib/graphics/gcontext.h"
#include "applib/graphics/graphics.h"
#include "applib/ui/layer.h"
#include "notif_port.h"
#include "notif_render.h"
#include "pbl/services/timeline/attribute.h"
#include "pbl/services/timeline/item.h"
#include "pbl/services/timeline/layout_layer.h"
#include "pbl/services/timeline/notification_layout.h"
#include "pbl/services/timeline/timeline_resources.h"
#include "pbl/util/crc32.h"

static FrameBuffer s_framebuffer;
static GContext s_context;
static bool s_inited;

_Static_assert(PBL_DISPLAY_WIDTH == 200 && PBL_DISPLAY_HEIGHT == 228,
               "pt2 notification framebuffer must be 200x228");

static int notif_render_item(TimelineItem *item);

static void prv_background_update_proc(Layer *layer, GContext *ctx) {
  graphics_context_set_fill_color(ctx, GColorWhite);
  graphics_fill_rect(ctx, &layer->bounds);
}

void notif_render_init(void) {
  if (s_inited) {
    return;
  }
  const GSize display_size = GSize(PBL_DISPLAY_WIDTH, PBL_DISPLAY_HEIGHT);
  framebuffer_init(&s_framebuffer, &display_size);
  graphics_context_init(&s_context, &s_framebuffer, GContextInitializationMode_System);
  notif_port_init(&s_context, &s_framebuffer);
  notif_port_fonts_init();
  s_inited = true;
}

static int notif_render_item(TimelineItem *item) {
  notif_render_init();

  static Layer root;
  const GRect frame = GRect(0, 0, PBL_DISPLAY_WIDTH, PBL_DISPLAY_HEIGHT);
  layer_init(&root, &frame);
  layer_set_update_proc(&root, prv_background_update_proc);

  NotificationLayoutInfo layout_info = {
      .item = item,
      .show_notification_timestamp = true,
  };
  const Uuid app_id = UUID_INVALID;
  const LayoutLayerConfig config = {
      .frame = &frame,
      .attributes = &item->attr_list,
      .mode = LayoutLayerModeCard,
      .app_id = &app_id,
      .context = &layout_info,
  };
  LayoutLayer *notification = layout_create(item->header.layout, &config);
  if (!notification) {
    printk("NOTIF_RENDER_FAIL\n");
    return -ENOMEM;
  }
  layer_add_child(&root, &notification->layer);
  layer_render_tree(&root, &s_context);
  printk("NOTIF_RENDER_OK\n");

  size_t framebuffer_size;
  uint16_t framebuffer_stride;
  uint8_t *framebuffer = notif_port_framebuffer_bytes(&framebuffer_size, &framebuffer_stride);
  const uint32_t frame_crc = crc32(CRC32_INIT, framebuffer, framebuffer_size);
  printk("NOTIF_FRAME 0x%08" PRIx32 "\n", frame_crc);

  const struct device *display = DEVICE_DT_GET(DT_CHOSEN(zephyr_display));
  if (!device_is_ready(display)) {
    printk("NOTIF_PUSH_FAIL %d\n", -ENODEV);
    return -ENODEV;
  }
  int ret = display_blanking_off(display);
  if (ret != 0) {
    printk("NOTIF_PUSH_FAIL %d\n", ret);
    return ret;
  }
  const struct display_buffer_descriptor desc = {
      .buf_size = framebuffer_size,
      .width = framebuffer_stride,
      .height = framebuffer_size / framebuffer_stride,
      .pitch = framebuffer_stride,
  };
  // The JDI scan orientation already matches Pebble's native framebuffer.
  ret = display_write(display, 0U, 0U, &desc, framebuffer);
  if (ret != 0) {
    printk("NOTIF_PUSH_FAIL %d\n", ret);
    return ret;
  }
  printk("NOTIF_PUSH_OK\n");
  // Pixels are latched in the framebuffer and the panel; the layout tree (and
  // any strings it referenced) is no longer needed and can be torn down so
  // repeated renders (live blob_db notifications) don't leak.
  layout_destroy(notification);
  return 0;
}

// Phase 2: a live CoreApp notification arrives as a blob_db INSERT whose value
// is a serialized TimelineItem (SerializedTimelineItemHeader + payload). Parse
// it with the real firmware deserializer and render it through the same card
// path as the demo. Raw bytes in, so the BLE-side caller needs no pebble types.
// Wire layout of the serialized TimelineItem header inside a blob_db value.
// This is the canonical PebbleOS on-wire format, which uses a 4-byte timestamp.
// It must be parsed by fixed offset, NOT by casting to SerializedTimelineItemHeader:
// this port's time_t is 8 bytes, so the C struct is 4 bytes larger than the wire
// and every field past the timestamp would be misread.
#define WIRE_OFF_ID          0   // Uuid, 16 bytes
#define WIRE_OFF_PARENT      16  // Uuid, 16 bytes
#define WIRE_OFF_TIMESTAMP   32  // uint32 LE
#define WIRE_OFF_DURATION    36  // uint16 LE
#define WIRE_OFF_TYPE        38  // uint8
#define WIRE_OFF_FLAGS       39  // uint8
#define WIRE_OFF_STATUS      40  // uint8
#define WIRE_OFF_LAYOUT      41  // uint8
#define WIRE_OFF_PAYLOAD_LEN 42  // uint16 LE
#define WIRE_OFF_NUM_ATTR    44  // uint8
#define WIRE_OFF_NUM_ACTIONS 45  // uint8
#define WIRE_HDR_SIZE        46

static uint16_t prv_rd16(const uint8_t *p) { return (uint16_t)(p[0] | (p[1] << 8)); }
static uint32_t prv_rd32(const uint8_t *p) {
  return (uint32_t)(p[0] | (p[1] << 8) | (p[2] << 16) | (p[3] << 24));
}

int notif_render_blob_db_value(const uint8_t *value, uint16_t value_len) {
  if (value_len < WIRE_HDR_SIZE) {
    printk("NOTIF_BLOB_SHORT len=%u\n", (unsigned)value_len);
    return -EINVAL;
  }
  const uint16_t payload_length = prv_rd16(value + WIRE_OFF_PAYLOAD_LEN);
  if ((uint32_t)WIRE_HDR_SIZE + payload_length > value_len) {
    printk("NOTIF_BLOB_BADLEN payload=%u val=%u\n", (unsigned)payload_length,
           (unsigned)value_len);
    return -EINVAL;
  }

  // Rebuild the header into this build's native struct so the shared firmware
  // deserializer reads correct field values regardless of time_t width.
  SerializedTimelineItemHeader header;
  memset(&header, 0, sizeof(header));
  memcpy(&header.common.id, value + WIRE_OFF_ID, sizeof(Uuid));
  memcpy(&header.common.parent_id, value + WIRE_OFF_PARENT, sizeof(Uuid));
  header.common.timestamp = (time_t)prv_rd32(value + WIRE_OFF_TIMESTAMP);
  header.common.duration = prv_rd16(value + WIRE_OFF_DURATION);
  header.common.type = value[WIRE_OFF_TYPE];
  header.common.flags = value[WIRE_OFF_FLAGS];
  header.common.status = value[WIRE_OFF_STATUS];
  header.common.layout = value[WIRE_OFF_LAYOUT];
  header.payload_length = payload_length;
  header.num_attributes = value[WIRE_OFF_NUM_ATTR];
  header.num_actions = value[WIRE_OFF_NUM_ACTIONS];
  const uint8_t *payload = value + WIRE_HDR_SIZE;

  printk("NOTIF_BLOB attrs=%u actions=%u payload=%u\n",
         (unsigned)header.num_attributes, (unsigned)header.num_actions,
         (unsigned)header.payload_length);

  TimelineItem item;
  if (!timeline_item_deserialize_item(&item, &header, payload)) {
    printk("NOTIF_BLOB_DESERIALIZE_FAIL\n");
    return -EINVAL;
  }
  // A notification card is always the notification layout regardless of what the
  // wire header carried.
  item.header.layout = LayoutIdNotification;
  int ret = notif_render_item(&item);
  timeline_item_free_allocated_buffer(&item);
  return ret;
}

void notif_render_demo(void) {
  static char s_app_name[] = "CoreApp";
  static char s_title[] = "Core Devices";
  static char s_body[] = "Hello from CoreApp over BLE";
  static Attribute s_attributes[] = {
      { .id = AttributeIdAppName, .cstring = s_app_name },
      { .id = AttributeIdSender, .cstring = s_app_name },
      { .id = AttributeIdTitle, .cstring = s_title },
      { .id = AttributeIdBody, .cstring = s_body },
      { .id = AttributeIdIconTiny, .uint32 = TIMELINE_RESOURCE_NOTIFICATION_GENERIC },
  };
  static TimelineItem s_item = {
      .header = {
          .timestamp = 1787587200,
          .type = TimelineItemTypeNotification,
          .visible = true,
          .layout = LayoutIdNotification,
      },
      .attr_list = {
          .num_attributes = ARRAY_SIZE(s_attributes),
          .attributes = s_attributes,
      },
  };
  notif_render_item(&s_item);
}
```
