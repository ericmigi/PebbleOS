## CMakeLists.txt
```
# SPDX-License-Identifier: Apache-2.0

cmake_minimum_required(VERSION 3.20.0)

set(USER_CACHE_DIR "${CMAKE_BINARY_DIR}/.cache" CACHE PATH "Zephyr cache directory")
find_package(Zephyr REQUIRED HINTS $ENV{ZEPHYR_BASE})
project(pebbleos_zephyr_ble)

# The SiFli system-config source declares a battery calibration temporary only
# used by an optional vendor configuration path.
zephyr_compile_options(-Wno-unused-variable)

get_filename_component(PEBBLEOS_ROOT "${CMAKE_CURRENT_SOURCE_DIR}/../.." ABSOLUTE)
set(NIMBLE "${PEBBLEOS_ROOT}/third_party/nimble")
set(MYNEWT_NIMBLE "${NIMBLE}/mynewt-nimble")
set(SIFLI "${PEBBLEOS_ROOT}/third_party/hal_sifli")
set(SIFLI_SDK "${SIFLI}/SiFli-SDK")
set(MBEDTLS "${PEBBLEOS_ROOT}/third_party/mbedtls")

target_include_directories(app BEFORE PRIVATE
  "${CMAKE_CURRENT_SOURCE_DIR}/include"
  "${NIMBLE}/port/include/sf32lb52"
  "${NIMBLE}/port/include"
  "${MYNEWT_NIMBLE}/nimble/include"
  "${MYNEWT_NIMBLE}/nimble/host/include"
  "${MYNEWT_NIMBLE}/nimble/host/services/bas/include"
  "${MYNEWT_NIMBLE}/nimble/host/services/dis/include"
  "${MYNEWT_NIMBLE}/nimble/host/services/gap/include"
  "${MYNEWT_NIMBLE}/nimble/host/services/gatt/include"
  "${MYNEWT_NIMBLE}/nimble/host/util/include"
  "${MYNEWT_NIMBLE}/nimble/transport/include"
  "${MYNEWT_NIMBLE}/nimble/transport/common/hci_h4/include"
  "${MYNEWT_NIMBLE}/porting/nimble/include"
  "${MBEDTLS}/include"
  "${MBEDTLS}/mbedtls/include"
  "${MBEDTLS}/mbedtls/library"
  "${PEBBLEOS_ROOT}/include"
  "${PEBBLEOS_ROOT}/include/pbl"
  "${PEBBLEOS_ROOT}/src/fw"
  "${SIFLI_SDK}/middleware/ipc_queue/porting/os/zephyr"
  "${SIFLI}/sf32lb52"
  "${SIFLI_SDK}/customer/boards/include"
  "${SIFLI_SDK}/drivers/Include"
  "${SIFLI_SDK}/drivers/cmsis/Include"
  "${SIFLI_SDK}/drivers/cmsis/sf32lb52x"
  "${SIFLI_SDK}/external/CMSIS/Include"
  "${SIFLI_SDK}/middleware/include"
  "${SIFLI_SDK}/middleware/ipc_queue/common"
  "${SIFLI_SDK}/middleware/ipc_queue/include"
  "${SIFLI_SDK}/middleware/ipc_queue/porting/sf32lb52x/hcpu"
)

# Appended last so it stays lower precedence than ble/include for the NimBLE
# sources; lets main.c resolve notif_render.h (which the render sources override
# via per-source -I below).
target_include_directories(app PRIVATE
  "${CMAKE_CURRENT_SOURCE_DIR}/../notif/include"
)

target_compile_definitions(app PRIVATE
  CONFIG_BOARD_OBELIX_PVT=1
  CONFIG_BOARD_OBELIX=1
  CONFIG_BT_LOG_LEVEL=3
  CONFIG_SOC_SF32LB52=1
  # Folded-in notification render path: select the Emery (pt2) 200x228x8 panel.
  CONFIG_PLATFORM_EMERY=1
  CONFIG_SCREEN_COLOR_DEPTH_BITS=8
  LXT_DISABLE
  MBEDTLS_CONFIG_FILE="pebble_mbedtls_config.h"
  NIMBLE_CFG_CONTROLLER=0
  PEBBLE_BLE_BRINGUP_APP=1
  SF32LB52X_REV_AUTO
  USE_HAL_DRIVER
)

target_compile_options(app PRIVATE
  -Wno-address-of-packed-member
  -Wno-old-style-declaration
  -Wno-pointer-arith
  -Wno-sign-compare
  -Wno-unused-function
  -Wno-unused-variable
)

file(GLOB NIMBLE_PORT_SOURCES
  "${MYNEWT_NIMBLE}/porting/nimble/src/*.c"
  "${MYNEWT_NIMBLE}/nimble/src/*.c"
  "${MYNEWT_NIMBLE}/nimble/host/src/*.c"
  "${MYNEWT_NIMBLE}/nimble/host/util/src/*.c"
  "${MYNEWT_NIMBLE}/nimble/host/services/bas/src/*.c"
  "${MYNEWT_NIMBLE}/nimble/host/services/dis/src/*.c"
  "${MYNEWT_NIMBLE}/nimble/host/services/gap/src/*.c"
  "${MYNEWT_NIMBLE}/nimble/host/services/gatt/src/*.c"
  "${MYNEWT_NIMBLE}/nimble/transport/src/*.c"
  "${MYNEWT_NIMBLE}/nimble/transport/common/hci_h4/src/*.c"
)
file(GLOB MBEDTLS_SOURCES "${MBEDTLS}/mbedtls/library/*.c")
list(REMOVE_ITEM NIMBLE_PORT_SOURCES
  "${MYNEWT_NIMBLE}/porting/nimble/src/hal_timer.c"
  "${MYNEWT_NIMBLE}/nimble/host/src/ble_gatts_lcl.c"
)

set_source_files_properties(
  ${NIMBLE_PORT_SOURCES}
  src/main.c
  "${NIMBLE}/port/src/npl_os_zephyr.c"
  "${PEBBLEOS_ROOT}/src/bluetooth-fw/nimble/advert.c"
  "${PEBBLEOS_ROOT}/src/bluetooth-fw/nimble/id.c"
  PROPERTIES COMPILE_OPTIONS
    "-include;${CMAKE_CURRENT_SOURCE_DIR}/include/nimble_zephyr_compat.h;-Wno-pointer-arith"
)

set_property(SOURCE
  "${MYNEWT_NIMBLE}/nimble/host/src/ble_uuid.c"
  APPEND PROPERTY COMPILE_OPTIONS
    "-include;${CMAKE_CURRENT_SOURCE_DIR}/include/ble_uuid_zephyr_compat.h"
)

target_sources(app PRIVATE
  src/main.c
  src/mbedtls_alloc.c
  src/ppog_min.c
  src/putbytes_min.c
  src/ram_store.c
  src/sifli_lrc_glue.c
  # Real PebbleOS legacy commit checksum (self-contained, no fw deps).
  "${PEBBLEOS_ROOT}/src/fw/util/legacy_checksum.c"
  "${PEBBLEOS_ROOT}/lib/os/mutex_zephyr.c"
  "${PEBBLEOS_ROOT}/lib/os/platform_zephyr.c"
  "${PEBBLEOS_ROOT}/lib/os/semaphore_zephyr.c"
  "${PEBBLEOS_ROOT}/lib/os/tick_zephyr.c"
  "${NIMBLE}/port/src/npl_os_zephyr.c"
  "${NIMBLE}/transport/hci_sf32lb52.c"
  "${PEBBLEOS_ROOT}/src/bluetooth-fw/nimble/advert.c"
  "${PEBBLEOS_ROOT}/src/bluetooth-fw/nimble/id.c"
  "${PEBBLEOS_ROOT}/src/bluetooth-fw/nimble/pebble_pairing_service.c"
  "${PEBBLEOS_ROOT}/src/bluetooth-fw/nimble/ppog_reversed_service.c"
  "${PEBBLEOS_ROOT}/src/bluetooth-fw/nimble/nimble_type_conversions.c"
  ${NIMBLE_PORT_SOURCES}
  ${MBEDTLS_SOURCES}

  "${SIFLI_SDK}/drivers/hal/bf0_hal_lcpu_config.c"
  "${SIFLI_SDK}/drivers/hal/bf0_hal_lrc_cal.c"
  "${SIFLI_SDK}/drivers/hal/bf0_hal_lpaon.c"
  "${SIFLI_SDK}/drivers/cmsis/sf32lb52x/bf0_lcpu_init.c"
  "${SIFLI_SDK}/drivers/cmsis/sf32lb52x/bt_rf_fulcal.c"
  "${SIFLI_SDK}/drivers/cmsis/sf32lb52x/lcpu_config_type.c"
  "${SIFLI_SDK}/drivers/cmsis/sf32lb52x/lcpu_patch.c"
  "${PEBBLEOS_ROOT}/third_party/nonfree/pebbleos-nonfree/sf32lb52/lcpu_52x.c"
  "${PEBBLEOS_ROOT}/third_party/nonfree/pebbleos-nonfree/sf32lb52/lcpu_patch_rev_b.c"
  "${SIFLI}/sf32lb52/lcpu_config.c"
  "${SIFLI_SDK}/middleware/ipc_queue/common/circular_buf.c"
  "${SIFLI_SDK}/middleware/ipc_queue/common/ipc_hw.c"
  "${SIFLI_SDK}/middleware/ipc_queue/common/ipc_queue.c"
  "${SIFLI_SDK}/middleware/ipc_queue/porting/sf32lb52x/hcpu/ipc_hw_port.c"
)

# ---------------------------------------------------------------------------
# Folded-in PebbleOS notification render path (shared with zephyr-port-apps/notif).
# These sources need the notif app's include environment, not the BLE one: notif's
# shim headers (kernel/pbl_malloc.h function decls, util/time/time.h, etc.) must
# win over repo include/, src/fw and ble/include. In the app target the BLE
# include dirs are searched first and per-source COMPILE_OPTIONS "-I" land AFTER
# them, so the shims lose. Building the render path as its own static library
# gives it an independent, correctly-ordered include search: notif dirs first
# (via BEFORE), then the Zephyr environment inherited from zephyr_interface.
# ---------------------------------------------------------------------------
set(GFX "${PEBBLEOS_ROOT}/src/fw/applib/graphics")
set(NOTIF "${PEBBLEOS_ROOT}/zephyr-port-apps/notif")

set(RENDER_SOURCES
  "${NOTIF}/src/port.c"
  "${NOTIF}/src/render.c"

  # PebbleOS notification card and its shared timeline/text-node machinery.
  # Live blob_db notification deserialize (SerializedTimelineItemHeader + payload).
  "${PEBBLEOS_ROOT}/src/fw/services/timeline/item.c"
  "${PEBBLEOS_ROOT}/src/fw/services/timeline/attributes_actions.c"
  "${PEBBLEOS_ROOT}/src/fw/services/timeline/attribute_group.c"
  "${PEBBLEOS_ROOT}/src/fw/services/timeline/attribute.c"
  "${PEBBLEOS_ROOT}/src/fw/services/timeline/notification_layout.c"
  "${PEBBLEOS_ROOT}/src/fw/services/timeline/layout_layer.c"
  "${PEBBLEOS_ROOT}/src/fw/services/timeline/layout_node.c"
  "${PEBBLEOS_ROOT}/src/fw/services/timeline/timeline_layout.c"
  "${PEBBLEOS_ROOT}/src/fw/apps/system/timeline/text_node.c"

  # Real Pebble layer, framebuffer, graphics, and text implementations.
  "${PEBBLEOS_ROOT}/src/fw/applib/ui/layer.c"
  "${GFX}/8_bit/bitblt_private.c"
  "${GFX}/8_bit/framebuffer.c"
  "${GFX}/arabic_shaping.c"
  "${GFX}/bitblt.c"
  "${GFX}/framebuffer.c"
  "${GFX}/gbitmap.c"
  "${GFX}/gbitmap_png.c"
  "${GFX}/gcolor_definitions.c"
  "${GFX}/graphics.c"
  "${GFX}/graphics_bitmap.c"
  "${GFX}/graphics_circle.c"
  "${GFX}/graphics_line.c"
  "${GFX}/graphics_private.c"
  "${GFX}/graphics_private_raw.c"
  "${GFX}/gtransform.c"
  "${GFX}/gtypes.c"
  "${GFX}/gpath.c"
  "${GFX}/perimeter.c"
  "${GFX}/rtl_support.c"
  "${GFX}/text_layout.c"
  "${GFX}/text_render.c"
  "${GFX}/text_resources.c"
  "${GFX}/utf8.c"
  "${PEBBLEOS_ROOT}/src/fw/applib/vendor/uPNG/upng.c"
  "${PEBBLEOS_ROOT}/src/fw/applib/vendor/tinflate/tinflate.c"
  "${PEBBLEOS_ROOT}/src/fw/applib/fonts/codepoint.c"
  "${PEBBLEOS_ROOT}/lib/util/crc32.c"
  "${PEBBLEOS_ROOT}/lib/util/hash.c"
  "${PEBBLEOS_ROOT}/lib/util/keyed_circular_cache.c"
  "${PEBBLEOS_ROOT}/lib/util/iterator.c"
  "${PEBBLEOS_ROOT}/lib/util/trig.c"
  "${PEBBLEOS_ROOT}/lib/util/math.c"
)

add_library(notif_render STATIC ${RENDER_SOURCES})
# Inherit the Zephyr compile environment (nostdinc, minimal libc, arch flags,
# autoconf.h) so k_* / zephyr headers resolve, without dragging in the app's
# BLE include dirs.
target_link_libraries(notif_render PRIVATE zephyr_interface)
# notif shim dirs FIRST so they shadow repo include/ + src/fw; this is the exact
# search order the standalone notif app builds with.
target_include_directories(notif_render BEFORE PRIVATE
  "${NOTIF}/include"
  "${PEBBLEOS_ROOT}/zephyr-port-apps/kernel/include"
  "${PEBBLEOS_ROOT}/zephyr-port-apps/gfx/include"
  "${PEBBLEOS_ROOT}/src/fw"
  "${PEBBLEOS_ROOT}/src/fw/applib/vendor/uPNG"
  "${PEBBLEOS_ROOT}/src/fw/applib/vendor/tinflate"
  "${PEBBLEOS_ROOT}/include"
  "${CMAKE_BINARY_DIR}/include/generated"
)
target_compile_definitions(notif_render PRIVATE
  CONFIG_BOARD_OBELIX_PVT=1
  CONFIG_PLATFORM_EMERY=1
  CONFIG_SCREEN_COLOR_DEPTH_BITS=8
  CONFIG_SOC_SF32LB52=1
)
target_compile_options(notif_render PRIVATE
  -include string.h
  -Wno-address-of-packed-member
)
target_link_libraries(app PRIVATE notif_render)

# Fonts + generic-notification icon, mirrored from zephyr-port-apps/notif.
generate_inc_file_for_target(notif_render
  "${PEBBLEOS_ROOT}/resources/normal/base/pbf/GOTHIC_18.pbf"
  "${CMAKE_BINARY_DIR}/include/generated/notif_gothic_18.pbf.inc"
)
generate_inc_file_for_target(notif_render
  "${PEBBLEOS_ROOT}/resources/normal/base/pbf/GOTHIC_24_BOLD.pbf"
  "${CMAKE_BINARY_DIR}/include/generated/notif_gothic_24_bold.pbf.inc"
)
generate_inc_file_for_target(notif_render
  "${PEBBLEOS_ROOT}/resources/normal/base/pbf/GOTHIC_28.pbf"
  "${CMAKE_BINARY_DIR}/include/generated/notif_gothic_28.pbf.inc"
)
generate_inc_file_for_target(notif_render
  "${PEBBLEOS_ROOT}/resources/normal/base/pbf/GOTHIC_28_BOLD.pbf"
  "${CMAKE_BINARY_DIR}/include/generated/notif_gothic_28_bold.pbf.inc"
)
find_program(MAGICK_EXECUTABLE magick REQUIRED)
set(NOTIF_ICON_PNG "${CMAKE_CURRENT_BINARY_DIR}/notification_generic_25.png")
add_custom_command(
  OUTPUT "${NOTIF_ICON_PNG}"
  COMMAND "${MAGICK_EXECUTABLE}"
          "${PEBBLEOS_ROOT}/resources/normal/base/images/Pebble_25x25_Generic_notification.svg"
          -background none -resize 25x25 -type Palette "PNG8:${NOTIF_ICON_PNG}"
  DEPENDS
          "${PEBBLEOS_ROOT}/resources/normal/base/images/Pebble_25x25_Generic_notification.svg"
  VERBATIM
)
generate_inc_file_for_target(notif_render
  "${NOTIF_ICON_PNG}"
  "${CMAKE_BINARY_DIR}/include/generated/notif_generic_icon.png.inc"
)
```

## prj.conf
```kconfig
CONFIG_ASSERT=y
CONFIG_BOOT_BANNER=n
CONFIG_CONSOLE=y
# k_heap backs both mbedtls (pairing) and the folded-in notification render path.
CONFIG_HEAP_MEM_POOL_SIZE=131072
CONFIG_MAIN_STACK_SIZE=8192
CONFIG_COMMON_LIBC_MALLOC=y
CONFIG_COMMON_LIBC_MALLOC_ARENA_SIZE=65536
CONFIG_PRINTK=y
CONFIG_SERIAL=y
CONFIG_THREAD_NAME=y
CONFIG_UART_CONSOLE=y

# JDI panel for the folded-in PebbleOS notification render path.
CONFIG_DISPLAY=y
CONFIG_SF32LB_JDI=y

CONFIG_USE_SIFLI_HAL=y
CONFIG_USE_SIFLI_HAL_AON=y
CONFIG_USE_SIFLI_HAL_LCPU_PATCH=y
CONFIG_USE_SIFLI_HAL_MAILBOX=y
CONFIG_USE_SIFLI_HAL_SYSTEM_CONFIG=y

CONFIG_SYSTEM_WORKQUEUE_STACK_SIZE=4096

# The BLE controller (LCPU) and HCPU share RAM: the LCPU boot data (patch,
# config, NVDS) in LPSYS RAM at 0x2040_0000 and the HCI command/event rings in
# HPSYS RAM. The shipping firmware runs the SiFli mpu_config() which marks that
# RAM non-cacheable; this standalone Zephyr port never does, so with the HCPU
# D-cache on, writes to the shared rings sat in cache and the LCPU read stale
# RAM (never booted / never drained HCI). Disable the D-cache to guarantee
# HCPU<->LCPU coherency.
# ponytail: global D-cache off; upgrade to a non-cacheable MPU region covering
# just 0x2040_0000 + the HPSYS mailbox if HCPU throughput matters.
CONFIG_DCACHE=n
```

## src/main.c
```c
/* SPDX-FileCopyrightText: 2026 Core Devices LLC */
/* SPDX-License-Identifier: Apache-2.0 */

#include <errno.h>
#include <stdbool.h>
#include <stdint.h>
#include <stdio.h>
#include <stdlib.h>
#include <string.h>

#include <zephyr/kernel.h>

#include <bluetooth/bluetooth_types.h>
#include <bluetooth/bt_driver_advert.h>
#include <bluetooth/id.h>
#include <host/ble_gap.h>
#include <host/ble_hs.h>
#include <host/ble_sm.h>
#include <host/util/util.h>
#include <nimble/nimble_npl.h>
#include <nimble/nimble_port.h>
#include <pbl/os/mutex.h>
#include <pbl/os/semaphore.h>
#include <pbl/os/tick.h>
#include <services/gap/ble_svc_gap.h>
#include <services/gatt/ble_svc_gatt.h>

#include "notif_render.h"

#define HOST_STACK_SIZE 6144
#define HOST_PRIORITY 3

extern int ble_transport_sf32lb52_status(void);
extern const char *ble_transport_sf32lb52_failure_where(void);
extern void ble_transport_sf32lb52_dump_ipc(void);
extern void ble_transport_sf32lb52_report_sync_timeout(void);

extern void pebble_pairing_service_init(void);
extern void pebble_pairing_service_notify_connectivity(uint16_t conn_handle);
extern void ppog_reversed_service_init(void);
extern void ram_store_init(void);

K_THREAD_STACK_DEFINE(s_host_stack, HOST_STACK_SIZE);
static struct k_thread s_host_thread;
static struct k_work_delayable s_sync_timeout;

struct BringupAdvertisement {
  BLEAdData header;
  uint8_t bytes[62];
};

static struct BringupAdvertisement s_advertisement;
static bool s_synchronized;

static void prv_fail(const char *where, int code) {
  printk("BLE_FAIL %s %d\n", where, code);
}

// PPoGATT link handling lives in ppog_min.c (bt_driver_cb_ppog_reversed_*).

static bool prv_npl_smoke_test(void) {
  struct ble_npl_mutex mutex;
  struct ble_npl_sem sem;
  PebbleMutex *pbl_mutex;
  PebbleSemaphore *pbl_sem;

  pbl_mutex = mutex_create();
  pbl_sem = semaphore_create();
  if (pbl_mutex == NULL || pbl_sem == NULL) {
    if (pbl_sem != NULL) {
      semaphore_destroy(pbl_sem);
    }
    if (pbl_mutex != NULL) {
      mutex_destroy(pbl_mutex);
    }
    return false;
  }
  mutex_lock(pbl_mutex);
  mutex_unlock(pbl_mutex);
  semaphore_give(pbl_sem);
  const bool pbl_os_ok = semaphore_take_with_timeout(pbl_sem, 0) &&
                         ticks_to_milliseconds(milliseconds_to_ticks(1000)) == 1000;
  semaphore_destroy(pbl_sem);
  mutex_destroy(pbl_mutex);
  if (!pbl_os_ok) {
    return false;
  }

  if (ble_npl_mutex_init(&mutex) != BLE_NPL_OK ||
      ble_npl_mutex_pend(&mutex, 0) != BLE_NPL_OK ||
      ble_npl_mutex_release(&mutex) != BLE_NPL_OK ||
      ble_npl_sem_init(&sem, 0) != BLE_NPL_OK ||
      ble_npl_sem_release(&sem) != BLE_NPL_OK ||
      ble_npl_sem_pend(&sem, 0) != BLE_NPL_OK) {
    return false;
  }

  ble_npl_time_t ticks;
  uint32_t ms;
  return ble_npl_time_ms_to_ticks(1000, &ticks) == BLE_NPL_OK &&
         ble_npl_time_ticks_to_ms(ticks, &ms) == BLE_NPL_OK && ms == 1000;
}

static void prv_build_pebble_advertisement(const char *name) {
  uint8_t *out = s_advertisement.bytes;
  const size_t name_len = strlen(name);

  *out++ = 2;
  *out++ = 0x01;
  *out++ = GAP_LE_AD_FLAGS_GEN_DISCOVERABLE_MASK |
           GAP_LE_AD_FLAGS_BR_EDR_NOT_SUPPORTED_MASK;

  *out++ = 3;
  *out++ = 0x03;
  *out++ = 0xd9;
  *out++ = 0xfe;

  *out++ = name_len + 1;
  *out++ = 0x09;
  memcpy(out, name, name_len);
  out += name_len;

  *out++ = 2;
  *out++ = 0x0a;
  *out++ = 0;
  s_advertisement.header.ad_data_length = out - s_advertisement.bytes;

  *out++ = 22;
  *out++ = 0xff;
  *out++ = 0xea;
  *out++ = 0x0e;
  *out++ = 0;
  memcpy(out, "PT2BLE000000", 12);
  out += 12;
  *out++ = 18;
  *out++ = 0;
  *out++ = 0;
  *out++ = 1;
  *out++ = 0;
  *out++ = 0;
  s_advertisement.header.scan_resp_data_length =
      out - s_advertisement.bytes - s_advertisement.header.ad_data_length;
}

static void prv_sync_timeout(struct k_work *work) {
  (void)work;
  if (!s_synchronized) {
    ble_transport_sf32lb52_report_sync_timeout();
  }
}

static void prv_start_advertising(void) {
  if (!bt_driver_advert_set_advertising_data(&s_advertisement.header)) {
    prv_fail("adv_data", -EIO);
    return;
  }
  if (!bt_driver_advert_advertising_enable(20, 20)) {
    prv_fail("adv_start", -EIO);
    return;
  }
  printk("BLE_ADV_START\n");
}

// App-level GAP listener: gives printk visibility into the connection/pairing
// lifecycle (advert.c's own logs are behind PBL_LOG) and re-advertises after a
// disconnect so the phone can reconnect without a watch reboot.
static struct ble_gap_event_listener s_app_gap_listener;

static int prv_app_gap_event(struct ble_gap_event *event, void *arg) {
  (void)arg;
  switch (event->type) {
    case BLE_GAP_EVENT_CONNECT:
      printk("BLE_APP_CONNECT status=%d handle=%d\n", event->connect.status,
             event->connect.conn_handle);
      break;
    case BLE_GAP_EVENT_DISCONNECT:
      printk("BLE_APP_DISCONNECT reason=0x%x\n", event->disconnect.reason);
      prv_start_advertising();
      break;
    case BLE_GAP_EVENT_ENC_CHANGE:
      printk("BLE_APP_ENC_CHANGE status=%d\n", event->enc_change.status);
      if (event->enc_change.status == 0) {
        pebble_pairing_service_notify_connectivity(event->enc_change.conn_handle);
      }
      break;
    case BLE_GAP_EVENT_PAIRING_COMPLETE:
      printk("BLE_APP_PAIRING_COMPLETE status=%d\n", event->pairing_complete.status);
      break;
    case BLE_GAP_EVENT_SUBSCRIBE:
      printk("BLE_APP_SUBSCRIBE attr=%d notify=%d\n", event->subscribe.attr_handle,
             event->subscribe.cur_notify);
      break;
    case BLE_GAP_EVENT_REPEAT_PAIRING:
      printk("BLE_APP_REPEAT_PAIRING\n");
      break;
    default:
      break;
  }
  return 0;
}

static void prv_reset_cb(int reason) {
  prv_fail("host_reset", reason);
}

static void prv_sync_cb(void) {
  BTDeviceAddress address;
  char name[BT_DEVICE_NAME_BUFFER_SIZE];
  int rc;

  s_synchronized = true;
  (void)k_work_cancel_delayable(&s_sync_timeout);
  printk("BLE_CONTROLLER_UP\n");

  rc = ble_hs_util_ensure_addr(0);
  if (rc != 0) {
    prv_fail("ensure_addr", rc);
    return;
  }

  bt_driver_id_copy_local_identity_address(&address);
  snprintf(name, sizeof(name), "Pebble Time 2 %02X%02X", address.octets[1], address.octets[0]);
  bt_driver_id_set_local_device_name(name);
  printk("BLE_ADDR " BT_DEVICE_ADDRESS_FMT "\n", BT_DEVICE_ADDRESS_XPLODE(address));

  prv_build_pebble_advertisement(name);
  (void)ble_gap_event_listener_register(&s_app_gap_listener, prv_app_gap_event, NULL);
  prv_start_advertising();
}

static void prv_host_main(void *arg1, void *arg2, void *arg3) {
  (void)arg1;
  (void)arg2;
  (void)arg3;
  nimble_port_run();
}

int main(void) {
  k_tid_t host_tid;
  int rc;

  if (!prv_npl_smoke_test()) {
    prv_fail("npl", -EINVAL);
    return 0;
  }
  printk("BLE_NPL_OK\n");

  nimble_port_init();
  rc = ble_transport_sf32lb52_status();
  if (rc != 0) {
    const char *where = ble_transport_sf32lb52_failure_where();
    prv_fail(where != NULL ? where : "ipc_lcpu", rc);
    return 0;
  }

  ble_svc_gap_init();
  ble_svc_gatt_init();
  pebble_pairing_service_init();
  ppog_reversed_service_init();
  ram_store_init();
  ble_hs_cfg.sync_cb = prv_sync_cb;
  ble_hs_cfg.reset_cb = prv_reset_cb;
  // Just-Works bonding so CoreApp can establish the encrypted link PPoGATT
  // requires (data chars are WRITE_ENC/READ_ENC).
  ble_hs_cfg.sm_io_cap = BLE_HS_IO_NO_INPUT_OUTPUT;
  ble_hs_cfg.sm_bonding = 1;
  ble_hs_cfg.sm_sc = 1;
  ble_hs_cfg.sm_mitm = 0;
  ble_hs_cfg.sm_our_key_dist = BLE_SM_PAIR_KEY_DIST_ENC | BLE_SM_PAIR_KEY_DIST_ID;
  ble_hs_cfg.sm_their_key_dist =
      BLE_SM_PAIR_KEY_DIST_ENC | BLE_SM_PAIR_KEY_DIST_ID;

  host_tid = k_thread_create(&s_host_thread, s_host_stack,
                             K_THREAD_STACK_SIZEOF(s_host_stack), prv_host_main,
                             NULL, NULL, NULL, HOST_PRIORITY, 0, K_NO_WAIT);
  if (host_tid == NULL) {
    prv_fail("host_thread", -ENOMEM);
    return 0;
  }
  k_thread_name_set(host_tid, "NimbleHost");
  printk("BLE_HOST_UP\n");

  k_work_init_delayable(&s_sync_timeout, prv_sync_timeout);
  (void)k_work_schedule(&s_sync_timeout, K_SECONDS(5));
  ble_hs_sched_start();

  // Phase 2: nothing is drawn at boot. The panel stays blank until a real
  // CoreApp notification is delivered over blob_db (0xb1db) and rendered from the
  // received TimelineItem, so what's on screen is always a genuinely delivered
  // notification, never a placeholder. notif_render_demo() remains available for
  // standalone render bring-up but is intentionally not invoked here.
  notif_render_init();
  printk("BLE_NOTIF_WAIT\n");

  while (true) {
    k_sleep(K_SECONDS(60));
  }
  return 0;
}
```

## include/ble_uuid_zephyr_compat.h
```c
/* SPDX-License-Identifier: Apache-2.0 */

#pragma once

/* Zephyr exports a four-argument hex2bin. NimBLE has a private, static
 * three-argument helper with the same name. Include Zephyr's declaration
 * before locally renaming only NimBLE's helper. */
#include "nimble_zephyr_compat.h"

#define hex2bin nimble_ble_uuid_hex2bin
```

## include/fw_ota.h
```c
/* SPDX-FileCopyrightText: 2026 Core Devices LLC */
/* SPDX-License-Identifier: Apache-2.0 */

// Firmware-update receive path for the BLE bring-up app. Wire-compatible with
// the real PebbleOS put_bytes.c / firmware_update service.c + system_message.c,
// folded down to a single-transfer receiver that streams the firmware image
// into an OTA slot. See putbytes_min.c.

#pragma once

#include <stdbool.h>
#include <stdint.h>

// Dispatched from ppog_min.c for the two Pebble Protocol endpoints CoreApp
// drives a firmware update over. `p`/`plen` are the PP payload (past the 4-byte
// [length][endpoint] header).
void fw_ota_handle_system_msg(uint16_t conn, const uint8_t *p, uint16_t plen);
void fw_ota_handle_putbytes(uint16_t conn, const uint8_t *p, uint16_t plen);

// Provided by ppog_min.c: send a Pebble Protocol message as a PPoGATT Data
// packet on `endpoint`, advancing the shared TX sequence number.
void ppog_min_send_pp(uint16_t conn, uint16_t endpoint, const uint8_t *payload,
                      uint16_t payload_len);

// --- OTA slot write API ---------------------------------------------------
// The sibling OTA agent's fw_ota_boot.c provides the strong symbols (open a
// slot region, stream bytes, CRC-validate + commit). Until then the weak
// defaults in putbytes_min.c just log, so the receive path builds and runs
// stand-alone. `obj_type` is a PutBytesObjectType (ObjectFirmware/Recovery/
// SysResources).
void ota_slot_begin(uint8_t obj_type, uint32_t total_size, uint32_t append_offset);
int ota_slot_write(uint32_t offset, const uint8_t *buf, uint16_t len);
void ota_slot_finalize(bool success);
```

## include/nimble_zephyr_compat.h
```c
/* SPDX-License-Identifier: Apache-2.0 */

#pragma once

/* NimBLE's os/util.h duplicates these helpers with slightly different macro
 * bodies. Use Zephyr's definitions consistently throughout this application. */
#include <zephyr/sys/util.h>

#define H_OS_UTIL_
```

## src/mbedtls_alloc.c
```c
/* SPDX-License-Identifier: Apache-2.0 */

#include <stddef.h>

#include <zephyr/kernel.h>

// mbedtls allocates via kernel_calloc / kernel_free (see pebble_mbedtls_config.h).
// The folded-in notification render path (notif/src/port.c) also provides the
// kernel_* / task_* / applib_* allocators, all backed by the Zephyr k_heap, and
// it defines kernel_free. Keep only kernel_calloc here, k_heap-backed too, so an
// mbedtls object allocated here and freed through port.c's kernel_free stays on
// one heap.
void *kernel_calloc(size_t count, size_t size) {
  return k_calloc(count, size);
}
```

## src/ppog_min.c
```c
/* SPDX-FileCopyrightText: 2026 Core Devices LLC */
/* SPDX-License-Identifier: Apache-2.0 */

// Minimal reversed-PPoGATT link layer for the BLE bring-up demo. The watch is
// the GATT server; the phone is the PPoGATT client and initiates the reset.
// We answer ResetRequest with ResetComplete, ACK every Data packet, reassemble
// the Pebble Protocol stream and log each PP message. Just enough to bring the
// link up and see what CoreApp sends after the session opens.
// ponytail: single connection, RX-only ACKing, no windowing/retransmit; grow
// into the real ppogatt.c + comm_session when more than a demo is needed.

#include <bluetooth/bluetooth_types.h>
#include <bluetooth/bt_driver_ppog_reversed.h>
#include <stdint.h>
#include <stdlib.h>
#include <string.h>
#include <zephyr/sys/printk.h>

#include "fw_ota.h"
#include "notif_render.h"

#define PPOG_TYPE_DATA 0x0
#define PPOG_TYPE_ACK 0x1
#define PPOG_TYPE_RESET_REQUEST 0x2
#define PPOG_TYPE_RESET_COMPLETE 0x3

#define PPOG_TYPE(b) ((b) & 0x7)
#define PPOG_SN(b) ((b) >> 3)
#define PPOG_HDR(type, sn) ((uint8_t)((type) | ((sn) << 3)))

#define PPOG_WINDOW 4

// Sized to reassemble a full PutBytes Put request (2044 data bytes + a 9-byte
// PutRequest header) with headroom, so firmware chunks don't overflow.
static uint8_t s_pp_buf[2560];
static uint16_t s_pp_len;
static uint8_t s_tx_sn;   // our PPoGATT Data sequence number
static bool s_session_open;

// Pebble Protocol endpoints we care about for the demo.
#define PP_ENDPOINT_SYSTEM_VERSION 0x0010  // phone asks watch's version
#define PP_ENDPOINT_PHONE_VERSION 0x0011   // watch asks phone's version
#define PP_ENDPOINT_FACTORY_REGISTRY 0x1389  // phone reads mfg_color
#define PP_ENDPOINT_APP_RUN_STATE 0x0034   // phone asks running app (STATUS)
#define PP_ENDPOINT_BLOB_DB 0xb1db         // notifications (blob_db insert)
#define PP_ENDPOINT_SYSTEM_MESSAGE 0x0012  // FW update start/status/complete
#define PP_ENDPOINT_PUT_BYTES 0xBEEF       // PutBytes object transfer

// Wire layout of the watch's system-version (0x0010) response, mirrored from
// src/fw/kernel/system_versions.c (struct VersionsMessage) + its sub-structs.
struct __attribute__((__packed__)) FwMeta {
  uint32_t version_timestamp;
  char version_tag[32];
  char version_short[8];
  uint8_t flags;  // is_recovery/ble/dual/slot0 bitfield + reserved
  uint8_t hw_platform;
  uint8_t metadata_version;
};

struct __attribute__((__packed__)) VersionsMessage {
  uint8_t command;
  struct FwMeta running_fw_metadata;
  struct FwMeta recovery_fw_metadata;
  uint32_t boot_version;
  char hw_version[9];
  char serial_number[12];
  uint8_t device_address[6];
  uint32_t resources_crc;
  uint32_t resources_timestamp;
  char iso_locale[6];
  uint16_t lang_version;
  uint64_t capabilities;
  uint8_t is_unfaithful;
  uint16_t activity_insights_version;
  uint16_t javascript_bytecode_version;
};

static void prv_send(uint16_t conn, uint8_t type, uint8_t sn, const uint8_t *pl,
                     uint16_t pl_len) {
  uint8_t pkt[16];
  if (pl_len + 1U > sizeof(pkt)) {
    return;
  }
  pkt[0] = PPOG_HDR(type, sn);
  if (pl_len) {
    memcpy(pkt + 1, pl, pl_len);
  }
  BTErrno rc = bt_driver_ppog_reversed_notify(conn, pkt, pl_len + 1U);
  if (rc != BTErrnoOK) {
    printk("BLE_PPOG_TX_ERR type=%u rc=%d\n", type, (int)rc);
  }
}

// Send a Pebble Protocol message as a PPoGATT Data packet.
// PP framing: [be16 length][be16 endpoint][payload]; PPoGATT: [type|sn<<3] + PP.
static void prv_send_pp(uint16_t conn, uint16_t endpoint, const uint8_t *payload,
                        uint16_t payload_len) {
  uint8_t pkt[260];
  if (1U + 4U + payload_len > sizeof(pkt)) {
    return;
  }
  pkt[0] = PPOG_HDR(PPOG_TYPE_DATA, s_tx_sn);
  pkt[1] = payload_len >> 8;
  pkt[2] = payload_len & 0xFF;
  pkt[3] = endpoint >> 8;
  pkt[4] = endpoint & 0xFF;
  if (payload_len) {
    memcpy(pkt + 5, payload, payload_len);
  }
  BTErrno rc = bt_driver_ppog_reversed_notify(conn, pkt, 5U + payload_len);
  printk("BLE_PP_TX endpoint=0x%04x sn=%u len=%u rc=%d\n", endpoint, s_tx_sn,
         payload_len, (int)rc);
  s_tx_sn = (s_tx_sn + 1) & 0x1F;
}

// Exposed to putbytes_min.c so the FW-update receive path can send its ACK/NACK
// and system-message responses over the shared PPoGATT link.
void ppog_min_send_pp(uint16_t conn, uint16_t endpoint, const uint8_t *payload,
                      uint16_t payload_len) {
  prv_send_pp(conn, endpoint, payload, payload_len);
}

// After the PPoGATT session opens, the watch drives the app-layer handshake by
// requesting the phone's version (endpoint 0x11, command 0x00). CoreApp gates
// notification delivery on this exchange completing.
static void prv_session_opened(uint16_t conn) {
  if (s_session_open) {
    return;
  }
  s_session_open = true;
  s_tx_sn = 0;
  const uint8_t version_request[1] = {0x00};  // CommSessionVersionCommandRequest
  prv_send_pp(conn, PP_ENDPOINT_PHONE_VERSION, version_request,
              sizeof(version_request));
  printk("BLE_PP_SESSION_OPEN sent phone-version request\n");
}

// Reply to the phone's system-version request (endpoint 0x0010) with a valid
// VersionsMessage so CoreApp marks the watch ready and starts sending data.
static void prv_send_system_version(uint16_t conn) {
  struct VersionsMessage m;
  memset(&m, 0, sizeof(m));
  m.command = 0x01;  // VERSION_RESPONSE
  // CoreApp's PebbleConnector rejects any running FW below v3.0 ("FW below v3.0
  // isn't supported; going into recovery mode") and classifies the watch
  // ConnectedPebbleDeviceInRecovery, which suppresses blob_db notification
  // delivery. Report a >=3.0 running version so it classifies us a normal
  // ConnectedPebbleDevice and forwards notifications.
  strncpy(m.running_fw_metadata.version_tag, "v4.0.0-zephyr",
          sizeof(m.running_fw_metadata.version_tag) - 1);
  strncpy(m.running_fw_metadata.version_short, "v4.0.0",
          sizeof(m.running_fw_metadata.version_short) - 1);
  m.running_fw_metadata.flags = 0x02;      // is_ble_firmware
  m.running_fw_metadata.hw_platform = 18;  // ObelixPVT
  m.running_fw_metadata.metadata_version = 1;
  // Populate recovery_fw_metadata too. If it is left zeroed the phone parses
  // recoveryFwVersion=null and PebbleConnector logs "No recovery FW installed!!!
  // going into recovery mode" -> classifies the watch as
  // ConnectedPebbleDeviceInRecovery, which suppresses notification (blob_db)
  // delivery. A real watch always reports a PRF/recovery image; mirror that so
  // CoreApp treats us as a normal ConnectedPebbleDevice and forwards blob_db.
  strncpy(m.recovery_fw_metadata.version_tag, "v0.0.1-zephyr-prf",
          sizeof(m.recovery_fw_metadata.version_tag) - 1);
  strncpy(m.recovery_fw_metadata.version_short, "v0.0.1",
          sizeof(m.recovery_fw_metadata.version_short) - 1);
  m.recovery_fw_metadata.flags = 0x03;      // is_recovery_firmware | is_ble_firmware
  m.recovery_fw_metadata.hw_platform = 18;  // ObelixPVT
  m.recovery_fw_metadata.metadata_version = 1;
  strncpy(m.hw_version, "obelix", sizeof(m.hw_version) - 1);
  strncpy(m.iso_locale, "en_US", sizeof(m.iso_locale) - 1);
  // Capabilities: run_state, log_dump, ext music, ext notification, lang_pack,
  // app_msg_8k, activity, voice, notif_filtering, unread_coredump, smooth_fw,
  // custom_vibe, continue_fw.
  // NB: blob_db_version_support (bit 22, 0x400000) is intentionally CLEARED.
  // With it set, CoreApp drives notifications over BlobDB v2 (endpoint 0xb2db)
  // and first waits on a v2 version handshake this minimal firmware doesn't
  // answer, so it never pushes the notification. Clearing it makes CoreApp use
  // legacy BlobDB v1 (0xb1db), which pushes the INSERT directly -> rendered.
  m.capabilities = 0x160C6FFULL & ~0x400000ULL;  // = 0x120C6FF
  prv_send_pp(conn, PP_ENDPOINT_SYSTEM_VERSION, (const uint8_t *)&m, sizeof(m));
  printk("BLE_PP_SYSVER_SENT len=%u\n", (unsigned int)sizeof(m));
}

// A CoreApp notification arrives as a blob_db INSERT on endpoint 0xb1db. Wire
// layout of the payload (after the 4-byte PP header): [cmd:1][token:2][db_id:1]
// then, for INSERT (0x01): [key_size:1][key][value_size:2 LE][value]; for
// INSERT_WITH_TIMESTAMP (0x0D) a 4-byte timestamp sits before key_size. db_id
// 0x04 is the notifications DB; the value is a serialized TimelineItem. Extract
// it and hand the raw bytes to the folded PebbleOS render path.
static void prv_handle_blob_db(uint16_t plen, const uint8_t *p) {
  if (plen < 4) {
    return;
  }
  uint8_t cmd = p[0];
  uint8_t db_id = p[3];
  uint16_t off = 4;  // past cmd + token(2) + db_id(1)
  if (cmd == 0x0D) {
    off += 4;  // INSERT_WITH_TIMESTAMP: skip the conflict-resolution timestamp
  } else if (cmd != 0x01) {
    printk("BLE_BLOB_SKIP cmd=0x%02x\n", cmd);
    return;
  }
  if (db_id != 0x04) {  // BlobDBIdNotifs
    printk("BLE_BLOB_OTHER_DB db=0x%02x\n", db_id);
    return;
  }
  if (off + 1u > plen) {
    return;
  }
  uint8_t key_size = p[off++];
  off += key_size;  // skip the notification key (its uuid)
  if (off + 2u > plen) {
    return;
  }
  uint16_t value_size = (uint16_t)(p[off] | (p[off + 1] << 8));
  off += 2;
  if (off + value_size > plen) {
    printk("BLE_BLOB_TRUNC off=%u val=%u plen=%u\n", off, value_size, plen);
    return;
  }
  printk("BLE_BLOB_INSERT db=0x%02x key=%u val=%u\n", db_id, key_size,
         value_size);
  notif_render_blob_db_value(p + off, value_size);
}

// Reassemble the Pebble Protocol stream: [be16 length][be16 endpoint][payload].
static void prv_pp_feed(uint16_t conn, const uint8_t *data, uint16_t len) {
  if (s_pp_len + len > sizeof(s_pp_buf)) {
    s_pp_len = 0;  // overflow guard; resync
    return;
  }
  memcpy(s_pp_buf + s_pp_len, data, len);
  s_pp_len += len;

  while (s_pp_len >= 4) {
    uint16_t msg_len = (s_pp_buf[0] << 8) | s_pp_buf[1];
    uint16_t endpoint = (s_pp_buf[2] << 8) | s_pp_buf[3];
    uint16_t total = 4 + msg_len;
    if (s_pp_len < total) {
      break;  // wait for more
    }
    printk("BLE_PP_MSG endpoint=0x%04x len=%u b0=%02x b1=%02x\n", endpoint,
           msg_len, msg_len > 0 ? s_pp_buf[4] : 0,
           msg_len > 1 ? s_pp_buf[5] : 0);
    if (endpoint == PP_ENDPOINT_SYSTEM_VERSION && msg_len >= 1 &&
        s_pp_buf[4] == 0x00) {
      prv_send_system_version(conn);
    } else if (endpoint == PP_ENDPOINT_FACTORY_REGISTRY && msg_len >= 1 &&
               s_pp_buf[4] == 0x00) {
      // Read of "mfg_color": reply {0x01, len=4, 0,0,0, color}.
      const uint8_t color_resp[6] = {0x01, 0x04, 0x00, 0x00, 0x00, 0x01};
      prv_send_pp(conn, PP_ENDPOINT_FACTORY_REGISTRY, color_resp,
                  sizeof(color_resp));
      printk("BLE_PP_FACTORY_COLOR_SENT\n");
    } else if (endpoint == PP_ENDPOINT_APP_RUN_STATE && msg_len >= 1 &&
               s_pp_buf[4] == 0x03) {
      // STATUS request: reply AppRunStateStart {cmd=0x01, 16-byte uuid}. The
      // phone's Negotiator only accepts cmd 0x01 + a NON-ZERO uuid, so fill a
      // fixed non-zero uuid (no real app is running).
      uint8_t run_resp[17] = {0x01};
      memset(run_resp + 1, 0x5a, 16);
      prv_send_pp(conn, PP_ENDPOINT_APP_RUN_STATE, run_resp, sizeof(run_resp));
      printk("BLE_PP_APP_RUN_STATE_SENT\n");
    } else if (endpoint == PP_ENDPOINT_BLOB_DB) {
      prv_handle_blob_db(msg_len, &s_pp_buf[4]);
    } else if (endpoint == PP_ENDPOINT_SYSTEM_MESSAGE) {
      fw_ota_handle_system_msg(conn, &s_pp_buf[4], msg_len);
    } else if (endpoint == PP_ENDPOINT_PUT_BYTES) {
      fw_ota_handle_putbytes(conn, &s_pp_buf[4], msg_len);
    }
    memmove(s_pp_buf, s_pp_buf + total, s_pp_len - total);
    s_pp_len -= total;
  }
}

// --- bt_driver_cb_ppog_reversed_* hooks (called from ppog_reversed_service) ---

void bt_driver_cb_ppog_reversed_subscribed(const BTDeviceInternal *device,
                                           uint16_t conn_handle) {
  (void)device;
  s_pp_len = 0;
  s_session_open = false;
  s_tx_sn = 0;
  printk("BLE_PPOG_SUBSCRIBED conn=%u\n", (unsigned int)conn_handle);
}

void bt_driver_cb_ppog_reversed_unsubscribed(uint16_t conn_handle) {
  s_pp_len = 0;
  s_session_open = false;
  printk("BLE_PPOG_UNSUBSCRIBED conn=%u\n", (unsigned int)conn_handle);
}

void bt_driver_cb_ppog_reversed_data_written(uint16_t conn_handle, uint8_t *buf,
                                             uint16_t len) {
  if (len < 1) {
    free(buf);
    return;
  }
  uint8_t type = PPOG_TYPE(buf[0]);
  uint8_t sn = PPOG_SN(buf[0]);
  printk("BLE_PPOG_RX type=%u sn=%u len=%u\n", type, sn, len);

  switch (type) {
    case PPOG_TYPE_RESET_REQUEST: {
      s_pp_len = 0;
      s_session_open = false;
      const uint8_t rc_payload[2] = {PPOG_WINDOW, PPOG_WINDOW};
      prv_send(conn_handle, PPOG_TYPE_RESET_COMPLETE, 0, rc_payload,
               sizeof(rc_payload));
      printk("BLE_PPOG_RESET_COMPLETE_SENT\n");
      break;
    }
    case PPOG_TYPE_RESET_COMPLETE:
      // Both sides have reset; the session is open. Drive the app handshake.
      prv_session_opened(conn_handle);
      break;
    case PPOG_TYPE_DATA:
      prv_pp_feed(conn_handle, buf + 1, len - 1);
      prv_send(conn_handle, PPOG_TYPE_ACK, sn, NULL, 0);
      break;
    case PPOG_TYPE_ACK:
    default:
      break;
  }
  free(buf);
}
```

## src/ram_store.c
```c
/* SPDX-FileCopyrightText: 2026 Core Devices LLC */
/* SPDX-License-Identifier: Apache-2.0 */

// Minimal in-RAM NimBLE bond store for the BLE bring-up app. Transient bonds
// (lost on reboot) are enough for the CoreApp connect/PPoGATT demo; swap in the
// flash-backed nimble_store.c once the full comm stack is folded in.
// ponytail: fixed 8-entry arrays, no persistence; upgrade to nimble_store.c
// when bonds must survive reboot.

#include <host/ble_hs.h>
#include <host/ble_store.h>
#include <string.h>
#include <zephyr/sys/printk.h>

#define MAX_SEC 8
#define MAX_CCCD 16

static struct ble_store_value_sec s_our_sec[MAX_SEC];
static int s_our_sec_n;
static struct ble_store_value_sec s_peer_sec[MAX_SEC];
static int s_peer_sec_n;
static struct ble_store_value_cccd s_cccd[MAX_CCCD];
static int s_cccd_n;

static bool prv_addr_eq(const ble_addr_t *a, const ble_addr_t *b) {
  return a->type == b->type && memcmp(a->val, b->val, 6) == 0;
}

static bool prv_addr_none(const ble_addr_t *a) {
  static const uint8_t zero[6];
  return memcmp(a->val, zero, 6) == 0;
}

static struct ble_store_value_sec *prv_sec_array(int obj_type, int *n) {
  if (obj_type == BLE_STORE_OBJ_TYPE_OUR_SEC) {
    *n = s_our_sec_n;
    return s_our_sec;
  }
  *n = s_peer_sec_n;
  return s_peer_sec;
}

static int prv_read(int obj_type, const union ble_store_key *key,
                    union ble_store_value *value) {
  if (obj_type == BLE_STORE_OBJ_TYPE_CCCD) {
    int skip = key->cccd.idx;
    for (int i = 0; i < s_cccd_n; i++) {
      if (!prv_addr_none(&key->cccd.peer_addr) &&
          !prv_addr_eq(&key->cccd.peer_addr, &s_cccd[i].peer_addr)) {
        continue;
      }
      if (key->cccd.chr_val_handle != 0 &&
          key->cccd.chr_val_handle != s_cccd[i].chr_val_handle) {
        continue;
      }
      if (skip-- > 0) {
        continue;
      }
      value->cccd = s_cccd[i];
      return 0;
    }
    return BLE_HS_ENOENT;
  }

  int n;
  struct ble_store_value_sec *arr = prv_sec_array(obj_type, &n);
  int skip = key->sec.idx;
  for (int i = 0; i < n; i++) {
    if (!prv_addr_none(&key->sec.peer_addr) &&
        !prv_addr_eq(&key->sec.peer_addr, &arr[i].peer_addr)) {
      continue;
    }
    if (skip-- > 0) {
      continue;
    }
    value->sec = arr[i];
    return 0;
  }
  return BLE_HS_ENOENT;
}

static int prv_write(int obj_type, const union ble_store_value *val) {
  if (obj_type == BLE_STORE_OBJ_TYPE_CCCD) {
    for (int i = 0; i < s_cccd_n; i++) {
      if (prv_addr_eq(&val->cccd.peer_addr, &s_cccd[i].peer_addr) &&
          val->cccd.chr_val_handle == s_cccd[i].chr_val_handle) {
        s_cccd[i] = val->cccd;
        return 0;
      }
    }
    if (s_cccd_n < MAX_CCCD) {
      s_cccd[s_cccd_n++] = val->cccd;
    }
    return 0;
  }

  int n;
  struct ble_store_value_sec *arr = prv_sec_array(obj_type, &n);
  for (int i = 0; i < n; i++) {
    if (prv_addr_eq(&val->sec.peer_addr, &arr[i].peer_addr)) {
      arr[i] = val->sec;
      return 0;
    }
  }
  if (n < MAX_SEC) {
    arr[n] = val->sec;
    if (obj_type == BLE_STORE_OBJ_TYPE_OUR_SEC) {
      s_our_sec_n++;
    } else {
      s_peer_sec_n++;
    }
  }
  return 0;
}

static int prv_delete(int obj_type, const union ble_store_key *key) {
  if (obj_type == BLE_STORE_OBJ_TYPE_CCCD) {
    for (int i = 0; i < s_cccd_n; i++) {
      if ((prv_addr_none(&key->cccd.peer_addr) ||
           prv_addr_eq(&key->cccd.peer_addr, &s_cccd[i].peer_addr)) &&
          (key->cccd.chr_val_handle == 0 ||
           key->cccd.chr_val_handle == s_cccd[i].chr_val_handle)) {
        s_cccd[i] = s_cccd[--s_cccd_n];
        return 0;
      }
    }
    return BLE_HS_ENOENT;
  }

  int n;
  struct ble_store_value_sec *arr = prv_sec_array(obj_type, &n);
  for (int i = 0; i < n; i++) {
    if (prv_addr_eq(&key->sec.peer_addr, &arr[i].peer_addr)) {
      if (obj_type == BLE_STORE_OBJ_TYPE_OUR_SEC) {
        arr[i] = arr[--s_our_sec_n];
      } else {
        arr[i] = arr[--s_peer_sec_n];
      }
      return 0;
    }
  }
  return BLE_HS_ENOENT;
}

void ram_store_init(void) {
  ble_hs_cfg.store_read_cb = prv_read;
  ble_hs_cfg.store_write_cb = prv_write;
  ble_hs_cfg.store_delete_cb = prv_delete;
}
```

## src/sifli_lrc_glue.c
```c
/* SPDX-FileCopyrightText: 2026 Core Devices LLC */
/* SPDX-License-Identifier: Apache-2.0 */

#include <stdarg.h>
#include <stdint.h>

#include <bf0_hal.h>
/* bf0_hal.h and Zephyr define IS_ALIGNED with opposite argument order. */
#undef IS_ALIGNED
#include <zephyr/kernel.h>

/* SiFli's IPC timeout loops use HAL_GetTick(). The module's weak default is
 * backed by uwTick, which Zephyr does not advance with NONE_HAL_TICK_INIT.
 */
uint32_t HAL_GetTick(void) {
  return k_uptime_get_32();
}

/* SiFli's weak HAL_Delay_us() picks HAL_Delay_us2_() whenever SysTick is
 * enabled -- which it always is under Zephyr -- and that path derives its busy
 * window from SysTick->LOAD and the SDK's HAL_TICK_PER_SECOND. Zephyr programs
 * SysTick for its own (tickless) kernel, so that assumption is wrong and every
 * delay stretches by ~1000x. The RF full calibration (bt_ful_cal) issues many
 * such delays, so LCPU bring-up took ~20s instead of ms and looked hung. Back
 * the delay with Zephyr's calibrated busy-wait instead.
 */
void HAL_Delay_us(uint32_t us) {
  k_busy_wait(us);
}

void HAL_DBG_printf(const char *fmt, ...) {
  (void)fmt;
}

void HAL_Set_backup(uint8_t idx, uint32_t value) {
  volatile uint32_t *backup = &hwp_rtc->BKP0R;

  backup[idx] = value;
}

uint32_t HAL_Get_backup(uint8_t idx) {
  volatile uint32_t *backup = &hwp_rtc->BKP0R;

  return backup[idx];
}
```
