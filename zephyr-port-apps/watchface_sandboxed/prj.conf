## CMakeLists.txt
```
# SPDX-License-Identifier: Apache-2.0

cmake_minimum_required(VERSION 3.20.0)

set(USER_CACHE_DIR "${CMAKE_BINARY_DIR}/.cache" CACHE PATH "Zephyr cache directory")
find_package(Zephyr REQUIRED HINTS $ENV{ZEPHYR_BASE})
project(pebbleos_zephyr_watchface_sandboxed)

get_filename_component(PEBBLEOS_ROOT "${CMAKE_CURRENT_SOURCE_DIR}/../.." ABSOLUTE)


option(WATCHFACE_ASCII_PREVIEW "Print an ASCII framebuffer preview on every tick" OFF)

set(GFX "${PEBBLEOS_ROOT}/src/fw/applib/graphics")
string(TIMESTAMP WATCHFACE_BUILD_EPOCH "%s" UTC)

# tick_timer_service.c is copied just as the S1 app does.  Keeping the generated
# copy out of the source tree avoids colliding with PebbleOS's SDK export build.
configure_file(
  "${PEBBLEOS_ROOT}/src/fw/applib/tick_timer_service.c"
  "${CMAKE_CURRENT_BINARY_DIR}/tick_timer_service.c"
  COPYONLY
)

target_include_directories(app PRIVATE
  "${CMAKE_CURRENT_SOURCE_DIR}/include"
  "${PEBBLEOS_ROOT}/zephyr-port-apps/kernel/include"
  "${PEBBLEOS_ROOT}/zephyr-port-apps/gfx/include"
  "${PEBBLEOS_ROOT}/zephyr-port-apps/loader/src"
  "${PEBBLEOS_ROOT}/src/fw"
  "${PEBBLEOS_ROOT}/src/fw/applib/vendor/uPNG"
  "${PEBBLEOS_ROOT}/include"
  "${CMAKE_BINARY_DIR}/include/generated"
)

target_compile_definitions(app PRIVATE
  CONFIG_BOARD_OBELIX_PVT=1
  CONFIG_PLATFORM_EMERY=1
  CONFIG_SCREEN_COLOR_DEPTH_BITS=8
  CONFIG_SOC_SF32LB52=1
  CONFIG_TASK_TIMER_POOL_SIZE=8
  KERNEL_BUILD_EPOCH=${WATCHFACE_BUILD_EPOCH}
  PBL_WTF_CONTEXT=1
)

if(WATCHFACE_ASCII_PREVIEW)
  target_compile_definitions(app PRIVATE WATCHFACE_ASCII_PREVIEW=1)
endif()

target_compile_options(app PRIVATE
  -include string.h
  -Wno-address-of-packed-member
)

target_sources(app PRIVATE
  src/main.c
  src/port.c
  src/sandbox.c
  src/sandbox_bridge.c
  src/sliding_text_emery_resources.c

  # S1: timer spine (the runtime is integration-specific and lives in port.c).
  "${PEBBLEOS_ROOT}/zephyr-port-apps/kernel/src/new_timer_zephyr.c"
  "${PEBBLEOS_ROOT}/lib/os/mutex_zephyr.c"
  "${PEBBLEOS_ROOT}/lib/os/platform_zephyr.c"
  "${PEBBLEOS_ROOT}/lib/os/semaphore_zephyr.c"
  "${PEBBLEOS_ROOT}/lib/os/tick_zephyr.c"
  "${PEBBLEOS_ROOT}/lib/util/list.c"
  "${PEBBLEOS_ROOT}/src/fw/kernel/task_timer.c"
  "${PEBBLEOS_ROOT}/src/fw/services/regular_timer/service.c"
  "${PEBBLEOS_ROOT}/src/fw/services/tick_timer/service.c"
  "${CMAKE_CURRENT_BINARY_DIR}/tick_timer_service.c"

  # S3: real Pebble framebuffer, graphics, text, and UI-layer implementations.
  "${GFX}/8_bit/bitblt_private.c"
  "${GFX}/8_bit/framebuffer.c"
  "${GFX}/arabic_shaping.c"
  "${GFX}/bitblt.c"
  "${GFX}/framebuffer.c"
  "${GFX}/gbitmap.c"
  "${GFX}/gcolor_definitions.c"
  "${GFX}/graphics.c"
  "${GFX}/graphics_circle.c"
  "${GFX}/graphics_line.c"
  "${GFX}/graphics_private.c"
  "${GFX}/graphics_private_raw.c"
  "${GFX}/gtransform.c"
  "${GFX}/gtypes.c"
  "${GFX}/perimeter.c"
  "${GFX}/rtl_support.c"
  "${GFX}/text_layout.c"
  "${GFX}/text_render.c"
  "${GFX}/text_resources.c"
  "${GFX}/utf8.c"
  "${PEBBLEOS_ROOT}/src/fw/applib/fonts/codepoint.c"
  "${PEBBLEOS_ROOT}/src/fw/applib/ui/layer.c"
  "${PEBBLEOS_ROOT}/src/fw/applib/ui/text_layer.c"
  "${PEBBLEOS_ROOT}/lib/util/crc32.c"
  "${PEBBLEOS_ROOT}/lib/util/keyed_circular_cache.c"
  "${PEBBLEOS_ROOT}/lib/util/iterator.c"
  "${PEBBLEOS_ROOT}/lib/util/trig.c"

  # S4: the exact PBW blob and its production checksum implementation.
  "${PEBBLEOS_ROOT}/zephyr-port-apps/loader/src/sliding_text_emery_bin.c"
  "${PEBBLEOS_ROOT}/src/fw/util/legacy_checksum.c"
)

zephyr_linker_sources(ROM_SECTIONS src/sandbox_syscalls.ld)

set_source_files_properties(
  "${PEBBLEOS_ROOT}/src/fw/kernel/task_timer.c"
  "${PEBBLEOS_ROOT}/src/fw/services/regular_timer/service.c"
  PROPERTIES COMPILE_OPTIONS "-include;pbl/drivers/rtc.h"
)

# The app's Gotham fonts come from its embedded Emery resource pack. Keep a
# system Gothic 14 font for TextLayer's default/fallback font.
generate_inc_file_for_target(app
  "${PEBBLEOS_ROOT}/resources/common/base/pbf/GOTHIC_14.pbf"
  "${CMAKE_BINARY_DIR}/include/generated/watchface_font_small.pbf.inc"
)
```

## prj.conf
```kconfig
CONFIG_ASSERT=y
CONFIG_BOOT_BANNER=n
CONFIG_CONSOLE=y
CONFIG_DISPLAY=y
CONFIG_SF32LB_JDI=y
CONFIG_HEAP_MEM_POOL_SIZE=4096
CONFIG_LOG=y
CONFIG_DISPLAY_LOG_LEVEL_INF=y
CONFIG_MAIN_STACK_SIZE=2048
CONFIG_PRINTK=y
CONFIG_RTC=y
CONFIG_SERIAL=y
CONFIG_UART_CONSOLE=y

# The PBW runs in an app-owned RWX MPU region. Firmware SRAM remains
# privileged-only; the custom hooks switch the app map and service svc #4.
CONFIG_ARM_MPU=y
CONFIG_ARM_CUSTOM_SVC_HOOK=y
CONFIG_ARM_CUSTOM_THREAD_RESTORE_HOOK=y
CONFIG_USERSPACE=n
CONFIG_LOG_MODE_IMMEDIATE=y
```

## boards/pt2.overlay
```dts
/* SPDX-License-Identifier: Apache-2.0 */

&rtc {
	status = "okay";
};
```

## src/main.c
```c
/* SPDX-License-Identifier: Apache-2.0 */

#include <errno.h>
#include <inttypes.h>
#include <stdbool.h>
#include <stddef.h>
#include <stdint.h>
#include <string.h>

#include <zephyr/cache.h>
#include <zephyr/device.h>
#include <zephyr/drivers/display.h>
#include <zephyr/kernel.h>
#include <zephyr/sys/printk.h>

#include "applib/tick_timer_service_private.h"
#include "pbl/services/new_timer/new_timer_service.h"
#include "pbl/services/regular_timer.h"
#include "process_management/pebble_process_info.h"
#include "sandbox.h"
#include "sandbox_bridge.h"
#include "sliding_text_emery_bin.h"
#include "util/legacy_checksum.h"
#include "watchface_port.h"

#define APP_STACK_SIZE 8192U
#define APP_PRIORITY 6
#define KERNEL_STACK_SIZE 3072
#define KERNEL_PRIORITY 5

_Static_assert(sizeof(PebbleProcessInfo) == 130U, "PebbleProcessInfo v16 ABI changed");

#define s_app_segment g_sandbox_app_arena.app_segment

static struct k_thread s_kernel_thread;
static struct k_thread s_app_thread;
static const struct device *const s_display = DEVICE_DT_GET(DT_CHOSEN(zephyr_display));
static const uint8_t *s_framebuffer;
static struct display_buffer_descriptor s_display_desc;
static bool s_display_ready;
static K_THREAD_STACK_DEFINE(s_kernel_stack, KERNEL_STACK_SIZE);
static struct z_thread_stack_element __kstackmem __aligned(32)
    s_app_stack[K_KERNEL_STACK_LEN(APP_STACK_SIZE)];

static bool prv_range_fits(size_t offset, size_t size, size_t limit) {
  return offset <= limit && size <= limit - offset;
}

static bool prv_validate_header(const PebbleProcessInfo *info, size_t blob_size,
                                size_t *stored_size_out) {
  const size_t header_size = sizeof(*info);
  const size_t reloc_size = (size_t)info->num_reloc_entries * sizeof(uint32_t);

  if (memcmp(info->header, "PBLAPP\0\0", sizeof(info->header)) != 0 ||
      info->struct_version.major != PROCESS_INFO_CURRENT_STRUCT_VERSION_MAJOR ||
      (info->flags & PROCESS_INFO_PLATFORM_MASK) != PROCESS_INFO_PLATFORM_EMERY) {
    printk("WATCHFACE_LOAD_FAIL header\n");
    return false;
  }
  if (info->load_size < header_size || info->load_size > info->virtual_size ||
      info->virtual_size > SANDBOX_APP_SEGMENT_CAPACITY ||
      !prv_range_fits(info->load_size, reloc_size, blob_size) ||
      !prv_range_fits(info->load_size, reloc_size, sizeof(s_app_segment))) {
    printk("WATCHFACE_LOAD_FAIL size load=%" PRIu32 " virtual=%" PRIu32 "\n",
           info->load_size, info->virtual_size);
    return false;
  }
  if ((info->offset & 1U) != 0U || info->offset < header_size ||
      !prv_range_fits(info->offset, sizeof(uint16_t), info->load_size) ||
      (info->sym_table_addr & 3U) != 0U || info->sym_table_addr < header_size ||
      !prv_range_fits(info->sym_table_addr, sizeof(uint32_t), info->virtual_size)) {
    printk("WATCHFACE_LOAD_FAIL entry\n");
    return false;
  }

  *stored_size_out = info->load_size + reloc_size;
  return true;
}

static bool prv_apply_relocations(const PebbleProcessInfo *info) {
  uint8_t *reloc_table = s_app_segment + info->load_size;

  for (uint32_t i = 0; i < info->num_reloc_entries; ++i) {
    uint32_t reloc_offset;
    uint32_t relative_value;
    memcpy(&reloc_offset, reloc_table + i * sizeof(reloc_offset), sizeof(reloc_offset));
    if (reloc_offset < sizeof(*info) ||
        !prv_range_fits(reloc_offset, sizeof(relative_value), info->load_size)) {
      printk("WATCHFACE_LOAD_FAIL relocation[%" PRIu32 "] target\n", i);
      return false;
    }
    memcpy(&relative_value, s_app_segment + reloc_offset, sizeof(relative_value));
    if (relative_value > info->virtual_size) {
      printk("WATCHFACE_LOAD_FAIL relocation[%" PRIu32 "] value\n", i);
      return false;
    }
    const uint32_t relocated = (uint32_t)(uintptr_t)(s_app_segment + relative_value);
    memcpy(s_app_segment + reloc_offset, &relocated, sizeof(relocated));
  }

  memset(reloc_table, 0, (size_t)info->num_reloc_entries * sizeof(uint32_t));
  return true;
}

static bool prv_load_pbw(PebbleProcessInfo *info_out) {
  PebbleProcessInfo info;
  size_t stored_size;

  if (sliding_text_emery_pbw_len < sizeof(info)) {
    return false;
  }
  memcpy(&info, sliding_text_emery_pbw, sizeof(info));
  if (!prv_validate_header(&info, sliding_text_emery_pbw_len, &stored_size)) {
    return false;
  }

  const uint32_t crc = legacy_defective_checksum_memory(
      sliding_text_emery_pbw + sizeof(info), info.load_size - sizeof(info));
  if (crc != info.crc) {
    printk("WATCHFACE_LOAD_FAIL crc=0x%08" PRIx32 " expected=0x%08" PRIx32 "\n",
           crc, info.crc);
    return false;
  }

  memset(s_app_segment, 0, sizeof(s_app_segment));
  memcpy(s_app_segment, sliding_text_emery_pbw, stored_size);
  if (!prv_apply_relocations(&info)) {
    return false;
  }

  const uint32_t jump_table = (uint32_t)(uintptr_t)g_sandbox_system_tbl;
  memcpy(s_app_segment + info.sym_table_addr, &jump_table, sizeof(jump_table));

  (void)sys_cache_data_flush_range(s_app_segment, info.virtual_size);
  (void)sys_cache_instr_invd_range(s_app_segment, info.virtual_size);

  *info_out = info;
  printk("WATCHFACE_LOADED entry=0x%08" PRIx32 " reloc=%" PRIu32 "\n",
         info.offset, info.num_reloc_entries);
  return true;
}

static void prv_kernel_main(void *arg1, void *arg2, void *arg3) {
  ARG_UNUSED(arg1);
  ARG_UNUSED(arg2);
  ARG_UNUSED(arg3);

  printk("WATCHFACE_KERNEL_UP\n");
  while (true) {
    PebbleEvent event;
    if (watchface_port_take_kernel_event(&event)) {
      watchface_port_dispatch_kernel_event(&event);
    }
  }
}

static void prv_app_main(void *arg1, void *arg2, void *arg3) {
  ARG_UNUSED(arg2);
  ARG_UNUSED(arg3);

  int (*entry)(void) = arg1;
  sandbox_app_runtime_init();
  sandbox_mpu_readback();
  const int probe_result = sandbox_syscall_probe(21);
  (void)sandbox_syscall_probe(probe_result);
  sandbox_app_step(SandboxStepAppEntry, (uintptr_t)entry);
  (void)entry();
  for (;;) {
    __WFE();
  }
}

void watchface_port_push_frame(void) {
  if (!s_display_ready) {
    return;
  }

  const int ret = display_write(s_display, 0U, 0U, &s_display_desc, s_framebuffer);
  if (ret != 0) {
    printk("DISPLAY_PUSH_FAIL %d\n", ret);
    return;
  }
  printk("DISPLAY_PUSH ok\n");
  printk("DISPLAY_PUSH_EOF\n");
}

int main(void) {
  printk("SANDBOX_BOOT\n");
  memset(&g_sandbox_app_arena, 0, sizeof(g_sandbox_app_arena));
  printk("SANDBOX_ARENA_OK %p+%zu\n", &g_sandbox_app_arena,
         sizeof(g_sandbox_app_arena));
  watchface_port_graphics_init();
  size_t framebuffer_size;
  uint16_t framebuffer_stride;
  const uint8_t *framebuffer =
      watchface_framebuffer_bytes(&framebuffer_size, &framebuffer_stride);
  printk("WATCHFACE_FB %p size=%zu stride=%u ARGB2222\n", framebuffer,
         framebuffer_size, framebuffer_stride);
  s_framebuffer = framebuffer;
  s_display_desc = (struct display_buffer_descriptor){
      .buf_size = framebuffer_size,
      .width = framebuffer_stride,
      .height = framebuffer_size / framebuffer_stride,
      .pitch = framebuffer_stride,
  };
  if (!device_is_ready(s_display)) {
    printk("DISPLAY_PUSH_FAIL %d\n", -ENODEV);
  } else {
    const int ret = display_blanking_off(s_display);
    if (ret != 0) {
      printk("DISPLAY_PUSH_FAIL %d\n", ret);
    } else {
      s_display_ready = true;
    }
  }
  new_timer_service_init();
  regular_timer_init();

  PebbleProcessInfo info;
  if (!prv_load_pbw(&info)) {
    printk("SANDBOX_LOAD_FAIL\n");
    return 0;
  }
  int (*entry)(void) =
      (int (*)(void))((uintptr_t)(s_app_segment + info.offset) | 1U);

  watchface_port_set_threads(&s_kernel_thread, &s_app_thread);
  k_thread_create(&s_kernel_thread, s_kernel_stack, K_THREAD_STACK_SIZEOF(s_kernel_stack),
                  prv_kernel_main, NULL, NULL, NULL, KERNEL_PRIORITY, 0, K_FOREVER);
  k_thread_name_set(&s_kernel_thread, "KernelMain");
  const size_t app_stack_size = K_KERNEL_STACK_SIZEOF(s_app_stack);
  k_thread_create(&s_app_thread, s_app_stack, app_stack_size, prv_app_main,
                  entry, NULL, NULL, APP_PRIORITY, 0, K_FOREVER);
  k_thread_name_set(&s_app_thread, "PebbleAppSandbox");
  if (!sandbox_prepare(&s_app_thread,
                       (uintptr_t)K_KERNEL_STACK_BUFFER(s_app_stack),
                       app_stack_size)) {
    return 0;
  }
  k_thread_start(&s_kernel_thread);
  sandbox_arm();
  k_thread_start(&s_app_thread);
  return 0;
}
```

## include/font_resource_keys.auto.h
```c
/* SPDX-License-Identifier: Apache-2.0 */
#pragma once

// The port serves a single system font for every key (watchface port.c's
// fonts_get_system_font ignores the key), so the string values are nominal.
#define FONT_KEY_GOTHIC_14 "RESOURCE_ID_GOTHIC_14"
#define FONT_KEY_GOTHIC_14_BOLD "RESOURCE_ID_GOTHIC_14_BOLD"
#define FONT_KEY_GOTHIC_18 "RESOURCE_ID_GOTHIC_18"
#define FONT_KEY_GOTHIC_18_BOLD "RESOURCE_ID_GOTHIC_18_BOLD"
#define FONT_KEY_GOTHIC_24 "RESOURCE_ID_GOTHIC_24"
#define FONT_KEY_GOTHIC_24_BOLD "RESOURCE_ID_GOTHIC_24_BOLD"
#define FONT_KEY_GOTHIC_28 "RESOURCE_ID_GOTHIC_28"
#define FONT_KEY_GOTHIC_28_BOLD "RESOURCE_ID_GOTHIC_28_BOLD"

#define FONT_KEY_GOTHIC_36 "RESOURCE_ID_GOTHIC_36"
#define FONT_KEY_GOTHIC_36_BOLD "RESOURCE_ID_GOTHIC_36_BOLD"
#define FONT_KEY_LECO_20_BOLD_NUMBERS "RESOURCE_ID_LECO_20_BOLD_NUMBERS"
#define FONT_KEY_LECO_26_BOLD_NUMBERS_AM_PM "RESOURCE_ID_LECO_26_BOLD_NUMBERS_AM_PM"
#define FONT_KEY_LECO_38_BOLD_NUMBERS "RESOURCE_ID_LECO_38_BOLD_NUMBERS"
```

## include/sandbox.h
```c
/* SPDX-License-Identifier: Apache-2.0 */
#pragma once

#include <stdbool.h>
#include <stddef.h>
#include <stdint.h>
#include <time.h>

#include <zephyr/kernel.h>

#define SANDBOX_APP_SEGMENT_CAPACITY 65536U
// Sized for the fw shell: real dialogs/pickers/fonts all allocate here
// (16K exhausted silently once the settings pickers landed).
#define SANDBOX_APP_HEAP_SIZE 81920U

typedef struct {
  uint8_t app_segment[SANDBOX_APP_SEGMENT_CAPACITY];
  uint8_t app_heap[SANDBOX_APP_HEAP_SIZE];
  struct tm localtime_result;
  uint8_t mpu_tail[32];
} SandboxAppArena;

extern SandboxAppArena g_sandbox_app_arena;

bool sandbox_prepare(struct k_thread *app_thread, uintptr_t stack_start,
                     size_t stack_size);
void sandbox_arm(void);
void sandbox_disarm(void);
void sandbox_dump_active_mpu(void);
bool sandbox_userspace_buffer_is_valid(const void *buffer, size_t size);
bool sandbox_thread_is_unprivileged(void);
```

## include/sandbox_bridge.h
```c
/* SPDX-License-Identifier: Apache-2.0 */
#pragma once

#include <stdint.h>

typedef enum {
  SandboxStepAppEntry,
  SandboxStepWindowCreate,
  SandboxStepTextLayerCreate,
  SandboxStepTickSubscribe,
  SandboxStepWindowStackPush,
  SandboxStepEventLoop,
  SandboxStepWaitTick,
  SandboxStepTickHandler,
  SandboxStepRender,
  SandboxStepCount,
} SandboxStep;

int sandbox_syscall_probe(int value);
void sandbox_app_runtime_init(void);
void sandbox_mpu_readback(void);
void sandbox_app_step(SandboxStep step, uintptr_t detail);
void sandbox_app_event_loop(void);
```

## include/sandbox_port.h
```c
/* SPDX-License-Identifier: Apache-2.0 */
#pragma once

#include <stdbool.h>
#include <stdint.h>
#include <time.h>

#include "applib/tick_timer_service.h"
#include "applib/ui/layer.h"

bool watchface_port_wait_tick(struct tm *tick_time, TimeUnits *units_changed,
                              TickHandler *handler, time_t *timestamp);
void watchface_port_render_tick(time_t timestamp);
int32_t watchface_port_time(int32_t *tloc);
struct tm *watchface_port_localtime(const int32_t *timep);
GRect watchface_layer_get_unobstructed_bounds_by_value(const Layer *layer);
#if defined(PBL_WATCHFACE_IN_FW)
void watchface_port_tick_subscribe(TimeUnits tick_units, TickHandler handler);
void watchface_port_tick_unsubscribe(void);
#endif
```

## include/sandbox_syscall.h
```c
/* SPDX-License-Identifier: Apache-2.0 */
#pragma once

#include "pbl/util/attributes.h"

void sandbox_syscall_maybe_skip_privilege(void);

#define DEFINE_SYSCALL(ret_type, function_name, ...)                              \
  ret_type NAKED_FUNC USED SECTION(".sandbox_syscall_text." #function_name)       \
      function_name(__VA_ARGS__) {                                                \
    __asm volatile(                                                               \
        "push {lr}\n"                                                           \
        "bl sandbox_syscall_maybe_skip_privilege\n"                             \
        "svc #4\n"                                                              \
        "b __" #function_name "\n");                                           \
  }                                                                               \
  ret_type EXTERNALLY_VISIBLE USED __##function_name(__VA_ARGS__)
```

## include/sliding_text_emery_resources.h
```c
/* SPDX-License-Identifier: Apache-2.0 */

#pragma once

#include <stddef.h>
#include <stdint.h>

extern const uint8_t sliding_text_emery_resources[];
extern const size_t sliding_text_emery_resources_len;
```

## include/watchface_port.h
```c
/* SPDX-License-Identifier: Apache-2.0 */
#pragma once

#include <stdbool.h>
#include <stddef.h>
#include <stdint.h>

#include <zephyr/kernel.h>

#include "kernel/events.h"

extern const void *const g_sandbox_system_tbl[626];

void watchface_port_set_threads(struct k_thread *kernel_thread, struct k_thread *app_thread);
void watchface_port_graphics_init(void);
void watchface_port_app_state_init(void);
void watchface_port_push_frame(void);
bool watchface_port_take_kernel_event(PebbleEvent *event);
void watchface_port_dispatch_kernel_event(PebbleEvent *event);
void watchface_start_fallback(void);

uint8_t *watchface_framebuffer_bytes(size_t *size_out, uint16_t *stride_out);
```

## src/sandbox.c
```c
/* SPDX-License-Identifier: Apache-2.0 */

#include "sandbox.h"
#include "sandbox_syscall.h"

#include <zephyr/arch/arm/custom_sandbox_hooks.h>
#include <zephyr/arch/arm/mpu/arm_mpu.h>
#include <zephyr/fatal.h>
#include <zephyr/linker/linker-defs.h>
#include <zephyr/sys/atomic.h>
#include <zephyr/sys/printk.h>
#include <zephyr/sys/util.h>
#include <zephyr/toolchain.h>

#include <cmsis_core.h>
#include <stddef.h>
#include <stdint.h>

#define MPU_MIN_ALIGN 32U
#define SVC_EXC_RETURN_PSP BIT(2)
#define SVC_EXC_RETURN_BASIC_FRAME BIT(4)
#define XPSR_STACK_ALIGN BIT(9)
SandboxAppArena g_sandbox_app_arena __aligned(MPU_MIN_ALIGN);

static struct k_thread *s_app_thread;
static uintptr_t s_stack_start;
static size_t s_stack_size;
static uintptr_t s_arena_start;
static size_t s_arena_size;
static uint8_t s_ram_region;
static uint8_t s_stack_region;
static uint8_t s_code_region;
static uint32_t s_saved_ram_rbar;
static uint32_t s_saved_ram_rlar;
static uint32_t s_saved_stack_rbar;
static uint32_t s_saved_stack_rlar;
static uint32_t s_saved_code_rbar;
static uint32_t s_saved_code_rlar;
static uint32_t s_app_code_rbar;
static uint32_t s_app_code_rlar;
static bool s_code_region_needed;
static atomic_t s_sandbox_ready;
static atomic_t s_syscall_active;
static uintptr_t s_app_return_address;

extern const uint8_t __sandbox_syscall_start[];
extern const uint8_t __sandbox_syscall_end[];

static void prv_mpu_region_read(uint8_t region, uint32_t *rbar,
                                uint32_t *rlar) {
  MPU->RNR = region;
  *rbar = MPU->RBAR;
  *rlar = MPU->RLAR;
}

static void prv_mpu_region_write(uint8_t region, uint32_t rbar,
                                 uint32_t rlar) {
  __DMB();
  MPU->RNR = region;
  MPU->RBAR = rbar;
  MPU->RLAR = rlar;
  __DSB();
  __ISB();
}

// Raw region write with no barriers; only valid while the MPU is disabled
// (see prv_mpu_batch_begin/end). Reprogramming several regions with the MPU
// enabled forces a pipeline refetch after each write under a transiently
// inconsistent map, which faults; disabling the MPU for the batch uses the
// privileged default map (all code executable) until the full new map is in.
static void prv_mpu_region_write_raw(uint8_t region, uint32_t rbar,
                                     uint32_t rlar) {
  MPU->RNR = region;
  MPU->RBAR = rbar;
  MPU->RLAR = rlar;
}

static uint32_t prv_mpu_batch_begin(void) {
  const uint32_t ctrl = MPU->CTRL;
  __DMB();
  MPU->CTRL = 0U;
  __DSB();
  __ISB();
  return ctrl;
}

static void prv_mpu_batch_end(uint32_t ctrl) {
  __DSB();
  MPU->CTRL = ctrl;
  __DSB();
  __ISB();
}

static void prv_mpu_dump(void) {
  const uint8_t regions =
      (MPU->TYPE & MPU_TYPE_DREGION_Msk) >> MPU_TYPE_DREGION_Pos;

  printk("SANDBOX_FAULT_MPU ctrl=0x%08x type=0x%08x mair0=0x%08x "
         "mair1=0x%08x\n",
         MPU->CTRL, MPU->TYPE, MPU->MAIR0, MPU->MAIR1);
  for (uint8_t i = 0U; i < regions; ++i) {
    uint32_t rbar;
    uint32_t rlar;
    prv_mpu_region_read(i, &rbar, &rlar);
    printk("SANDBOX_FAULT_MPU region=%u rbar=0x%08x rlar=0x%08x "
           "base=0x%08x limit=0x%08x ap=%u xn=%u attr=%u en=%u\n",
           i, rbar, rlar, (uint32_t)(rbar & MPU_RBAR_BASE_Msk),
           (uint32_t)((rlar & MPU_RLAR_LIMIT_Msk) | (MPU_MIN_ALIGN - 1U)),
           (unsigned int)((rbar & MPU_RBAR_AP_Msk) >> MPU_RBAR_AP_Pos),
           (unsigned int)((rbar & MPU_RBAR_XN_Msk) != 0U),
           (unsigned int)((rlar & MPU_RLAR_AttrIndx_Msk) >>
                          MPU_RLAR_AttrIndx_Pos),
           (unsigned int)((rlar & MPU_RLAR_EN_Msk) != 0U));
  }
}

void k_sys_fatal_error_handler(unsigned int reason,
                               const struct arch_esf *esf) {
  const uint32_t cfsr = SCB->CFSR;
  const uint32_t pc = esf ? esf->basic.pc : 0U;
  const uint32_t lr = esf ? esf->basic.lr : 0U;
  const uint32_t xpsr = esf ? esf->basic.xpsr : 0U;

  printk("SANDBOX_FATAL reason=%u thread=%p control=0x%08x msp=0x%08x "
         "psp=0x%08x psplim=0x%08x\n",
         reason, k_current_get(), __get_CONTROL(), __get_MSP(), __get_PSP(),
         __get_PSPLIM());
  printk("SANDBOX_FAULT cfsr=0x%08x hfsr=0x%08x mmfar=0x%08x "
         "mmfar_valid=%u bfar=0x%08x bfar_valid=%u pc=0x%08x lr=0x%08x "
         "xpsr=0x%08x\n",
         cfsr, SCB->HFSR, SCB->MMFAR,
         (cfsr & SCB_CFSR_MMARVALID_Msk) != 0U, SCB->BFAR,
         (cfsr & SCB_CFSR_BFARVALID_Msk) != 0U, pc, lr, xpsr);
  prv_mpu_dump();
  // Faulting thread's stack: return addresses in the code image give a
  // backtrace via addr2line without a debugger on the rig.
  {
    const uint32_t *sp = (const uint32_t *)__get_PSP();
    for (int row = 0; row < 12; ++row) {
      printk("SANDBOX_STACK %08x: %08x %08x %08x %08x %08x %08x %08x %08x\n",
             (unsigned)(uintptr_t)(sp + row * 8), (unsigned)sp[row * 8], (unsigned)sp[row * 8 + 1],
             (unsigned)sp[row * 8 + 2], (unsigned)sp[row * 8 + 3], (unsigned)sp[row * 8 + 4],
             (unsigned)sp[row * 8 + 5], (unsigned)sp[row * 8 + 6], (unsigned)sp[row * 8 + 7]);
    }
  }

  if (reason == K_ERR_KERNEL_PANIC || k_current_get() != s_app_thread) {
    k_fatal_halt(reason);
  }
}

static bool prv_region_contains(uint32_t rbar, uint32_t rlar, uintptr_t start,
                                size_t size) {
  const uintptr_t base = rbar & MPU_RBAR_BASE_Msk;
  const uintptr_t limit =
      (rlar & MPU_RLAR_LIMIT_Msk) | (MPU_MIN_ALIGN - 1U);

  return size != 0U && (rlar & MPU_RLAR_EN_Msk) != 0U && start >= base &&
         start <= UINTPTR_MAX - (size - 1U) && start + size - 1U <= limit;
}

static bool prv_region_is_user_executable(uint32_t rbar, uint32_t rlar,
                                          uintptr_t start, size_t size) {
  const uint32_t ap =
      (rbar & MPU_RBAR_AP_Msk) >> MPU_RBAR_AP_Pos;

  return prv_region_contains(rbar, rlar, start, size) &&
         (rbar & MPU_RBAR_XN_Msk) == 0U &&
         (ap == P_RW_U_RW || ap == P_RO_U_RO);
}

void sandbox_dump_active_mpu(void) {
  uint32_t rbar;
  uint32_t rlar;

  prv_mpu_region_read(s_ram_region, &rbar, &rlar);
  printk("SANDBOX_MPU_ACTIVE arena_region=%u rbar=0x%08x rlar=0x%08x "
         "ap=%u xn=%u user_exec=%u control=0x%08x\n",
         s_ram_region, rbar, rlar,
         (unsigned int)((rbar & MPU_RBAR_AP_Msk) >> MPU_RBAR_AP_Pos),
         (unsigned int)((rbar & MPU_RBAR_XN_Msk) != 0U),
         prv_region_is_user_executable(rbar, rlar, s_arena_start,
                                       s_arena_size),
         __get_CONTROL());
}

static bool prv_ranges_overlap(uintptr_t first_start, size_t first_size,
                               uintptr_t second_start, size_t second_size) {
  return first_size != 0U && second_size != 0U &&
         first_start <= UINTPTR_MAX - first_size &&
         second_start <= UINTPTR_MAX - second_size &&
         first_start < second_start + second_size &&
         second_start < first_start + first_size;
}

static bool prv_range_contains(uintptr_t base, size_t extent,
                               const void *buffer, size_t size) {
  const uintptr_t address = (uintptr_t)buffer;

  if (size == 0U) {
    return address >= base && address <= base + extent;
  }
  return address >= base && address <= UINTPTR_MAX - size &&
         address + size <= base + extent;
}

bool sandbox_userspace_buffer_is_valid(const void *buffer, size_t size) {
  return prv_range_contains(s_arena_start, s_arena_size, buffer, size) ||
         prv_range_contains(s_stack_start, s_stack_size, buffer, size);
}

bool sandbox_thread_is_unprivileged(void) {
  return (__get_CONTROL() & CONTROL_nPRIV_Msk) != 0U;
}

static bool __attribute__((noinline, used)) prv_thread_is_privileged(void) {
  return !sandbox_thread_is_unprivileged();
}

void __attribute__((naked, used)) sandbox_syscall_maybe_skip_privilege(void) {
  __asm volatile(
      "push {r0-r3, lr}\n"
      "bl prv_thread_is_privileged\n"
      "cmp r0, #1\n"
      "pop {r0-r3, lr}\n"
      "it eq\n"
      "addeq lr, #2\n"
      "mov ip, lr\n"
      "pop {lr}\n"
      "push {ip}\n"
      "pop {pc}\n");
}

static uintptr_t __attribute__((noinline, used)) prv_syscall_exit(void) {
  atomic_clear(&s_syscall_active);
  return s_app_return_address;
}

static void __attribute__((naked, used)) prv_drop_privilege(void) {
  __asm volatile(
      "push {r0, r1}\n"
      "bl prv_syscall_exit\n"
      "mov r12, r0\n"
      "pop {r0, r1}\n"
      "mrs r2, control\n"
      "orr r2, r2, #1\n"
      "msr control, r2\n"
      "isb\n"
      "bx r12\n");
}

// Privileged PBW execution (fw_pbw_runner.c): the app segment lives in SRAM,
// which Zephyr maps execute-never. ARMv8-M faults on overlapping regions, so
// (like the sandbox's app-thread branch) the SRAM region that covers the
// arena is narrowed to the arena with XN clear; privileged accesses to the
// rest of SRAM fall back to the default map (PRIVDEFENA). Zephyr rewrites
// the dynamic regions on every switch, hence the re-arm from the restore hook.
static bool s_arena_exec;
static uint8_t s_arena_exec_region;

static void prv_write_arena_exec_region(void) {
  const uintptr_t arena_start = (uintptr_t)&g_sandbox_app_arena;
  const size_t arena_size = sizeof(g_sandbox_app_arena);
  const uint32_t rbar = arena_start & MPU_RBAR_BASE_Msk;  // AP=0: privileged RW, XN clear
  const uint32_t rlar = ((arena_start + arena_size - 1U) & MPU_RLAR_LIMIT_Msk) |
                        (MPU_MAIR_INDEX_SRAM << MPU_RLAR_AttrIndx_Pos) | MPU_RLAR_EN_Msk;
  const uint32_t ctrl = prv_mpu_batch_begin();
  prv_mpu_region_write_raw(s_arena_exec_region, rbar, rlar);
  prv_mpu_batch_end(ctrl);
}

bool sandbox_arena_exec_enable(void) {
  if (s_arena_exec) {
    return true;
  }
  const uintptr_t arena_start = (uintptr_t)&g_sandbox_app_arena;
  const uint8_t regions = (uint8_t)((MPU->TYPE & MPU_TYPE_DREGION_Msk) >> MPU_TYPE_DREGION_Pos);
  for (uint8_t i = 0U; i < regions; ++i) {
    uint32_t rbar, rlar;
    prv_mpu_region_read(i, &rbar, &rlar);
    if (prv_region_contains(rbar, rlar, arena_start, sizeof(g_sandbox_app_arena))) {
      s_arena_exec_region = i;
      s_arena_exec = true;
      prv_write_arena_exec_region();
      __ISB();
      printk("SANDBOX_ARENA_EXEC region=%u base=%p size=%u\n", i, (void *)arena_start,
             (unsigned)sizeof(g_sandbox_app_arena));
      return true;
    }
  }
  printk("SANDBOX_ARENA_EXEC_FAIL no region covers the arena\n");
  return false;
}

void z_arm_custom_thread_restore_hook(struct k_thread *incoming) {
  if (s_arena_exec) {
    prv_write_arena_exec_region();
    __ISB();
  }
  if (!atomic_get(&s_sandbox_ready)) {
    return;
  }

  const uint32_t control = __get_CONTROL();
  if (incoming == s_app_thread) {
    const uint32_t arena_rbar =
        ((s_arena_start & MPU_RBAR_BASE_Msk) | P_RW_U_RW_Msk) &
        ~MPU_RBAR_XN_Msk;
    const uint32_t arena_rlar =
        ((s_arena_start + s_arena_size - 1U) & MPU_RLAR_LIMIT_Msk) |
        (MPU_MAIR_INDEX_SRAM << MPU_RLAR_AttrIndx_Pos) | MPU_RLAR_EN_Msk;
    const uint32_t stack_rbar =
        (s_stack_start & MPU_RBAR_BASE_Msk) | P_RW_U_RW_Msk |
        MPU_RBAR_XN_Msk;
    const uint32_t stack_rlar =
        ((s_stack_start + s_stack_size - 1U) & MPU_RLAR_LIMIT_Msk) |
        (MPU_MAIR_INDEX_SRAM << MPU_RLAR_AttrIndx_Pos) | MPU_RLAR_EN_Msk;

    const uint32_t ctrl = prv_mpu_batch_begin();
    if (s_code_region_needed) {
      prv_mpu_region_write_raw(s_code_region, s_app_code_rbar, s_app_code_rlar);
    }
    prv_mpu_region_write_raw(s_ram_region, arena_rbar, arena_rlar);
    prv_mpu_region_write_raw(s_stack_region, stack_rbar, stack_rlar);
    prv_mpu_batch_end(ctrl);
    if (atomic_get(&s_syscall_active)) {
      __set_CONTROL(control & ~CONTROL_nPRIV_Msk);
    } else {
      __set_CONTROL(control | CONTROL_nPRIV_Msk);
    }
  } else {
    const uint32_t ctrl = prv_mpu_batch_begin();
    prv_mpu_region_write_raw(s_stack_region, s_saved_stack_rbar,
                             s_saved_stack_rlar);
    prv_mpu_region_write_raw(s_ram_region, s_saved_ram_rbar, s_saved_ram_rlar);
    if (s_code_region_needed) {
      prv_mpu_region_write_raw(s_code_region, s_saved_code_rbar,
                               s_saved_code_rlar);
    }
    prv_mpu_batch_end(ctrl);
    __set_CONTROL(control & ~CONTROL_nPRIV_Msk);
  }
  __ISB();
}

int z_arm_custom_svc_hook(uint32_t *exc_frame, uint32_t exc_return,
                          uint8_t svc_num) {
  uintptr_t frame;
  uintptr_t stack_end;
  uintptr_t return_pc;
  uintptr_t svc_pc;
  uintptr_t msp;
  size_t frame_size;

  if (!atomic_get(&s_sandbox_ready)) {
    return 0;
  }
  if (svc_num != 4U || k_current_get() != s_app_thread) {
    return 0;
  }

  frame = (uintptr_t)exc_frame;
  stack_end = s_stack_start + s_stack_size;
  msp = __get_MSP();
  if ((exc_return & SVC_EXC_RETURN_PSP) == 0U ||
      !sandbox_thread_is_unprivileged() || frame < s_stack_start ||
      frame > stack_end || stack_end - frame < 8U * sizeof(uint32_t) ||
      (msp >= s_stack_start && msp < stack_end)) {
    return 0;
  }

  frame_size = 8U * sizeof(uint32_t);
  if ((exc_return & SVC_EXC_RETURN_BASIC_FRAME) == 0U) {
    frame_size += 18U * sizeof(uint32_t);
  }
  if ((exc_frame[7] & XPSR_STACK_ALIGN) != 0U) {
    frame_size += sizeof(uint32_t);
  }
  return_pc = exc_frame[6];
  if (frame_size > stack_end - frame || return_pc < sizeof(uint16_t)) {
    exc_frame[0] = UINT32_MAX;
    return 1;
  }

  svc_pc = return_pc - sizeof(uint16_t);
  if (svc_pc < (uintptr_t)__sandbox_syscall_start ||
      svc_pc >= (uintptr_t)__sandbox_syscall_end ||
      *(const uint16_t *)svc_pc != 0xdf04U ||
      atomic_get(&s_syscall_active)) {
    exc_frame[0] = UINT32_MAX;
    return 1;
  }

  s_app_return_address = exc_frame[5];
  exc_frame[5] = (uintptr_t)&prv_drop_privilege;
  atomic_set(&s_syscall_active, 1);
  __set_CONTROL(__get_CONTROL() & ~CONTROL_nPRIV_Msk);
  __ISB();
  return 1;
}

void sandbox_arm(void) {
  atomic_set(&s_sandbox_ready, 1);
}

void sandbox_disarm(void) {
  atomic_clear(&s_sandbox_ready);
  atomic_clear(&s_syscall_active);
  s_app_thread = NULL;
}

bool sandbox_prepare(struct k_thread *app_thread, uintptr_t stack_start,
                     size_t stack_size) {
  const uint8_t regions =
      (MPU->TYPE & MPU_TYPE_DREGION_Msk) >> MPU_TYPE_DREGION_Pos;
  const uintptr_t arena_start = (uintptr_t)&g_sandbox_app_arena;
  const size_t arena_size = ROUND_UP(
      offsetof(SandboxAppArena, mpu_tail), MPU_MIN_ALIGN);
  bool ram_found = false;
  bool stack_slot_found = false;
  bool code_slot_found = false;
  bool code_access_found = false;
  const uintptr_t code_start =
      ROUND_DOWN((uintptr_t)__rom_region_start, MPU_MIN_ALIGN);
  const uintptr_t code_end =
      ROUND_UP((uintptr_t)__rom_region_end, MPU_MIN_ALIGN);

  if (regions < 4U) {
    printk("SANDBOX_SETUP_FAIL %s:%d region_count=%u required=4\n",
           __FILE_NAME__, __LINE__, regions);
    return false;
  }
  if (code_end <= code_start ||
      (arena_start & (MPU_MIN_ALIGN - 1U)) != 0U ||
      (arena_size & (MPU_MIN_ALIGN - 1U)) != 0U ||
      (stack_start & (MPU_MIN_ALIGN - 1U)) != 0U ||
      (stack_size & (MPU_MIN_ALIGN - 1U)) != 0U) {
    printk("SANDBOX_SETUP_FAIL %s:%d alignment code=%p..%p "
           "arena=%p+%zu stack=%p+%zu align=%u\n",
           __FILE_NAME__, __LINE__, (void *)code_start, (void *)code_end,
           (void *)arena_start, arena_size, (void *)stack_start, stack_size,
           MPU_MIN_ALIGN);
    return false;
  }
  if (prv_ranges_overlap(arena_start, arena_size, stack_start, stack_size)) {
    printk("SANDBOX_SETUP_FAIL %s:%d arena_stack_overlap arena=%p+%zu "
           "stack=%p+%zu\n", __FILE_NAME__, __LINE__, (void *)arena_start,
           arena_size, (void *)stack_start, stack_size);
    return false;
  }

  for (uint8_t i = 0U; i < regions; ++i) {
    uint32_t rbar;
    uint32_t rlar;
    prv_mpu_region_read(i, &rbar, &rlar);
    if (prv_region_contains(rbar, rlar, arena_start, arena_size) &&
        prv_region_contains(rbar, rlar, stack_start, stack_size)) {
      s_ram_region = i;
      s_saved_ram_rbar = rbar;
      s_saved_ram_rlar = rlar;
      ram_found = true;
    }
    if (prv_region_is_user_executable(rbar, rlar, code_start,
                                      code_end - code_start)) {
      code_access_found = true;
      printk("SANDBOX_MPU_CODE_EXISTING region=%u rbar=0x%08x rlar=0x%08x\n",
             i, rbar, rlar);
    }
  }

  for (int i = regions - 1; i >= 0; --i) {
    uint32_t rbar;
    uint32_t rlar;
    prv_mpu_region_read((uint8_t)i, &rbar, &rlar);
    if ((rlar & MPU_RLAR_EN_Msk) == 0U) {
      s_stack_region = (uint8_t)i;
      s_saved_stack_rbar = rbar;
      s_saved_stack_rlar = rlar;
      stack_slot_found = true;
      break;
    }
  }

  for (int i = regions - 1; !code_access_found && i >= 0; --i) {
    uint32_t rbar;
    uint32_t rlar;
    prv_mpu_region_read((uint8_t)i, &rbar, &rlar);
    if ((rlar & MPU_RLAR_EN_Msk) == 0U && (uint8_t)i != s_stack_region) {
      s_code_region = (uint8_t)i;
      s_saved_code_rbar = rbar;
      s_saved_code_rlar = rlar;
      code_slot_found = true;
      break;
    }
  }

  if (!ram_found || !stack_slot_found ||
      (!code_access_found && !code_slot_found) ||
      s_stack_region == s_ram_region ||
      (!code_access_found && s_code_region == s_ram_region)) {
    printk("SANDBOX_SETUP_FAIL %s:%d slots ram_found=%u ram=%u "
           "stack_found=%u stack=%u code_access=%u code_slot=%u code=%u\n",
           __FILE_NAME__, __LINE__, ram_found, s_ram_region,
           stack_slot_found, s_stack_region, code_access_found,
           code_slot_found, s_code_region);
    return false;
  }

  s_code_region_needed = !code_access_found;
  if (s_code_region_needed) {
    // Firmware code must be user-executable: RO for priv+user, and XN cleared
    // (the arena region clears XN the same way). Without clearing XN the region
    // is execute-never, so fetching firmware code faults with an instruction
    // access violation.
    s_app_code_rbar =
        ((code_start & MPU_RBAR_BASE_Msk) | P_RO_U_RO_Msk) & ~MPU_RBAR_XN_Msk;
    s_app_code_rlar =
        ((code_end - 1U) & MPU_RLAR_LIMIT_Msk) |
        (MPU_MAIR_INDEX_FLASH << MPU_RLAR_AttrIndx_Pos) | MPU_RLAR_EN_Msk;
  }

  s_app_thread = app_thread;
  s_stack_start = stack_start;
  s_stack_size = stack_size;
  s_arena_start = arena_start;
  s_arena_size = arena_size;
  printk("SANDBOX_MPU arena=%p+%zu stack=%p+%zu code=%p+%zu "
         "slots=ram:%u stack:%u code:%s%u\n",
         (void *)s_arena_start, s_arena_size, (void *)s_stack_start,
         s_stack_size, (void *)code_start, (size_t)(code_end - code_start),
         s_ram_region, s_stack_region,
         s_code_region_needed ? "new:" : "existing:",
         s_code_region_needed ? s_code_region : 0U);
  return true;
}
```

## src/sandbox_bridge.c
```c
/* SPDX-License-Identifier: Apache-2.0 */

#include "sandbox_bridge.h"

#include <stdbool.h>
#include <stddef.h>
#include <stdint.h>
#include <string.h>
#include <time.h>

#include <zephyr/sys/printk.h>

#define sign_extend zephyr_sign_extend
#include "sandbox.h"
#undef sign_extend

#include "applib/applib_resource.h"
#include "applib/fonts/fonts.h"
#include "applib/tick_timer_service_private.h"
#include "applib/tick_timer_service.h"
#include "applib/ui/animation.h"
#include "applib/ui/app_window_stack.h"
#include "applib/ui/layer.h"
#include "applib/ui/text_layer.h"
#include "applib/ui/window.h"
#include "applib/unobstructed_area_service.h"
#include "kernel/pebble_tasks.h"
#include "kernel/pbl_malloc.h"
#include "sandbox_syscall.h"
#include "sandbox_port.h"
#include "watchface_port.h"

void *task_malloc(size_t size);
void task_free(void *ptr);

static bool s_app_announced;
static uint32_t s_step_mask;

static const char *const s_step_names[SandboxStepCount] = {
    [SandboxStepAppEntry] = "app_entry",
    [SandboxStepWindowCreate] = "window_create",
    [SandboxStepTextLayerCreate] = "text_layer_create",
    [SandboxStepTickSubscribe] = "tick_subscribe",
    [SandboxStepWindowStackPush] = "window_stack_push",
    [SandboxStepEventLoop] = "event_loop",
    [SandboxStepWaitTick] = "wait_tick",
    [SandboxStepTickHandler] = "tick_handler",
    [SandboxStepRender] = "render",
};

static void prv_log_step(SandboxStep step, uintptr_t detail) {
  if ((unsigned int)step >= SandboxStepCount ||
      (s_step_mask & (1UL << step)) != 0U) {
    return;
  }

  s_step_mask |= 1UL << step;
  if (detail != 0U) {
    printk("SANDBOX_STEP %s 0x%08x\n", s_step_names[step],
           (uint32_t)detail);
  } else {
    printk("SANDBOX_STEP %s\n", s_step_names[step]);
  }
}

int __sandbox_syscall_probe(int value);

DEFINE_SYSCALL(void, sandbox_app_runtime_init, void) {
  watchface_port_app_state_init();
#if !defined(PBL_WATCHFACE_IN_FW)
  tick_timer_service_init();
#endif
}

DEFINE_SYSCALL(void, sandbox_mpu_readback, void) {
  sandbox_dump_active_mpu();
}

DEFINE_SYSCALL(int, sandbox_syscall_probe, int value) {
  if (sandbox_thread_is_unprivileged()) {
    return -1;
  }
  if (!s_app_announced) {
    s_app_announced = true;
    printk("SANDBOX_APP_UP\n");
  }
  if (value == 42) {
    printk("SANDBOX_SYSCALL_OK\n");
  }
  return value * 2;
}

DEFINE_SYSCALL(void, sandbox_app_step, SandboxStep step, uintptr_t detail) {
  prv_log_step(step, detail);
}

DEFINE_SYSCALL(bool, sandbox_wait_tick, struct tm *tick_time,
               TimeUnits *units_changed, TickHandler *handler,
               time_t *timestamp) {
  if (!sandbox_userspace_buffer_is_valid(tick_time, sizeof(*tick_time)) ||
      !sandbox_userspace_buffer_is_valid(units_changed,
                                         sizeof(*units_changed)) ||
      !sandbox_userspace_buffer_is_valid(handler, sizeof(*handler)) ||
      !sandbox_userspace_buffer_is_valid(timestamp, sizeof(*timestamp))) {
    return false;
  }
  return watchface_port_wait_tick(tick_time, units_changed, handler,
                                  timestamp);
}

DEFINE_SYSCALL(void, sandbox_render_tick, time_t timestamp) {
  watchface_port_render_tick(timestamp);
}

void sandbox_app_event_loop(void) {
  sandbox_app_step(SandboxStepEventLoop, 0U);
  for (;;) {
    struct tm tick_time;
    TimeUnits units_changed;
    TickHandler handler;
    time_t timestamp;

    sandbox_app_step(SandboxStepWaitTick, 0U);
    if (sandbox_wait_tick(&tick_time, &units_changed, &handler, &timestamp) &&
        handler) {
      sandbox_app_step(SandboxStepTickHandler, (uintptr_t)handler);
      handler(&tick_time, units_changed);
      sandbox_app_step(SandboxStepRender, 0U);
      sandbox_render_tick(timestamp);
    }
  }
}

DEFINE_SYSCALL(GFont, sandbox_fonts_get_system_font, const char *font_key) {
  return fonts_get_system_font(font_key);
}

DEFINE_SYSCALL(GFont, sandbox_fonts_load_custom_font, ResHandle handle) {
  return fonts_load_custom_font(handle);
}

DEFINE_SYSCALL(void, sandbox_fonts_unload_custom_font, GFont font) {
  fonts_unload_custom_font(font);
}

DEFINE_SYSCALL(void, sandbox_task_free, void *ptr) {
  task_free(ptr);
}

DEFINE_SYSCALL(void, sandbox_layer_add_child, Layer *parent, Layer *child) {
  layer_add_child(parent, child);
}

DEFINE_SYSCALL(GRect, sandbox_layer_get_frame_by_value, const Layer *layer) {
  return layer_get_frame_by_value(layer);
}

DEFINE_SYSCALL(void, sandbox_layer_mark_dirty, Layer *layer) {
  layer_mark_dirty(layer);
}

DEFINE_SYSCALL(void, sandbox_layer_set_frame_by_value, Layer *layer,
               GRect frame) {
  layer_set_frame_by_value(layer, frame);
}

DEFINE_SYSCALL(void, sandbox_layer_set_hidden, Layer *layer, bool hidden) {
  layer_set_hidden(layer, hidden);
}

DEFINE_SYSCALL(void *, sandbox_task_malloc, size_t size) {
  return task_malloc(size);
}

DEFINE_SYSCALL(ResHandle, sandbox_resource_get_handle, uint32_t resource_id) {
  return applib_resource_get_handle(resource_id);
}

DEFINE_SYSCALL(char *, sandbox_strcat, char *destination,
               const char *source) {
  return strcat(destination, source);
}

DEFINE_SYSCALL(char *, sandbox_strcpy, char *destination,
               const char *source) {
  return strcpy(destination, source);
}

DEFINE_SYSCALL(size_t, sandbox_strlen, const char *string) {
  return strlen(string);
}

DEFINE_SYSCALL(void, sandbox_tick_timer_service_subscribe,
               TimeUnits tick_units, TickHandler handler) {
  prv_log_step(SandboxStepTickSubscribe, (uintptr_t)handler);
#if defined(PBL_WATCHFACE_IN_FW)
  watchface_port_tick_subscribe(tick_units, handler);
#else
  tick_timer_service_subscribe(tick_units, handler);
#endif
}

DEFINE_SYSCALL(void, sandbox_tick_timer_service_unsubscribe, void) {
#if defined(PBL_WATCHFACE_IN_FW)
  watchface_port_tick_unsubscribe();
#else
  tick_timer_service_unsubscribe();
#endif
}

DEFINE_SYSCALL(Window *, sandbox_window_create, void) {
  prv_log_step(SandboxStepWindowCreate, 0U);
  return window_create();
}

DEFINE_SYSCALL(void, sandbox_window_destroy, Window *window) {
  window_destroy(window);
}

DEFINE_SYSCALL(Layer *, sandbox_window_get_root_layer, const Window *window) {
  return window_get_root_layer(window);
}

DEFINE_SYSCALL(void, sandbox_app_window_stack_push, Window *window,
               bool animated) {
  prv_log_step(SandboxStepWindowStackPush, (uintptr_t)window);
  app_window_stack_push(window, animated);
}

DEFINE_SYSCALL(void, sandbox_window_set_background_color, Window *window,
               GColor color) {
  window_set_background_color(window, color);
}

DEFINE_SYSCALL(struct tm *, sandbox_localtime, const int32_t *timep) {
  if (timep && !sandbox_userspace_buffer_is_valid(timep, sizeof(*timep))) {
    return NULL;
  }
  return watchface_port_localtime(timep);
}

DEFINE_SYSCALL(Animation *, sandbox_animation_create, void) {
  return animation_create();
}

DEFINE_SYSCALL(bool, sandbox_animation_set_duration, Animation *animation,
               uint32_t duration_ms) {
  return animation_set_duration(animation, duration_ms);
}

DEFINE_SYSCALL(bool, sandbox_animation_set_implementation,
               Animation *animation,
               const AnimationImplementation *implementation) {
  return animation_set_implementation(animation, implementation);
}

DEFINE_SYSCALL(TextLayer *, sandbox_text_layer_create, GRect frame) {
  prv_log_step(SandboxStepTextLayerCreate, 0U);
  return text_layer_create(frame);
}

DEFINE_SYSCALL(void, sandbox_text_layer_destroy, TextLayer *text_layer) {
  text_layer_destroy(text_layer);
}

DEFINE_SYSCALL(Layer *, sandbox_text_layer_get_layer,
               TextLayer *text_layer) {
  return text_layer_get_layer(text_layer);
}

DEFINE_SYSCALL(const char *, sandbox_text_layer_get_text,
               TextLayer *text_layer) {
  return text_layer_get_text(text_layer);
}

DEFINE_SYSCALL(void, sandbox_text_layer_set_background_color,
               TextLayer *text_layer, GColor color) {
  text_layer_set_background_color(text_layer, color);
}

DEFINE_SYSCALL(void, sandbox_text_layer_set_font, TextLayer *text_layer,
               GFont font) {
  text_layer_set_font(text_layer, font);
}

DEFINE_SYSCALL(void, sandbox_text_layer_set_text, TextLayer *text_layer,
               const char *text) {
  text_layer_set_text(text_layer, text);
}

DEFINE_SYSCALL(void, sandbox_text_layer_set_text_alignment,
               TextLayer *text_layer, GTextAlignment alignment) {
  text_layer_set_text_alignment(text_layer, alignment);
}

DEFINE_SYSCALL(void, sandbox_text_layer_set_text_color,
               TextLayer *text_layer, GColor color) {
  text_layer_set_text_color(text_layer, color);
}

DEFINE_SYSCALL(int32_t, sandbox_time, int32_t *tloc) {
  if (tloc && !sandbox_userspace_buffer_is_valid(tloc, sizeof(*tloc))) {
    return -1;
  }
  return watchface_port_time(tloc);
}

DEFINE_SYSCALL(GRect, sandbox_layer_get_unobstructed_bounds,
               const Layer *layer) {
  return watchface_layer_get_unobstructed_bounds_by_value(layer);
}

DEFINE_SYSCALL(void, sandbox_unobstructed_area_service_subscribe,
               UnobstructedAreaHandlers handlers, void *context) {
  app_unobstructed_area_service_subscribe(handlers, context);
}

DEFINE_SYSCALL(void, sandbox_unobstructed_area_service_unsubscribe, void) {
  app_unobstructed_area_service_unsubscribe();
}

const void *const g_sandbox_system_tbl[626] = {
    [31] = sandbox_app_event_loop,
    [96] = sandbox_fonts_get_system_font,
    [97] = sandbox_fonts_load_custom_font,
    [98] = sandbox_fonts_unload_custom_font,
    [99] = sandbox_task_free,
    [138] = sandbox_layer_add_child,
    [145] = sandbox_layer_get_frame_by_value,
    [150] = sandbox_layer_mark_dirty,
    [155] = sandbox_layer_set_frame_by_value,
    [156] = sandbox_layer_set_hidden,
    [161] = sandbox_task_malloc,
    [206] = sandbox_resource_get_handle,
    [241] = sandbox_strcat,
    [243] = sandbox_strcpy,
    [245] = sandbox_strlen,
    [262] = sandbox_tick_timer_service_subscribe,
    [263] = sandbox_tick_timer_service_unsubscribe,
    [271] = sandbox_window_create,
    [272] = sandbox_window_destroy,
    [275] = sandbox_window_get_root_layer,
    [287] = sandbox_app_window_stack_push,
    [377] = sandbox_window_set_background_color,
    [379] = sandbox_localtime,
    [380] = sandbox_animation_create,
    [384] = animation_schedule,
    [388] = sandbox_animation_set_duration,
    [390] = sandbox_animation_set_implementation,
    [391] = animation_unschedule,
    [462] = sandbox_text_layer_create,
    [463] = sandbox_text_layer_destroy,
    [465] = sandbox_text_layer_get_layer,
    [466] = sandbox_text_layer_get_text,
    [467] = sandbox_text_layer_set_background_color,
    [468] = sandbox_text_layer_set_font,
    [471] = sandbox_text_layer_set_text,
    [472] = sandbox_text_layer_set_text_alignment,
    [473] = sandbox_text_layer_set_text_color,
    [519] = sandbox_time,
    [622] = sandbox_layer_get_unobstructed_bounds,
    [624] = sandbox_unobstructed_area_service_subscribe,
    [625] = sandbox_unobstructed_area_service_unsubscribe,
};
```

## src/wall_clock.c
```c
/* SPDX-FileCopyrightText: 2026 Core Devices LLC */
/* SPDX-License-Identifier: Apache-2.0 */

#include <stdbool.h>
#include <time.h>

#include <zephyr/device.h>
#include <zephyr/devicetree.h>
#include <zephyr/kernel.h>

#if DT_NODE_HAS_STATUS(DT_NODELABEL(rtc), okay)
#include <zephyr/drivers/rtc.h>
#include <zephyr/sys/timeutil.h>

#define SF32LB_RTC_RESET_EPOCH 946684800

static const struct device *const s_rtc = DEVICE_DT_GET(DT_NODELABEL(rtc));

static bool prv_read_rtc(time_t *timestamp) {
  struct rtc_time rtc_time;
  if (!device_is_ready(s_rtc) || rtc_get_time(s_rtc, &rtc_time) != 0) {
    return false;
  }

  struct tm now = *rtc_time_to_tm(&rtc_time);

  if (now.tm_year >= 0 && now.tm_year < 100) {
    now.tm_year += 100;
  }
#if DT_NODE_HAS_COMPAT(DT_NODELABEL(rtc), sifli_sf32lb_rtc)
  // SF32LB driver returns one-based months; Zephyr-compliant drivers don't.
  if (now.tm_mon >= 1 && now.tm_mon <= 12) {
    now.tm_mon -= 1;
  }
#endif

  if (now.tm_year < 100 || now.tm_year > 137 || now.tm_mon < 0 ||
      now.tm_mon > 11 || now.tm_mday < 1 || now.tm_mday > 31) {
    return false;
  }

  *timestamp = timeutil_timegm(&now);
  return true;
}
#endif

static bool s_wall_clock_initialized;
static time_t s_wall_clock_offset;

time_t kernel_wall_clock_get(void) {
  const time_t uptime_seconds = k_uptime_get() / 1000;

  if (!s_wall_clock_initialized) {
#ifdef KERNEL_DEMO_EPOCH
    s_wall_clock_offset = (time_t)KERNEL_DEMO_EPOCH - uptime_seconds;
#elif DT_NODE_HAS_STATUS(DT_NODELABEL(rtc), okay)
    time_t rtc_time;
    if (prv_read_rtc(&rtc_time) && rtc_time != SF32LB_RTC_RESET_EPOCH) {
      s_wall_clock_offset = rtc_time - uptime_seconds;
    } else {
      s_wall_clock_offset = KERNEL_BUILD_EPOCH;
    }
#else
    s_wall_clock_offset = KERNEL_BUILD_EPOCH;
#endif
    s_wall_clock_initialized = true;
  }

  return s_wall_clock_offset + uptime_seconds;
}
```
