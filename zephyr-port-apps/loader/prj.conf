## prj.conf
```kconfig
CONFIG_PRINTK=y
CONFIG_LOG=n
CONFIG_MAIN_STACK_SIZE=4096
CONFIG_ARM_MPU=y
CONFIG_ARM_CUSTOM_SVC_HOOK=y
CONFIG_ARM_CUSTOM_THREAD_RESTORE_HOOK=y
CONFIG_USERSPACE=n
```

## src/main.c
```c
/* SPDX-License-Identifier: Apache-2.0 */

#include <zephyr/kernel.h>
#include <zephyr/sys/printk.h>
#include <zephyr/toolchain.h>

#include "process_management/pebble_process_info.h"
#include "sliding_text_emery_bin.h"
#include "syscall_demo.h"
#include "util/legacy_checksum.h"

#include <inttypes.h>
#include <stdbool.h>
#include <stddef.h>
#include <stdint.h>
#include <string.h>

#define APP_SEGMENT_CAPACITY 4096U

_Static_assert(sizeof(PebbleProcessInfo) == 130U,
               "PebbleProcessInfo v16 ABI changed");

static uint8_t s_app_segment[APP_SEGMENT_CAPACITY] __aligned(32);

static void prv_sdk_placeholder(void) {}

/* The firmware build supplies the generated, ABI-ordered table instead. */
static const void *const g_pbl_system_tbl[] = {
  &prv_sdk_placeholder,
};

static bool prv_range_fits(size_t offset, size_t size, size_t limit) {
  return (offset <= limit) && (size <= (limit - offset));
}

static bool prv_validate_header(const PebbleProcessInfo *info, size_t blob_size,
                                size_t *stored_size_out) {
  const size_t header_size = sizeof(*info);
  const size_t load_size = info->load_size;
  const size_t virtual_size = info->virtual_size;

  if (memcmp(info->header, "PBLAPP\0\0", sizeof(info->header)) != 0) {
    printk("LOADER_FAIL: invalid magic\n");
    return false;
  }
  if (info->struct_version.major != PROCESS_INFO_CURRENT_STRUCT_VERSION_MAJOR) {
    printk("LOADER_FAIL: unsupported header version %u.%u\n",
           info->struct_version.major, info->struct_version.minor);
    return false;
  }
  if ((info->flags & PROCESS_INFO_PLATFORM_MASK) !=
      PROCESS_INFO_PLATFORM_EMERY) {
    printk("LOADER_FAIL: binary is not for emery (flags=0x%08" PRIx32 ")\n",
           info->flags);
    return false;
  }
  if (load_size < header_size || load_size > virtual_size ||
      virtual_size > sizeof(s_app_segment)) {
    printk("LOADER_FAIL: sizes header=%zu load=%zu virtual=%zu segment=%zu\n",
           header_size, load_size, virtual_size, sizeof(s_app_segment));
    return false;
  }

  const size_t reloc_size = (size_t)info->num_reloc_entries * sizeof(uint32_t);
  if (info->num_reloc_entries != reloc_size / sizeof(uint32_t) ||
      !prv_range_fits(load_size, reloc_size, blob_size) ||
      !prv_range_fits(load_size, reloc_size, sizeof(s_app_segment))) {
    printk("LOADER_FAIL: relocation table does not fit\n");
    return false;
  }

  if ((info->offset & 1U) != 0U ||
      !prv_range_fits(info->offset, sizeof(uint16_t), load_size) ||
      info->offset < header_size) {
    printk("LOADER_FAIL: invalid entry 0x%08" PRIx32 "\n", info->offset);
    return false;
  }
  if ((info->sym_table_addr & (sizeof(uint32_t) - 1U)) != 0U ||
      !prv_range_fits(info->sym_table_addr, sizeof(uint32_t), virtual_size) ||
      info->sym_table_addr < header_size) {
    printk("LOADER_FAIL: invalid jump table slot 0x%08" PRIx32 "\n",
           info->sym_table_addr);
    return false;
  }

  *stored_size_out = load_size + reloc_size;
  return true;
}

static bool prv_verify_crc(const PebbleProcessInfo *info, const uint8_t *image) {
  const size_t header_size = sizeof(*info);
  const uint32_t calculated = legacy_defective_checksum_memory(
      image + header_size, info->load_size - header_size);

  if (calculated != info->crc) {
    printk("LOADER_FAIL: crc calculated=0x%08" PRIx32
           " expected=0x%08" PRIx32 "\n", calculated, info->crc);
    return false;
  }
  return true;
}

static bool prv_apply_relocations(const PebbleProcessInfo *info,
                                  uint8_t *destination) {
  uint8_t *reloc_table = destination + info->load_size;

  for (uint32_t i = 0; i < info->num_reloc_entries; ++i) {
    uint32_t reloc_offset;
    memcpy(&reloc_offset, &reloc_table[i * sizeof(reloc_offset)],
           sizeof(reloc_offset));
    if (!prv_range_fits(reloc_offset, sizeof(uint32_t), info->load_size) ||
        reloc_offset < sizeof(*info)) {
      printk("LOADER_FAIL: invalid relocation target[%" PRIu32
             "]=0x%08" PRIx32 "\n", i, reloc_offset);
      return false;
    }

    uint32_t app_relative_value;
    memcpy(&app_relative_value, destination + reloc_offset,
           sizeof(app_relative_value));
    if (app_relative_value > info->virtual_size) {
      printk("LOADER_FAIL: invalid relocation value[%" PRIu32
             "]=0x%08" PRIx32 "\n", i, app_relative_value);
      return false;
    }

    const uint32_t relocated_value =
        (uint32_t)(uintptr_t)(destination + app_relative_value);
    memcpy(destination + reloc_offset, &relocated_value,
           sizeof(relocated_value));
  }

  if (info->num_reloc_entries != 0U) {
    memset(reloc_table, 0,
           (size_t)info->num_reloc_entries * sizeof(uint32_t));
  }
  return true;
}

static bool prv_load_sliding_text(void) {
  PebbleProcessInfo info;
  size_t stored_size;

  if (sliding_text_emery_pbw_len < sizeof(info)) {
    printk("LOADER_FAIL: image smaller than header\n");
    return false;
  }
  memcpy(&info, sliding_text_emery_pbw, sizeof(info));

  if (!prv_validate_header(&info, sliding_text_emery_pbw_len, &stored_size)) {
    return false;
  }

  memset(s_app_segment, 0, sizeof(s_app_segment));
  memcpy(s_app_segment, sliding_text_emery_pbw, stored_size);
  if (memcmp(&info, s_app_segment, sizeof(info)) != 0) {
    printk("LOADER_FAIL: header changed during copy\n");
    return false;
  }
  if (!prv_verify_crc(&info, s_app_segment)) {
    return false;
  }

  printk("LOADER: header ok (crc=0x%08" PRIx32
         " version=%u.%u entry=0x%08" PRIx32 ")\n",
         info.crc, info.struct_version.major, info.struct_version.minor,
         info.offset);
  if (!prv_apply_relocations(&info, s_app_segment)) {
    return false;
  }
  printk("LOADER: relocated %" PRIu32 " entries\n", info.num_reloc_entries);

  const uint32_t jump_table = (uint32_t)(uintptr_t)&g_pbl_system_tbl;
  memcpy(s_app_segment + info.sym_table_addr, &jump_table, sizeof(jump_table));
  uint32_t patched_value;
  memcpy(&patched_value, s_app_segment + info.sym_table_addr,
         sizeof(patched_value));
  if (patched_value != jump_table) {
    printk("LOADER_FAIL: jump table patch did not stick\n");
    return false;
  }
  printk("LOADER: jumptable patched\n");

  return true;
}

int main(void) {
  if (prv_load_sliding_text()) {
    printk("LOADER_OK\n");
    if (syscall_demo_run()) {
      printk("SYSCALL_OK\n");
    }
  }
  return 0;
}
```

## src/sliding_text_emery_bin.c
```c
/* SPDX-License-Identifier: Apache-2.0 */
/* Generated from Sliding Text's emery/pebble-app.bin. */
#include "sliding_text_emery_bin.h"

const uint8_t sliding_text_emery_pbw[] = {
  0x50, 0x42, 0x4c, 0x41, 0x50, 0x50, 0x00, 0x00, 0x10, 0x00, 0x05, 0x5f,
  0x01, 0x02, 0xcc, 0x0b, 0xb8, 0x05, 0x00, 0x00, 0xc9, 0x55, 0x47, 0x9a,
  0x53, 0x6c, 0x69, 0x64, 0x69, 0x6e, 0x67, 0x20, 0x54, 0x65, 0x78, 0x74,
  0x00, 0x00, 0x00, 0x00, 0x00, 0x00, 0x00, 0x00, 0x00, 0x00, 0x00, 0x00,
  0x00, 0x00, 0x00, 0x00, 0x00, 0x00, 0x00, 0x00, 0x50, 0x65, 0x62, 0x62,
  0x6c, 0x65, 0x20, 0x54, 0x65, 0x63, 0x68, 0x6e, 0x6f, 0x6c, 0x6f, 0x67,
  0x79, 0x00, 0x00, 0x00, 0x00, 0x00, 0x00, 0x00, 0x00, 0x00, 0x00, 0x00,
  0x00, 0x00, 0x00, 0x00, 0x00, 0x00, 0x00, 0x00, 0xb8, 0x00, 0x00, 0x00,
  0x41, 0x01, 0x00, 0x00, 0x34, 0x00, 0x00, 0x00, 0xc7, 0xa9, 0xd5, 0x35,
  0xe9, 0xbd, 0x4c, 0x36, 0x9c, 0x30, 0xb4, 0x5a, 0xd0, 0x90, 0x86, 0x34,
  0x1f, 0x4e, 0x08, 0xe5, 0x90, 0xb4, 0xf7, 0x69, 0xd0, 0x0b, 0x00, 0x00,
  0x04, 0x00, 0x00, 0x00, 0x14, 0x00, 0x00, 0x00, 0x03, 0x00, 0x00, 0x00,
  0x47, 0x4e, 0x55, 0x00, 0x71, 0x91, 0x72, 0x01, 0x9b, 0xbe, 0x1b, 0x52,
  0xb9, 0x87, 0x2c, 0xf0, 0x5f, 0xdb, 0x2c, 0x43, 0x9c, 0x2b, 0xb2, 0x4e,
  0x03, 0xa3, 0x18, 0x68, 0x08, 0x44, 0x02, 0x68, 0x94, 0x46, 0x0f, 0xbc,
  0x60, 0x47, 0x00, 0xbf, 0xa8, 0xa8, 0xa8, 0xa8, 0x0a, 0x22, 0xf8, 0xb5,
  0x91, 0xfb, 0xf2, 0xf5, 0x95, 0xfb, 0xf2, 0xf3, 0x02, 0xfb, 0x13, 0x53,
  0x00, 0x2b, 0x07, 0x46, 0x0e, 0x46, 0x02, 0xfb, 0x15, 0x15, 0x30, 0xdd,
  0x01, 0x2b, 0x0d, 0xd1, 0x91, 0x42, 0x0b, 0xd0, 0x1a, 0x4b, 0x7b, 0x44,
  0x53, 0xf8, 0x25, 0x40, 0x21, 0x46, 0x00, 0xf0, 0xbf, 0xfb, 0x20, 0x46,
  0xbd, 0xe8, 0xf8, 0x40, 0x00, 0xf0, 0xc6, 0xbb, 0x15, 0x4a, 0x38, 0x46,
  0x7a, 0x44, 0x52, 0xf8, 0x23, 0x40, 0x21, 0x46, 0x00, 0xf0, 0xb2, 0xfb,
  0x20, 0x46, 0x00, 0xf0, 0xbb, 0xfb, 0x00, 0x2d, 0x04, 0x46, 0x16, 0xdd,
  0x0f, 0x49, 0x38, 0x46, 0x79, 0x44, 0x00, 0xf0, 0xa7, 0xfb, 0x01, 0x34,
  0x0d, 0x4b, 0x38, 0x46, 0x7b, 0x44, 0x53, 0xf8, 0x25, 0x50, 0x29, 0x46,
  0x00, 0xf0, 0x9e, 0xfb, 0x28, 0x46, 0x00, 0xf0, 0xa7, 0xfb, 0x04, 0x44,
  0x05, 0xe0, 0x00, 0x2d, 0x4f, 0xf0, 0x00, 0x04, 0xee, 0xdc, 0x00, 0x2e,
  0xec, 0xd0, 0x20, 0x46, 0xf8, 0xbd, 0x00, 0xbf, 0x7a, 0x0a, 0x00, 0x00,
  0xe8, 0x09, 0x00, 0x00, 0xb9, 0x08, 0x00, 0x00, 0x60, 0x0a, 0x00, 0x00,
  0x2d, 0xe9, 0xf0, 0x41, 0x0d, 0x46, 0x16, 0x46, 0x04, 0x46, 0x26, 0x4f,
  0x28, 0x46, 0x7f, 0x44, 0x39, 0x46, 0x00, 0xf0, 0x83, 0xfb, 0x39, 0x46,
  0x30, 0x46, 0x00, 0xf0, 0x7f, 0xfb, 0x5c, 0xb9, 0x21, 0x49, 0x28, 0x46,
  0x79, 0x44, 0x00, 0xf0, 0x73, 0xfb, 0x20, 0x49, 0x79, 0x44, 0x28, 0x46,
  0xbd, 0xe8, 0xf0, 0x41, 0x00, 0xf0, 0x6c, 0xbb, 0x09, 0x2c, 0x09, 0xdc,
  0x0a, 0x22, 0x94, 0xfb, 0xf2, 0xf3, 0x02, 0xfb, 0x13, 0x43, 0x1a, 0x4a,
  0x7a, 0x44, 0x52, 0xf8, 0x23, 0x10, 0xee, 0xe7, 0xa4, 0xf1, 0x0b, 0x03,
  0x08, 0x2b, 0x0c, 0xd8, 0x16, 0x4f, 0x0a, 0x3c, 0x7f, 0x44, 0x57, 0xf8,
  0x34, 0x10, 0x28, 0x46, 0x07, 0xeb, 0xc4, 0x07, 0x00, 0xf0, 0x52, 0xfb,
  0x79, 0x68, 0x30, 0x46, 0xde, 0xe7, 0x0a, 0x27, 0x94, 0xfb, 0xf7, 0xf8,
  0xb8, 0xfb, 0xf7, 0xf3, 0x07, 0xfb, 0x13, 0x83, 0x0d, 0x4a, 0x07, 0xfb,
  0x18, 0x44, 0x7a, 0x44, 0x28, 0x46, 0x52, 0xf8, 0x23, 0x10, 0x00, 0xf0,
  0x3f, 0xfb, 0x24, 0xb1, 0x09, 0x4b, 0x7b, 0x44, 0x53, 0xf8, 0x24, 0x10,
  0xe7, 0xe7, 0xbd, 0xe8, 0xf0, 0x81, 0x00, 0xbf, 0x68, 0x08, 0x00, 0x00,
  0x74, 0x08, 0x00, 0x00, 0x75, 0x08, 0x00, 0x00, 0xe0, 0x09, 0x00, 0x00,
  0x54, 0x09, 0x00, 0x00, 0x02, 0x09, 0x00, 0x00, 0x92, 0x09, 0x00, 0x00,
  0x0c, 0x22, 0x0b, 0x46, 0x90, 0xfb, 0xf2, 0xf1, 0x10, 0xb5, 0x01, 0xfb,
  0x12, 0x04, 0x00, 0x2c, 0x08, 0xbf, 0x14, 0x46, 0x04, 0x49, 0x18, 0x46,
  0x79, 0x44, 0x00, 0xf0, 0x1f, 0xfb, 0x21, 0x46, 0xbd, 0xe8, 0x10, 0x40,
  0xff, 0xf7, 0x3c, 0xbf, 0x9e, 0x07, 0x00, 0x00, 0x2d, 0xe9, 0xf0, 0x4f,
  0x2e, 0x4b, 0x2f, 0x4a, 0x7b, 0x44, 0x9d, 0x58, 0x8d, 0xb0, 0x2b, 0x68,
  0x00, 0x24, 0xd3, 0xf8, 0x80, 0x00, 0x00, 0xf0, 0x2f, 0xfb, 0x01, 0x46,
  0x08, 0xa8, 0x00, 0xf0, 0x9d, 0xfb, 0xbd, 0xf9, 0x26, 0x30, 0x4f, 0xf0,
  0x24, 0x0b, 0xa6, 0x3b, 0x03, 0xeb, 0xd3, 0x73, 0x5b, 0x10, 0xad, 0xf8,
  0x10, 0x30, 0x9b, 0xb2, 0x03, 0xf1, 0x30, 0x02, 0x60, 0x33, 0xad, 0xf8,
  0x14, 0x30, 0x4f, 0xf0, 0x46, 0x13, 0x06, 0x93, 0x46, 0x23, 0x27, 0x46,
  0xad, 0xf8, 0x1c, 0x30, 0xbd, 0xf9, 0x24, 0x60, 0x02, 0xab, 0xad, 0xf8,
  0x12, 0x20, 0x0d, 0xf1, 0x10, 0x09, 0x0d, 0xf1, 0x18, 0x08, 0x01, 0x93,
  0x0b, 0xfb, 0x04, 0xfa, 0x2b, 0x68, 0x01, 0x34, 0x53, 0x44, 0x58, 0x68,
  0x00, 0xf0, 0x44, 0xfb, 0x01, 0x46, 0x01, 0x98, 0x00, 0xf0, 0xb0, 0xfa,
  0x39, 0xf9, 0x02, 0x3b, 0xad, 0xf8, 0x28, 0x70, 0xad, 0xf8, 0x2a, 0x30,
  0x38, 0xf9, 0x02, 0x3b, 0xad, 0xf8, 0x2c, 0x60, 0xad, 0xf8, 0x2e, 0x30,
  0x2b, 0x68, 0x53, 0x44, 0x58, 0x68, 0x00, 0xf0, 0x2f, 0xfb, 0x0c, 0xab,
  0x13, 0xe9, 0x06, 0x00, 0x00, 0xf0, 0xa6, 0xfa, 0x2b, 0x68, 0x72, 0x42,
  0x53, 0x44, 0x03, 0x2c, 0xc3, 0xe9, 0x05, 0x26, 0xdf, 0x61, 0xd5, 0xd1,
  0x0d, 0xb0, 0xbd, 0xe8, 0xf0, 0x8f, 0x00, 0xbf, 0x68, 0x09, 0x00, 0x00,
  0x00, 0x00, 0x00, 0x00, 0x38, 0xb5, 0x0f, 0x4b, 0x0f, 0x4a, 0x7b, 0x44,
  0x9c, 0x58, 0x25, 0x68, 0x00, 0xf0, 0xe8, 0xfa, 0x23, 0x68, 0xc5, 0xf8,
  0x84, 0x00, 0x4f, 0xf0, 0xff, 0x31, 0xd3, 0xf8, 0x84, 0x00, 0x00, 0xf0,
  0xeb, 0xfa, 0x23, 0x68, 0x08, 0x49, 0xd3, 0xf8, 0x84, 0x00, 0x79, 0x44,
  0x00, 0xf0, 0xea, 0xfa, 0x23, 0x68, 0xd3, 0xf8, 0x84, 0x00, 0xbd, 0xe8,
  0x38, 0x40, 0x00, 0xf0, 0xd7, 0xba, 0x00, 0xbf, 0xa2, 0x08, 0x00, 0x00,
  0x00, 0x00, 0x00, 0x00, 0x72, 0x08, 0x00, 0x00, 0xff, 0xf7, 0xd8, 0xbf,
  0xf7, 0xb5, 0xcd, 0xe9, 0x00, 0x23, 0x0c, 0x46, 0x06, 0x46, 0xdd, 0xe9,
  0x00, 0x01, 0x08, 0x9d, 0xbd, 0xf9, 0x04, 0x70, 0x00, 0xf0, 0xda, 0xfa,
  0x00, 0x21, 0x20, 0x60, 0x00, 0xf0, 0x00, 0xfb, 0x4f, 0xf0, 0x00, 0x01,
  0x20, 0x68, 0x00, 0xf0, 0xe9, 0xfa, 0x4f, 0xf0, 0xff, 0x31, 0x20, 0x68,
  0x00, 0xf0, 0xfc, 0xfa, 0x25, 0xb1, 0x29, 0x46, 0x20, 0x68, 0x00, 0xf0,
  0xe5, 0xfa, 0x01, 0x25, 0x01, 0x23, 0x23, 0x71, 0x00, 0x23, 0x7a, 0x42,
  0xc4, 0xe9, 0x04, 0x27, 0x09, 0x9a, 0xa3, 0x60, 0xc4, 0xe9, 0x07, 0x23,
  0xa3, 0x61, 0x4f, 0xf0, 0xff, 0x33, 0x25, 0x73, 0xc6, 0xe9, 0x1c, 0x33,
  0x03, 0xb0, 0xf0, 0xbd, 0x73, 0xb5, 0x04, 0x46, 0x00, 0x68, 0x0d, 0x46,
  0x00, 0xf0, 0xc0, 0xfa, 0x06, 0x46, 0x20, 0xb1, 0x02, 0x23, 0xa5, 0x60,
  0x23, 0x71, 0x02, 0xb0, 0x70, 0xbd, 0x29, 0x46, 0x20, 0x68, 0x00, 0xf0,
  0xc7, 0xfa, 0x20, 0x68, 0x00, 0xf0, 0xac, 0xfa, 0x01, 0x46, 0x68, 0x46,
  0x00, 0xf0, 0x18, 0xfa, 0x63, 0x69, 0x20, 0x68, 0xad, 0xf8, 0x00, 0x30,
  0x00, 0xf0, 0xa2, 0xfa, 0xdd, 0xe9, 0x00, 0x12, 0x00, 0xf0, 0x1a, 0xfa,
  0x26, 0x71, 0xe6, 0xe7, 0x2d, 0xe9, 0xf0, 0x43, 0x67, 0x4b, 0x68, 0x4a,
  0x7b, 0x44, 0x9b, 0x58, 0x85, 0xb0, 0x00, 0x20, 0x1c, 0x68, 0x00, 0xf0,
  0xbb, 0xfa, 0x01, 0x90, 0x01, 0xa8, 0x00, 0xf0, 0x5d, 0xfa, 0x63, 0x6f,
  0xd0, 0xe9, 0x01, 0x67, 0xb3, 0x42, 0x75, 0xd0, 0x94, 0xf8, 0x49, 0x11,
  0x04, 0xf1, 0x88, 0x05, 0x49, 0x01, 0x01, 0xf1, 0x81, 0x02, 0x41, 0x31,
  0x29, 0x44, 0x30, 0x46, 0x2a, 0x44, 0xff, 0xf7, 0x87, 0xfe, 0x94, 0xf8,
  0x49, 0x11, 0x23, 0x6f, 0x05, 0xeb, 0x41, 0x11, 0xbb, 0x42, 0x01, 0xf1,
  0x41, 0x01, 0x09, 0xd1, 0x14, 0x2e, 0x07, 0xdd, 0x0a, 0x22, 0x63, 0x6f,
  0x96, 0xfb, 0xf2, 0xf0, 0x93, 0xfb, 0xf2, 0xf3, 0x98, 0x42, 0x51, 0xd0,
  0x04, 0xf1, 0x28, 0x00, 0xff, 0xf7, 0xa4, 0xff, 0x94, 0xf8, 0x49, 0x31,
  0x04, 0xf1, 0x4c, 0x00, 0x05, 0xeb, 0x43, 0x11, 0x81, 0x31, 0xff, 0xf7,
  0x9b, 0xff, 0x94, 0xf8, 0x49, 0x31, 0x4f, 0xf0, 0x01, 0x09, 0xb3, 0xfa,
  0x83, 0xf3, 0x5b, 0x09, 0x84, 0xf8, 0x49, 0x31, 0x66, 0x67, 0x23, 0x6f,
  0xbb, 0x42, 0x17, 0xd0, 0x94, 0xf8, 0xc8, 0x10, 0x04, 0xf1, 0x88, 0x05,
  0x38, 0x46, 0x05, 0xeb, 0x41, 0x11, 0xff, 0xf7, 0xb1, 0xfe, 0x94, 0xf8,
  0xc8, 0x10, 0x20, 0x1d, 0x05, 0xeb, 0x41, 0x11, 0xff, 0xf7, 0x7e, 0xff,
  0x94, 0xf8, 0xc8, 0x30, 0x27, 0x67, 0xb3, 0xfa, 0x83, 0xf3, 0x5b, 0x09,
  0x84, 0xf8, 0xc8, 0x30, 0x25, 0x46, 0x04, 0xf1, 0x6c, 0x08, 0x02, 0xaf,
  0x68, 0x68, 0x00, 0xf0, 0x2f, 0xfa, 0x01, 0x46, 0x38, 0x46, 0x00, 0xf0,
  0x9b, 0xf9, 0x2a, 0x7a, 0x02, 0x2a, 0x18, 0xd0, 0x03, 0x2a, 0xbd, 0xf9,
  0x08, 0x60, 0x3e, 0xd0, 0x62, 0xb3, 0x24, 0x35, 0x45, 0x45, 0xed, 0xd1,
  0xb9, 0xf1, 0x00, 0x0f, 0x03, 0xd1, 0xd4, 0xf8, 0x84, 0x00, 0x00, 0xf0,
  0x07, 0xfa, 0x05, 0xb0, 0xbd, 0xe8, 0xf0, 0x83, 0xa0, 0x6a, 0x00, 0xf0,
  0x2b, 0xfa, 0xad, 0xe7, 0x4f, 0xf0, 0x00, 0x09, 0xbd, 0xe7, 0x6b, 0x6a,
  0x2a, 0x6a, 0x01, 0x33, 0x93, 0x42, 0x6b, 0x62, 0xc2, 0xbf, 0x03, 0x23,
  0x2b, 0x72, 0x00, 0x23, 0xee, 0x69, 0xc8, 0xbf, 0x6b, 0x62, 0x36, 0xb2,
  0x68, 0x68, 0x00, 0xf0, 0xff, 0xf9, 0xad, 0xf8, 0x08, 0x60, 0x97, 0xe8,
  0x06, 0x00, 0x00, 0xf0, 0x75, 0xf9, 0x4f, 0xf0, 0x01, 0x09, 0xd2, 0xe7,
  0x03, 0x21, 0xea, 0x69, 0xb3, 0x1a, 0x00, 0x2b, 0xb8, 0xbf, 0x5b, 0x42,
  0xb3, 0xfb, 0xf1, 0xf3, 0x01, 0x33, 0xf3, 0x1a, 0x1e, 0xb2, 0xb2, 0x42,
  0xe6, 0xdb, 0x01, 0x23, 0x16, 0xb2, 0x2b, 0x72, 0xe2, 0xe7, 0xeb, 0x69,
  0xf3, 0x1a, 0x00, 0x2b, 0xb8, 0xbf, 0x5b, 0x42, 0xb3, 0xfb, 0xf2, 0xf3,
  0x01, 0x33, 0xf6, 0x1a, 0x6b, 0x69, 0x36, 0xb2, 0x9e, 0x42, 0xd5, 0xdc,
  0x4f, 0xf0, 0x00, 0x09, 0xe9, 0x68, 0x68, 0x68, 0x85, 0xf8, 0x08, 0x90,
  0xb5, 0xf9, 0x18, 0x60, 0x00, 0xf0, 0xe6, 0xf9, 0xc5, 0xf8, 0x0c, 0x90,
  0xc8, 0xe7, 0x00, 0xbf, 0xa4, 0x07, 0x00, 0x00, 0x00, 0x00, 0x00, 0x00,
  0x2d, 0xe9, 0xf0, 0x47, 0x4f, 0xf4, 0xac, 0x70, 0x90, 0xb0, 0x80, 0x4d,
  0x00, 0xf0, 0x46, 0xf9, 0x7f, 0x4b, 0x7d, 0x44, 0xef, 0x58, 0x00, 0x25,
  0xc0, 0xe9, 0x53, 0x55, 0x80, 0xf8, 0xc8, 0x50, 0x80, 0xf8, 0x49, 0x51,
  0xc0, 0xf8, 0x54, 0x51, 0x04, 0x46, 0x38, 0x60, 0x00, 0xf0, 0x60, 0xf9,
  0x6f, 0xf0, 0x3f, 0x01, 0xc4, 0xf8, 0x80, 0x00, 0x00, 0xf0, 0x72, 0xf9,
  0x01, 0x20, 0x00, 0xf0, 0x33, 0xf9, 0x00, 0xf0, 0xfb, 0xf8, 0xa0, 0x67,
  0x02, 0x20, 0x00, 0xf0, 0x2d, 0xf9, 0x00, 0xf0, 0xf5, 0xf8, 0xe0, 0x67,
  0xd4, 0xf8, 0x80, 0x00, 0x00, 0xf0, 0x56, 0xf9, 0x80, 0x46, 0x01, 0x46,
  0x03, 0xa8, 0x00, 0xf0, 0x03, 0xf9, 0x06, 0x23, 0x4f, 0xf0, 0x46, 0x0a,
  0xbd, 0xf9, 0x12, 0x60, 0xbd, 0xf9, 0x10, 0x90, 0xa6, 0x3e, 0x01, 0x93,
  0x06, 0xeb, 0xd6, 0x76, 0xa3, 0x6f, 0x76, 0x10, 0xad, 0xf8, 0x2e, 0x60,
  0xad, 0xf8, 0x2c, 0x50, 0xad, 0xf8, 0x30, 0x90, 0xad, 0xf8, 0x32, 0xa0,
  0x21, 0x1d, 0x20, 0x46, 0x00, 0x93, 0xdd, 0xe9, 0x0b, 0x23, 0xff, 0xf7,
  0x85, 0xfe, 0x60, 0x68, 0x00, 0xf0, 0x74, 0xf9, 0xb6, 0xb2, 0x01, 0x46,
  0x40, 0x46, 0x00, 0xf0, 0xd9, 0xf8, 0x06, 0xf1, 0x30, 0x03, 0xad, 0xf8,
  0x26, 0x30, 0x03, 0x23, 0x01, 0x93, 0xe3, 0x6f, 0xad, 0xf8, 0x24, 0x50,
  0xad, 0xf8, 0x28, 0x90, 0xad, 0xf8, 0x2a, 0xa0, 0x04, 0xf1, 0x28, 0x01,
  0x20, 0x46, 0x00, 0x93, 0xdd, 0xe9, 0x09, 0x23, 0xff, 0xf7, 0x68, 0xfe,
  0xa0, 0x6a, 0x00, 0xf0, 0x57, 0xf9, 0x01, 0x46, 0x40, 0x46, 0x00, 0xf0,
  0xbd, 0xf8, 0x01, 0x95, 0xe3, 0x6f, 0x60, 0x36, 0xad, 0xf8, 0x1e, 0x60,
  0xad, 0xf8, 0x1c, 0x50, 0xad, 0xf8, 0x20, 0x90, 0xad, 0xf8, 0x22, 0xa0,
  0x04, 0xf1, 0x4c, 0x01, 0x20, 0x46, 0x00, 0x93, 0xdd, 0xe9, 0x07, 0x23,
  0xff, 0xf7, 0x4e, 0xfe, 0xe0, 0x6c, 0x00, 0xf0, 0x3d, 0xf9, 0x01, 0x46,
  0x40, 0x46, 0x00, 0xf0, 0xa3, 0xf8, 0x3e, 0x48, 0x78, 0x44, 0x00, 0xf0,
  0x87, 0xf8, 0x38, 0x4b, 0x38, 0x4a, 0x19, 0x46, 0x06, 0x46, 0x37, 0x48,
  0xcd, 0xe9, 0x05, 0x23, 0x00, 0xf0, 0x20, 0xf9, 0x29, 0x46, 0x20, 0x60,
  0x00, 0xf0, 0x34, 0xf9, 0x20, 0x68, 0x4f, 0xf0, 0xff, 0x31, 0x00, 0xf0,
  0x47, 0xf9, 0x31, 0x46, 0x20, 0x68, 0x00, 0xf0, 0x31, 0xf9, 0x32, 0x49,
  0x20, 0x68, 0x79, 0x44, 0x00, 0xf0, 0x32, 0xf9, 0x20, 0x68, 0x00, 0xf0,
  0x17, 0xf9, 0x01, 0x46, 0x40, 0x46, 0x00, 0xf0, 0x7d, 0xf8, 0x20, 0x68,
  0x00, 0xf0, 0x10, 0xf9, 0x01, 0x21, 0x00, 0xf0, 0x8f, 0xf8, 0x40, 0x46,
  0x00, 0xf0, 0x80, 0xf8, 0xff, 0xf7, 0xee, 0xfd, 0x27, 0x49, 0x02, 0x20,
  0x79, 0x44, 0x00, 0xf0, 0xa9, 0xf8, 0x26, 0x4b, 0x0d, 0x95, 0x7b, 0x44,
  0x0e, 0x93, 0x0f, 0x95, 0x0d, 0xaa, 0x07, 0xca, 0x2b, 0x46, 0x00, 0xf0,
  0x2f, 0xf9, 0x01, 0x21, 0xd4, 0xf8, 0x80, 0x00, 0x00, 0xf0, 0xb8, 0xf8,
  0x00, 0xf0, 0x3e, 0xf8, 0x00, 0xf0, 0x9c, 0xf8, 0x00, 0xf0, 0x2a, 0xf9,
  0x3b, 0x68, 0xd3, 0xf8, 0x84, 0x00, 0x00, 0xf0, 0xd7, 0xf8, 0x3b, 0x68,
  0x58, 0x68, 0x00, 0xf0, 0xdf, 0xf8, 0x3b, 0x68, 0x98, 0x6a, 0x00, 0xf0,
  0xdb, 0xf8, 0x3b, 0x68, 0xd8, 0x6c, 0x00, 0xf0, 0xd7, 0xf8, 0x3b, 0x68,
  0x18, 0x68, 0x00, 0xf0, 0xd3, 0xf8, 0x3b, 0x68, 0xd3, 0xf8, 0x80, 0x00,
  0x00, 0xf0, 0x8c, 0xf8, 0x3b, 0x68, 0x98, 0x6f, 0x00, 0xf0, 0x2e, 0xf8,
  0x3b, 0x68, 0xd8, 0x6f, 0x00, 0xf0, 0x2a, 0xf8, 0x38, 0x68, 0x00, 0xf0,
  0x2d, 0xf8, 0x28, 0x46, 0x10, 0xb0, 0xbd, 0xe8, 0xf0, 0x87, 0x00, 0xbf,
  0x64, 0x00, 0x14, 0x00, 0x00, 0x00, 0xfd, 0xff, 0xee, 0x05, 0x00, 0x00,
  0x00, 0x00, 0x00, 0x00, 0xe7, 0x03, 0x00, 0x00, 0xc7, 0x03, 0x00, 0x00,
  0x21, 0xfc, 0xff, 0xff, 0x03, 0xfb, 0xff, 0xff, 0x0f, 0xb4, 0x4f, 0xf0,
  0x7c, 0x01, 0xff, 0xf7, 0x61, 0xbc, 0x00, 0xbf, 0x0f, 0xb4, 0x4f, 0xf4,
  0xc0, 0x71, 0xff, 0xf7, 0x5b, 0xbc, 0x00, 0xbf, 0x0f, 0xb4, 0x4f, 0xf4,
  0xc2, 0x71, 0xff, 0xf7, 0x55, 0xbc, 0x00, 0xbf, 0x0f, 0xb4, 0x4f, 0xf4,
  0xc4, 0x71, 0xff, 0xf7, 0x4f, 0xbc, 0x00, 0xbf, 0x0f, 0xb4, 0x4f, 0xf4,
  0xc6, 0x71, 0xff, 0xf7, 0x49, 0xbc, 0x00, 0xbf, 0x0f, 0xb4, 0x4f, 0xf4,
  0x0a, 0x71, 0xff, 0xf7, 0x43, 0xbc, 0x00, 0xbf, 0x0f, 0xb4, 0x4f, 0xf4,
  0x11, 0x71, 0xff, 0xf7, 0x3d, 0xbc, 0x00, 0xbf, 0x0f, 0xb4, 0x4f, 0xf4,
  0x16, 0x71, 0xff, 0xf7, 0x37, 0xbc, 0x00, 0xbf, 0x0f, 0xb4, 0x4f, 0xf4,
  0x1b, 0x71, 0xff, 0xf7, 0x31, 0xbc, 0x00, 0xbf, 0x0f, 0xb4, 0x4f, 0xf4,
  0x1c, 0x71, 0xff, 0xf7, 0x2b, 0xbc, 0x00, 0xbf, 0x0f, 0xb4, 0x4f, 0xf4,
  0x21, 0x71, 0xff, 0xf7, 0x25, 0xbc, 0x00, 0xbf, 0x0f, 0xb4, 0x4f, 0xf4,
  0x4e, 0x71, 0xff, 0xf7, 0x1f, 0xbc, 0x00, 0xbf, 0x0f, 0xb4, 0x4f, 0xf4,
  0x71, 0x71, 0xff, 0xf7, 0x19, 0xbc, 0x00, 0xbf, 0x0f, 0xb4, 0x4f, 0xf4,
  0x73, 0x71, 0xff, 0xf7, 0x13, 0xbc, 0x00, 0xbf, 0x0f, 0xb4, 0x4f, 0xf4,
  0x75, 0x71, 0xff, 0xf7, 0x0d, 0xbc, 0x00, 0xbf, 0x0f, 0xb4, 0x4f, 0xf4,
  0x83, 0x61, 0xff, 0xf7, 0x07, 0xbc, 0x00, 0xbf, 0x0f, 0xb4, 0x40, 0xf2,
  0x1c, 0x41, 0xff, 0xf7, 0x01, 0xbc, 0x00, 0xbf, 0x0f, 0xb4, 0x40, 0xf2,
  0x3c, 0x41, 0xff, 0xf7, 0xfb, 0xbb, 0x00, 0xbf, 0x0f, 0xb4, 0x4f, 0xf4,
  0x88, 0x61, 0xff, 0xf7, 0xf5, 0xbb, 0x00, 0xbf, 0x0f, 0xb4, 0x40, 0xf2,
  0x4c, 0x41, 0xff, 0xf7, 0xef, 0xbb, 0x00, 0xbf, 0x0f, 0xb4, 0x40, 0xf2,
  0x7c, 0x41, 0xff, 0xf7, 0xe9, 0xbb, 0x00, 0xbf, 0x0f, 0xb4, 0x40, 0xf2,
  0xe4, 0x51, 0xff, 0xf7, 0xe3, 0xbb, 0x00, 0xbf, 0x0f, 0xb4, 0x40, 0xf2,
  0xec, 0x51, 0xff, 0xf7, 0xdd, 0xbb, 0x00, 0xbf, 0x0f, 0xb4, 0x4f, 0xf4,
  0xbe, 0x61, 0xff, 0xf7, 0xd7, 0xbb, 0x00, 0xbf, 0x0f, 0xb4, 0x4f, 0xf4,
  0xc0, 0x61, 0xff, 0xf7, 0xd1, 0xbb, 0x00, 0xbf, 0x0f, 0xb4, 0x4f, 0xf4,
  0xc2, 0x61, 0xff, 0xf7, 0xcb, 0xbb, 0x00, 0xbf, 0x0f, 0xb4, 0x4f, 0xf4,
  0xc3, 0x61, 0xff, 0xf7, 0xc5, 0xbb, 0x00, 0xbf, 0x0f, 0xb4, 0x40, 0xf2,
  0x1c, 0x61, 0xff, 0xf7, 0xbf, 0xbb, 0x00, 0xbf, 0x0f, 0xb4, 0x4f, 0xf4,
  0xe7, 0x61, 0xff, 0xf7, 0xb9, 0xbb, 0x00, 0xbf, 0x0f, 0xb4, 0x40, 0xf2,
  0x3c, 0x71, 0xff, 0xf7, 0xb3, 0xbb, 0x00, 0xbf, 0x0f, 0xb4, 0x40, 0xf2,
  0x44, 0x71, 0xff, 0xf7, 0xad, 0xbb, 0x00, 0xbf, 0x0f, 0xb4, 0x4f, 0xf4,
  0xe9, 0x61, 0xff, 0xf7, 0xa7, 0xbb, 0x00, 0xbf, 0x0f, 0xb4, 0x40, 0xf2,
  0x4c, 0x71, 0xff, 0xf7, 0xa1, 0xbb, 0x00, 0xbf, 0x0f, 0xb4, 0x4f, 0xf4,
  0xea, 0x61, 0xff, 0xf7, 0x9b, 0xbb, 0x00, 0xbf, 0x0f, 0xb4, 0x40, 0xf2,
  0x5c, 0x71, 0xff, 0xf7, 0x95, 0xbb, 0x00, 0xbf, 0x0f, 0xb4, 0x4f, 0xf4,
  0xec, 0x61, 0xff, 0xf7, 0x8f, 0xbb, 0x00, 0xbf, 0x0f, 0xb4, 0x40, 0xf2,
  0x64, 0x71, 0xff, 0xf7, 0x89, 0xbb, 0x00, 0xbf, 0x0f, 0xb4, 0x40, 0xf6,
  0x1c, 0x01, 0xff, 0xf7, 0x83, 0xbb, 0x00, 0xbf, 0x0f, 0xb4, 0x40, 0xf6,
  0xb8, 0x11, 0xff, 0xf7, 0x7d, 0xbb, 0x00, 0xbf, 0x0f, 0xb4, 0x4f, 0xf4,
  0x1c, 0x61, 0xff, 0xf7, 0x77, 0xbb, 0x00, 0xbf, 0x0f, 0xb4, 0x40, 0xf6,
  0xc4, 0x11, 0xff, 0xf7, 0x71, 0xbb, 0x00, 0xbf, 0x71, 0x75, 0x61, 0x72,
  0x74, 0x65, 0x72, 0x00, 0x25, 0x73, 0x20, 0x25, 0x73, 0x20, 0x00, 0x61,
  0x66, 0x74, 0x65, 0x72, 0x00, 0x74, 0x6f, 0x00, 0x68, 0x61, 0x6c, 0x66,
  0x00, 0x70, 0x61, 0x73, 0x74, 0x00, 0x6d, 0x69, 0x64, 0x6e, 0x69, 0x67,
  0x68, 0x74, 0x00, 0x6e, 0x6f, 0x6f, 0x6e, 0x00, 0x6f, 0x27, 0x00, 0x20,
  0x25, 0x73, 0x25, 0x73, 0x00, 0x63, 0x6c, 0x6f, 0x63, 0x6b, 0x00, 0x74,
  0x65, 0x6e, 0x00, 0x74, 0x77, 0x65, 0x6e, 0x74, 0x79, 0x00, 0x74, 0x68,
  0x69, 0x72, 0x74, 0x79, 0x00, 0x66, 0x6f, 0x72, 0x74, 0x79, 0x00, 0x66,
  0x69, 0x66, 0x74, 0x79, 0x00, 0x73, 0x69, 0x78, 0x74, 0x79, 0x00, 0x73,
  0x65, 0x76, 0x65, 0x6e, 0x74, 0x79, 0x00, 0x65, 0x69, 0x67, 0x68, 0x74,
  0x79, 0x00, 0x6e, 0x69, 0x6e, 0x65, 0x74, 0x79, 0x00, 0x65, 0x6c, 0x65,
  0x76, 0x65, 0x6e, 0x00, 0x74, 0x77, 0x65, 0x6c, 0x76, 0x65, 0x00, 0x74,
  0x68, 0x69, 0x72, 0x74, 0x65, 0x65, 0x6e, 0x00, 0x66, 0x6f, 0x75, 0x72,
  0x00, 0x66, 0x69, 0x66, 0x74, 0x65, 0x65, 0x6e, 0x00, 0x73, 0x69, 0x78,
  0x74, 0x65, 0x65, 0x6e, 0x00, 0x73, 0x65, 0x76, 0x65, 0x6e, 0x00, 0x65,
  0x69, 0x67, 0x68, 0x74, 0x00, 0x6e, 0x69, 0x6e, 0x65, 0x00, 0x66, 0x6f,
  0x75, 0x72, 0x74, 0x65, 0x65, 0x6e, 0x00, 0x73, 0x65, 0x76, 0x65, 0x6e,
  0x74, 0x65, 0x65, 0x6e, 0x00, 0x65, 0x69, 0x67, 0x68, 0x74, 0x65, 0x65,
  0x6e, 0x00, 0x6e, 0x69, 0x6e, 0x65, 0x74, 0x65, 0x65, 0x6e, 0x00, 0x7a,
  0x65, 0x72, 0x6f, 0x00, 0x6f, 0x6e, 0x65, 0x00, 0x74, 0x77, 0x6f, 0x00,
  0x74, 0x68, 0x72, 0x65, 0x65, 0x00, 0x66, 0x69, 0x76, 0x65, 0x00, 0x73,
  0x69, 0x78, 0x00, 0x52, 0x45, 0x53, 0x4f, 0x55, 0x52, 0x43, 0x45, 0x5f,
  0x49, 0x44, 0x5f, 0x47, 0x4f, 0x54, 0x48, 0x49, 0x43, 0x5f, 0x31, 0x34,
  0x00, 0x64, 0x65, 0x6d, 0x6f, 0x20, 0x6d, 0x6f, 0x64, 0x65, 0x00, 0x00,
  0xf8, 0xb5, 0x00, 0xbf, 0xf8, 0xb5, 0x00, 0xbf, 0xd6, 0x09, 0x00, 0x00,
  0x07, 0x0a, 0x00, 0x00, 0x0b, 0x0a, 0x00, 0x00, 0x12, 0x0a, 0x00, 0x00,
  0x19, 0x0a, 0x00, 0x00, 0x1f, 0x0a, 0x00, 0x00, 0x25, 0x0a, 0x00, 0x00,
  0x2b, 0x0a, 0x00, 0x00, 0x33, 0x0a, 0x00, 0x00, 0x3a, 0x0a, 0x00, 0x00,
  0xd6, 0x09, 0x00, 0x00, 0xd6, 0x09, 0x00, 0x00, 0x41, 0x0a, 0x00, 0x00,
  0xd6, 0x09, 0x00, 0x00, 0x48, 0x0a, 0x00, 0x00, 0xd6, 0x09, 0x00, 0x00,
  0x4f, 0x0a, 0x00, 0x00, 0xd6, 0x09, 0x00, 0x00, 0x58, 0x0a, 0x00, 0x00,
  0x9e, 0x0a, 0x00, 0x00, 0x5d, 0x0a, 0x00, 0x00, 0xd6, 0x09, 0x00, 0x00,
  0x65, 0x0a, 0x00, 0x00, 0xd6, 0x09, 0x00, 0x00, 0x6d, 0x0a, 0x00, 0x00,
  0x9e, 0x0a, 0x00, 0x00, 0x73, 0x0a, 0x00, 0x00, 0x9e, 0x0a, 0x00, 0x00,
  0x79, 0x0a, 0x00, 0x00, 0x9e, 0x0a, 0x00, 0x00, 0xd6, 0x09, 0x00, 0x00,
  0x41, 0x0a, 0x00, 0x00, 0x48, 0x0a, 0x00, 0x00, 0x4f, 0x0a, 0x00, 0x00,
  0x7e, 0x0a, 0x00, 0x00, 0x5d, 0x0a, 0x00, 0x00, 0x65, 0x0a, 0x00, 0x00,
  0x87, 0x0a, 0x00, 0x00, 0x91, 0x0a, 0x00, 0x00, 0x9a, 0x0a, 0x00, 0x00,
  0xa3, 0x0a, 0x00, 0x00, 0xa8, 0x0a, 0x00, 0x00, 0xac, 0x0a, 0x00, 0x00,
  0xb0, 0x0a, 0x00, 0x00, 0x58, 0x0a, 0x00, 0x00, 0xb6, 0x0a, 0x00, 0x00,
  0xbb, 0x0a, 0x00, 0x00, 0x6d, 0x0a, 0x00, 0x00, 0x73, 0x0a, 0x00, 0x00,
  0x79, 0x0a, 0x00, 0x00, 0x00, 0x00, 0x00, 0x00, 0x0d, 0x04, 0x00, 0x00,
  0x00, 0x00, 0x00, 0x00, 0xcc, 0x0b, 0x00, 0x00, 0x00, 0x00, 0x00, 0x00,
  0x00, 0x00, 0x00, 0x00, 0x00, 0x00, 0x00, 0x00, 0xe8, 0x0a, 0x00, 0x00,
  0xec, 0x0a, 0x00, 0x00, 0xf0, 0x0a, 0x00, 0x00, 0xf4, 0x0a, 0x00, 0x00,
  0xf8, 0x0a, 0x00, 0x00, 0xfc, 0x0a, 0x00, 0x00, 0x00, 0x0b, 0x00, 0x00,
  0x04, 0x0b, 0x00, 0x00, 0x08, 0x0b, 0x00, 0x00, 0x0c, 0x0b, 0x00, 0x00,
  0x10, 0x0b, 0x00, 0x00, 0x14, 0x0b, 0x00, 0x00, 0x18, 0x0b, 0x00, 0x00,
  0x1c, 0x0b, 0x00, 0x00, 0x20, 0x0b, 0x00, 0x00, 0x24, 0x0b, 0x00, 0x00,
  0x28, 0x0b, 0x00, 0x00, 0x2c, 0x0b, 0x00, 0x00, 0x30, 0x0b, 0x00, 0x00,
  0x34, 0x0b, 0x00, 0x00, 0x38, 0x0b, 0x00, 0x00, 0x3c, 0x0b, 0x00, 0x00,
  0x40, 0x0b, 0x00, 0x00, 0x44, 0x0b, 0x00, 0x00, 0x48, 0x0b, 0x00, 0x00,
  0x4c, 0x0b, 0x00, 0x00, 0x50, 0x0b, 0x00, 0x00, 0x54, 0x0b, 0x00, 0x00,
  0x58, 0x0b, 0x00, 0x00, 0x5c, 0x0b, 0x00, 0x00, 0x60, 0x0b, 0x00, 0x00,
  0x64, 0x0b, 0x00, 0x00, 0x68, 0x0b, 0x00, 0x00, 0x6c, 0x0b, 0x00, 0x00,
  0x70, 0x0b, 0x00, 0x00, 0x74, 0x0b, 0x00, 0x00, 0x78, 0x0b, 0x00, 0x00,
  0x7c, 0x0b, 0x00, 0x00, 0x80, 0x0b, 0x00, 0x00, 0x84, 0x0b, 0x00, 0x00,
  0x88, 0x0b, 0x00, 0x00, 0x8c, 0x0b, 0x00, 0x00, 0x90, 0x0b, 0x00, 0x00,
  0x94, 0x0b, 0x00, 0x00, 0x98, 0x0b, 0x00, 0x00, 0x9c, 0x0b, 0x00, 0x00,
  0xa0, 0x0b, 0x00, 0x00, 0xa4, 0x0b, 0x00, 0x00, 0xa8, 0x0b, 0x00, 0x00,
  0xac, 0x0b, 0x00, 0x00, 0xb4, 0x0b, 0x00, 0x00, 0xbc, 0x0b, 0x00, 0x00
};
const size_t sliding_text_emery_pbw_len = sizeof(sliding_text_emery_pbw);
```

## src/sliding_text_emery_bin.h
```c
/* SPDX-License-Identifier: Apache-2.0 */

#pragma once

#include <stddef.h>
#include <stdint.h>

extern const uint8_t sliding_text_emery_pbw[];
extern const size_t sliding_text_emery_pbw_len;
```

## src/syscall_demo.c
```c
/*
 * Copyright (c) 2026 Core Devices LLC
 * SPDX-License-Identifier: Apache-2.0
 */

#include "syscall_demo.h"

#include <zephyr/arch/arm/custom_sandbox_hooks.h>
#include <zephyr/arch/arm/mpu/arm_mpu.h>
#include <zephyr/kernel.h>
#include <zephyr/linker/linker-defs.h>
#include <zephyr/linker/sections.h>
#include <zephyr/sys/atomic.h>
#include <zephyr/sys/printk.h>
#include <zephyr/sys/util.h>
#include <zephyr/toolchain.h>

#include <cmsis_core.h>
#include <stdint.h>

#define APP_STACK_SIZE 2048U
#define MPU_MIN_ALIGN 32U
#define SVC_EXC_RETURN_PSP BIT(2)
#define SYSCALL_DEMO_TIMEOUT_MS 1000

#define DEFINE_SYSCALL(ret_type, function_name, ...)                              \
  ret_type __attribute__((naked, used, section(".text.syscall_text." #function_name))) \
      function_name(__VA_ARGS__) {                                               \
    __asm volatile(                                                              \
        "push {lr}\n"                                                           \
        "bl syscall_demo_maybe_skip_privilege\n"                               \
        ".global syscall_demo_svc_callsite\n"                                  \
        "syscall_demo_svc_callsite:\n"                                         \
        "svc #4\n"                                                              \
        "b __" #function_name "\n");                                           \
  }                                                                              \
  ret_type __attribute__((used)) __##function_name(__VA_ARGS__)

static struct k_thread s_app_thread;
static struct z_thread_stack_element __kstackmem __aligned(MPU_MIN_ALIGN)
    s_app_stack[K_KERNEL_STACK_LEN(APP_STACK_SIZE)];

static atomic_t s_sandbox_ready;
static atomic_t s_syscall_returned;
uintptr_t syscall_demo_app_return_address __attribute__((used));
static uint32_t s_app_stack_start;
static uint32_t s_app_stack_size;
static uint32_t s_saved_sram_rbar;
static uint32_t s_saved_sram_rlar;
static uint32_t s_saved_code_rbar;
static uint32_t s_saved_code_rlar;
static uint32_t s_app_code_rbar;
static uint32_t s_app_code_rlar;
static uint8_t s_sram_region;
static uint8_t s_code_region;
static bool s_code_region_needed;

extern const uint16_t syscall_demo_svc_callsite[];

static void prv_mpu_region_read(uint8_t region, uint32_t *rbar,
                                uint32_t *rlar) {
  MPU->RNR = region;
  *rbar = MPU->RBAR;
  *rlar = MPU->RLAR;
}

static void prv_mpu_region_write(uint8_t region, uint32_t rbar,
                                 uint32_t rlar) {
  __DMB();
  MPU->RNR = region;
  MPU->RBAR = rbar;
  MPU->RLAR = rlar;
  __DSB();
  __ISB();
}

static bool prv_region_contains(uint32_t rbar, uint32_t rlar, uint32_t start,
                                uint32_t size) {
  const uint32_t base = rbar & MPU_RBAR_BASE_Msk;
  const uint32_t limit = (rlar & MPU_RLAR_LIMIT_Msk) | (MPU_MIN_ALIGN - 1U);

  return (rlar & MPU_RLAR_EN_Msk) != 0U && start >= base &&
         (start + size - 1U) <= limit;
}

static bool prv_region_is_user_executable(uint32_t rbar, uint32_t rlar,
                                          uint32_t start, uint32_t size) {
  const uint32_t ap = (rbar & MPU_RBAR_AP_Msk) >> MPU_RBAR_AP_Pos;

  return prv_region_contains(rbar, rlar, start, size) &&
         (rbar & MPU_RBAR_XN_Msk) == 0U &&
         (ap == P_RW_U_RW || ap == P_RO_U_RO);
}

void z_arm_custom_thread_restore_hook(struct k_thread *incoming) {
  uint32_t control = __get_CONTROL();

  if (!atomic_get(&s_sandbox_ready)) {
    return;
  }

  if (incoming == &s_app_thread) {
    const uint32_t rbar =
        (s_app_stack_start & MPU_RBAR_BASE_Msk) | P_RW_U_RW_Msk |
        MPU_RBAR_XN_Msk;
    const uint32_t rlar =
        ((s_app_stack_start + s_app_stack_size - 1U) & MPU_RLAR_LIMIT_Msk) |
        (MPU_MAIR_INDEX_SRAM << MPU_RLAR_AttrIndx_Pos) | MPU_RLAR_EN_Msk;

    if (s_code_region_needed) {
      prv_mpu_region_write(s_code_region, s_app_code_rbar, s_app_code_rlar);
    }
    prv_mpu_region_write(s_sram_region, rbar, rlar);
    __set_CONTROL(control | CONTROL_nPRIV_Msk);
  } else {
    prv_mpu_region_write(s_sram_region, s_saved_sram_rbar,
                         s_saved_sram_rlar);
    if (s_code_region_needed) {
      prv_mpu_region_write(s_code_region, s_saved_code_rbar,
                           s_saved_code_rlar);
    }
    __set_CONTROL(control & ~CONTROL_nPRIV_Msk);
  }
  __ISB();
}

static void __attribute__((naked, used)) syscall_demo_drop_privilege(void) {
  __asm volatile(
      "ldr r12, =syscall_demo_app_return_address\n"
      "ldr r12, [r12]\n"
      "mrs r2, control\n"
      "orr r2, r2, #1\n"
      "msr control, r2\n"
      "isb\n"
      "bx r12\n");
}

int z_arm_custom_svc_hook(uint32_t *exc_frame, uint32_t exc_return,
                          uint8_t svc_num) {
  const uint32_t stack_end = s_app_stack_start + s_app_stack_size;
  const uint32_t expected_pc =
      (uint32_t)(uintptr_t)syscall_demo_svc_callsite + sizeof(uint16_t);
  const uint32_t msp = __get_MSP();

  if (svc_num != 4U || k_current_get() != &s_app_thread ||
      (exc_return & SVC_EXC_RETURN_PSP) == 0U ||
      (__get_CONTROL() & CONTROL_nPRIV_Msk) == 0U ||
      (uint32_t)exc_frame < s_app_stack_start ||
      ((uint32_t)exc_frame + 8U * sizeof(uint32_t)) > stack_end ||
      (msp >= s_app_stack_start && msp < stack_end) ||
      exc_frame[6] != expected_pc) {
    exc_frame[0] = UINT32_MAX;
    return 1;
  }

  syscall_demo_app_return_address = exc_frame[5];
  exc_frame[5] = (uint32_t)(uintptr_t)&syscall_demo_drop_privilege;

  uint32_t control = __get_CONTROL();
  __set_CONTROL(control & ~CONTROL_nPRIV_Msk);
  __ISB();
  return 1;
}

static bool __attribute__((noinline, used)) prv_thread_is_privileged(void) {
  return (__get_CONTROL() & CONTROL_nPRIV_Msk) == 0U;
}

void __attribute__((naked, used)) syscall_demo_maybe_skip_privilege(void) {
  __asm volatile(
      "push {r0-r3, lr}\n"
      "bl prv_thread_is_privileged\n"
      "cmp r0, #1\n"
      "pop {r0-r3, lr}\n"
      "it eq\n"
      "addeq lr, #2\n"
      "mov ip, lr\n"
      "pop {lr}\n"
      "push {ip}\n"
      "pop {pc}\n");
}

DEFINE_SYSCALL(int, syscall_demo_double, int value) {
  if (value == 42) {
    atomic_set(&s_syscall_returned, 1);
  }
  return value * 2;
}

static void prv_app_entry(void *p1, void *p2, void *p3) {
  ARG_UNUSED(p1);
  ARG_UNUSED(p2);
  ARG_UNUSED(p3);

  const int value = syscall_demo_double(21);
  (void)syscall_demo_double(value);
  for (;;) {
    __WFE();
  }
}

static bool prv_sandbox_prepare(void) {
  const uint8_t regions =
      (MPU->TYPE & MPU_TYPE_DREGION_Msk) >> MPU_TYPE_DREGION_Pos;
  const uint32_t code_start =
      ROUND_DOWN((uint32_t)__text_region_start, MPU_MIN_ALIGN);
  const uint32_t code_end =
      ROUND_UP((uint32_t)__text_region_end, MPU_MIN_ALIGN);
  bool sram_found = false;
  bool code_slot_found = false;
  bool code_access_found = false;

  if (regions < 8U ||
      (s_app_stack_start & (MPU_MIN_ALIGN - 1U)) != 0U ||
      (s_app_stack_size & (MPU_MIN_ALIGN - 1U)) != 0U ||
      code_end <= code_start ||
      !IN_RANGE((uint32_t)prv_app_entry, code_start, code_end - 1U)) {
    return false;
  }

  for (uint8_t i = 0U; i < regions; ++i) {
    uint32_t rbar;
    uint32_t rlar;
    prv_mpu_region_read(i, &rbar, &rlar);
    if (prv_region_is_user_executable(rbar, rlar, code_start,
                                      code_end - code_start)) {
      code_access_found = true;
    }
    if (prv_region_contains(rbar, rlar, s_app_stack_start,
                            s_app_stack_size)) {
      s_sram_region = i;
      s_saved_sram_rbar = rbar;
      s_saved_sram_rlar = rlar;
      sram_found = true;
    }
  }
  if (!sram_found) {
    return false;
  }

  for (int i = regions - 1; !code_access_found && i >= 0; --i) {
    uint32_t rbar;
    uint32_t rlar;
    prv_mpu_region_read((uint8_t)i, &rbar, &rlar);
    if ((rlar & MPU_RLAR_EN_Msk) == 0U) {
      s_code_region = (uint8_t)i;
      s_saved_code_rbar = rbar;
      s_saved_code_rlar = rlar;
      code_slot_found = true;
      break;
    }
  }
  if (!code_access_found && !code_slot_found) {
    return false;
  }

  s_code_region_needed = !code_access_found;
  if (s_code_region_needed) {
    s_app_code_rbar = (code_start & MPU_RBAR_BASE_Msk) | P_RO_U_RO_Msk;
    s_app_code_rlar =
        ((code_end - 1U) & MPU_RLAR_LIMIT_Msk) |
        (MPU_MAIR_INDEX_FLASH << MPU_RLAR_AttrIndx_Pos) | MPU_RLAR_EN_Msk;
  }
  return true;
}

bool syscall_demo_run(void) {
  s_app_stack_start = (uint32_t)K_KERNEL_STACK_BUFFER(s_app_stack);
  s_app_stack_size = K_KERNEL_STACK_SIZEOF(s_app_stack);

  k_thread_create(&s_app_thread, s_app_stack, s_app_stack_size, prv_app_entry,
                  NULL, NULL, NULL, 5, 0, K_FOREVER);
  k_thread_name_set(&s_app_thread, "pbw-syscall-demo");

  if (!prv_sandbox_prepare()) {
    printk("SYSCALL_FAIL: MPU setup\n");
    return false;
  }

  atomic_set(&s_sandbox_ready, 1);
  k_thread_start(&s_app_thread);

  for (int elapsed = 0; elapsed < SYSCALL_DEMO_TIMEOUT_MS; ++elapsed) {
    if (atomic_get(&s_syscall_returned)) {
      printk("SYSCALL: DEFINE_SYSCALL svc#4 returned 42\n");
      return true;
    }
    k_sleep(K_MSEC(1));
  }

  printk("SYSCALL_FAIL: timeout\n");
  return false;
}
```

## src/syscall_demo.h
```c
/* SPDX-License-Identifier: Apache-2.0 */

#pragma once

#include <stdbool.h>

bool syscall_demo_run(void);
```
