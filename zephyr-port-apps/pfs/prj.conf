## CMakeLists.txt
```
# SPDX-License-Identifier: Apache-2.0

cmake_minimum_required(VERSION 3.20.0)

set(USER_CACHE_DIR "${CMAKE_BINARY_DIR}/.cache" CACHE PATH "Zephyr cache directory")
find_package(Zephyr REQUIRED HINTS $ENV{ZEPHYR_BASE})
project(pebbleos_zephyr_pfs)

get_filename_component(PEBBLEOS_ROOT "${CMAKE_CURRENT_SOURCE_DIR}/../.." ABSOLUTE)

target_include_directories(app PRIVATE
  "${CMAKE_CURRENT_SOURCE_DIR}/include"
  "${PEBBLEOS_ROOT}/include"
  "${PEBBLEOS_ROOT}/src/fw"
)

target_compile_definitions(app PRIVATE
  CONFIG_FLASH_GD25Q256E=1
  CONFIG_PBLBOOT=1
  CONFIG_RECOVERY_FW=1
  CONFIG_SERVICE_FILESYSTEM_LOG_LEVEL=0
  CONFIG_SOC_SF32LB52=1
)

target_sources(app PRIVATE
  src/flash_shim.c
  src/main.c
  src/port.c
  "${PEBBLEOS_ROOT}/lib/os/mutex_zephyr.c"
  "${PEBBLEOS_ROOT}/lib/os/platform_zephyr.c"
  "${PEBBLEOS_ROOT}/lib/os/semaphore_zephyr.c"
  "${PEBBLEOS_ROOT}/lib/os/tick_zephyr.c"
  "${PEBBLEOS_ROOT}/lib/util/list.c"
  "${PEBBLEOS_ROOT}/src/fw/flash_region/filesystem_regions.c"
  "${PEBBLEOS_ROOT}/src/fw/flash_region/flash_region.c"
  "${PEBBLEOS_ROOT}/src/fw/services/filesystem/flash_translation.c"
  "${PEBBLEOS_ROOT}/src/fw/services/filesystem/pfs.c"
  "${PEBBLEOS_ROOT}/src/fw/util/crc8.c"
  "${PEBBLEOS_ROOT}/src/fw/util/legacy_checksum.c"
)
```

## prj.conf
```kconfig
CONFIG_ASSERT=y
CONFIG_BOOT_BANNER=n
CONFIG_CONSOLE=y
CONFIG_CRC=y
CONFIG_FLASH=y
CONFIG_HEAP_MEM_POOL_SIZE=65536
CONFIG_MAIN_STACK_SIZE=4096
CONFIG_PRINTK=y
CONFIG_SERIAL=y
CONFIG_UART_CONSOLE=y

# The bring-up result is emitted as concise PFS_* markers over UART.
CONFIG_LOG=n
```

## src/main.c
```c
/* SPDX-License-Identifier: Apache-2.0 */

#include <stddef.h>
#include <stdint.h>
#include <string.h>

#include <zephyr/sys/crc.h>
#include <zephyr/sys/printk.h>

#include "pbl/services/filesystem/pfs.h"
#include "pfs_flash_shim.h"

#define TEST_FILE_NAME "zephyr-pfs-selftest"
#define TEST_PAYLOAD_SIZE 257u

extern void pfs_reset_all_state(void);

static int prv_fail(const char *detail, int result) {
  printk("PFS_FAIL %s %d\n", detail, result);
  return result == 0 ? -1 : result;
}

static void prv_fill_payload(uint8_t *payload, size_t size) {
  uint8_t value = 0x5au;

  for (size_t index = 0; index < size; ++index) {
    value = (uint8_t)((value * 33u) ^ (uint8_t)index ^ 0xa7u);
    payload[index] = value;
  }
}

static int prv_read_and_verify(const uint8_t *expected, uint8_t *actual,
                               size_t size, uint32_t *crc) {
  int fd = pfs_open(TEST_FILE_NAME, OP_FLAG_READ, FILE_TYPE_STATIC, 0);
  if (fd < 0) {
    return prv_fail("open_read", fd);
  }

  size_t file_size = pfs_get_file_size(fd);
  if (file_size != size) {
    (void)pfs_close(fd);
    return prv_fail("file_size", (int)file_size);
  }

  int bytes_read = pfs_read(fd, actual, size);
  if (bytes_read != (int)size) {
    (void)pfs_close(fd);
    return prv_fail("read", bytes_read);
  }

  if (memcmp(expected, actual, size) != 0) {
    (void)pfs_close(fd);
    return prv_fail("memcmp", -1);
  }

  *crc = crc32_ieee(actual, size);
  int result = pfs_close(fd);
  if (result < 0) {
    return prv_fail("close_read", result);
  }

  return 0;
}

int main(void) {
  uint8_t payload[TEST_PAYLOAD_SIZE];
  uint8_t readback[TEST_PAYLOAD_SIZE];
  uint32_t crc;
  int result;

  prv_fill_payload(payload, sizeof(payload));

  result = pfs_flash_shim_init();
  if (result != 0) {
    return prv_fail("flash_init", result);
  }

  result = pfs_init(false);
  if (result < 0) {
    return prv_fail("mount", result);
  }
  pfs_format(true);
  if (!pfs_active()) {
    return prv_fail("format", -1);
  }
  printk("PFS_MOUNT_OK\n");

  int fd = pfs_open(TEST_FILE_NAME, OP_FLAG_WRITE, FILE_TYPE_STATIC,
                    sizeof(payload));
  if (fd < 0) {
    return prv_fail("open_write", fd);
  }

  int bytes_written = pfs_write(fd, payload, sizeof(payload));
  if (bytes_written != (int)sizeof(payload)) {
    (void)pfs_close(fd);
    return prv_fail("write", bytes_written);
  }

  result = pfs_close(fd);
  if (result < 0) {
    return prv_fail("close_write", result);
  }
  printk("PFS_WRITE_OK %d\n", bytes_written);

  memset(readback, 0, sizeof(readback));
  result = prv_read_and_verify(payload, readback, sizeof(readback), &crc);
  if (result != 0) {
    return result;
  }
  printk("PFS_READ_OK %08x\n", crc);

  pfs_reset_all_state();
  result = pfs_init(false);
  if (result < 0) {
    return prv_fail("remount", result);
  }

  memset(readback, 0, sizeof(readback));
  result = prv_read_and_verify(payload, readback, sizeof(readback), &crc);
  if (result != 0) {
    return result;
  }
  printk("PFS_PERSIST_OK\n");

  result = pfs_remove(TEST_FILE_NAME);
  if (result < 0) {
    return prv_fail("remove", result);
  }

  pfs_reset_all_state();
  result = pfs_init(false);
  if (result < 0) {
    return prv_fail("delete_remount", result);
  }

  fd = pfs_open(TEST_FILE_NAME, OP_FLAG_READ, FILE_TYPE_STATIC, 0);
  if (fd >= 0) {
    (void)pfs_close(fd);
    return prv_fail("delete_persist", fd);
  }

  printk("PFS_DONE\n");
  return 0;
}
```

## include/pfs_flash_shim.h
```c
/* SPDX-License-Identifier: Apache-2.0 */

#pragma once

int pfs_flash_shim_init(void);
```

## src/flash_shim.c
```c
/* SPDX-License-Identifier: Apache-2.0 */

#include "pfs_flash_shim.h"

#include <errno.h>
#include <stddef.h>
#include <stdint.h>

#include <zephyr/device.h>
#include <zephyr/devicetree.h>
#include <zephyr/drivers/flash.h>

#include "flash_region/flash_region.h"
#include "system/passert.h"

#define PFS_FLASH_NODE DT_NODELABEL(mpi2)

#define PFS_DEVICE_OFFSET(address) ((address) - FLASH_REGION_BASE_ADDRESS)

static const struct device *const s_flash = DEVICE_DT_GET(PFS_FLASH_NODE);

static void prv_check_range(uint32_t address, size_t size, const char *operation) {
  if ((address < FLASH_REGION_FILESYSTEM_BEGIN) ||
      (address > FLASH_REGION_FILESYSTEM_END) ||
      (size > (FLASH_REGION_FILESYSTEM_END - address))) {
    pfs_port_panic(__FILE__, __LINE__, "%s out of range: %#x + %u",
                   operation, address, (unsigned int)size);
  }
}

static void prv_check_result(const char *operation, int result) {
  if (result != 0) {
    pfs_port_panic(__FILE__, __LINE__, "%s failed: %d", operation, result);
  }
}

int pfs_flash_shim_init(void) {
  if (!device_is_ready(s_flash)) {
    return -ENODEV;
  }

  uint64_t flash_size;
  int result = flash_get_size(s_flash, &flash_size);
  if (result != 0) {
    return result;
  }

  if (PFS_DEVICE_OFFSET(FLASH_REGION_FILESYSTEM_END) > flash_size) {
    return -ERANGE;
  }

  return 0;
}

void flash_read_bytes(uint8_t *buffer, uint32_t start_addr,
                      uint32_t buffer_size) {
  prv_check_range(start_addr, buffer_size, "flash_read");
  prv_check_result("flash_read",
                   flash_read(s_flash, PFS_DEVICE_OFFSET(start_addr), buffer,
                              buffer_size));
}

void flash_write_bytes(const uint8_t *buffer, uint32_t start_addr,
                       uint32_t buffer_size) {
  prv_check_range(start_addr, buffer_size, "flash_write");
  prv_check_result("flash_write",
                   flash_write(s_flash, PFS_DEVICE_OFFSET(start_addr), buffer,
                               buffer_size));
}

void flash_erase_subsector_blocking(uint32_t subsector_addr) {
  PBL_ASSERTN((subsector_addr & (SUBSECTOR_SIZE_BYTES - 1u)) == 0);
  prv_check_range(subsector_addr, SUBSECTOR_SIZE_BYTES, "flash_erase_4k");
  prv_check_result("flash_erase_4k",
                   flash_erase(s_flash, PFS_DEVICE_OFFSET(subsector_addr),
                               SUBSECTOR_SIZE_BYTES));
}

void flash_erase_sector_blocking(uint32_t sector_addr) {
  PBL_ASSERTN((sector_addr & (SECTOR_SIZE_BYTES - 1u)) == 0);
  prv_check_range(sector_addr, SECTOR_SIZE_BYTES, "flash_erase_64k");
  prv_check_result("flash_erase_64k",
                   flash_erase(s_flash, PFS_DEVICE_OFFSET(sector_addr),
                               SECTOR_SIZE_BYTES));
}
```

## src/port.c
```c
/* SPDX-License-Identifier: Apache-2.0 */

#include <stdarg.h>
#include <stddef.h>
#include <stdint.h>
#include <string.h>

#include <zephyr/kernel.h>
#include <zephyr/sys/printk.h>

#include "kernel/pbl_malloc.h"
#include "kernel/pebble_tasks.h"
#include "pbl/os/malloc.h"

void pfs_port_panic(const char *file, int line, const char *format, ...) {
  va_list arguments;

  printk("PFS_FAIL %s:%d ", file, line);
  va_start(arguments, format);
  vprintk(format, arguments);
  va_end(arguments);
  printk("\n");
  k_panic();
  CODE_UNREACHABLE;
}

void *kernel_malloc(size_t size) {
  return os_malloc(size);
}

void *kernel_malloc_check(size_t size) {
  return os_malloc_check(size);
}

void kernel_free(void *pointer) {
  os_free(pointer);
}

char *kernel_strdup(const char *string) {
  size_t size = strlen(string) + 1u;
  char *copy = os_malloc(size);
  if (copy != NULL) {
    memcpy(copy, string, size);
  }
  return copy;
}

char *kernel_strdup_check(const char *string) {
  char *copy = kernel_strdup(string);
  if (copy == NULL) {
    pfs_port_panic(__FILE__, __LINE__, "out of memory");
  }
  return copy;
}

void psleep(int millis) {
  if (millis == 0) {
    k_yield();
  } else {
    k_msleep(millis);
  }
}

uint64_t rtc_get_ticks(void) {
  return k_uptime_get();
}

PebbleTask pebble_task_get_current(void) {
  return PebbleTask_KernelMain;
}

void task_watchdog_bit_set(PebbleTask task) {
  (void)task;
}

void util_assertion_failed(const char *file, int line) {
  pfs_port_panic(file, line, "utility assertion");
}

void util_log(const char *file, int line, const char *string) {
  printk("%s:%d %s\n", file, line, string);
}

void prompt_send_response(const char *response) {
  printk("%s\n", response);
}

void prompt_send_response_fmt(char *buffer, size_t buffer_size,
                              const char *format, ...) {
  va_list arguments;

  va_start(arguments, format);
  vsnprintk(buffer, buffer_size, format, arguments);
  va_end(arguments);
  printk("%s\n", buffer);
}
```
