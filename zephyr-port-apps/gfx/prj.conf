## CMakeLists.txt
```
# SPDX-License-Identifier: Apache-2.0

cmake_minimum_required(VERSION 3.20.0)

set(USER_CACHE_DIR "${CMAKE_BINARY_DIR}/.cache" CACHE PATH "Zephyr cache directory")
find_package(Zephyr REQUIRED HINTS $ENV{ZEPHYR_BASE})
project(pebbleos_zephyr_gfx)

get_filename_component(PEBBLEOS_ROOT "${CMAKE_CURRENT_SOURCE_DIR}/../.." ABSOLUTE)
set(GFX "${PEBBLEOS_ROOT}/src/fw/applib/graphics")

target_include_directories(app PRIVATE
  "${CMAKE_CURRENT_SOURCE_DIR}/include"
  "${PEBBLEOS_ROOT}/src/fw"
  "${PEBBLEOS_ROOT}/src/fw/applib/vendor/uPNG"
  "${PEBBLEOS_ROOT}/include"
  "${CMAKE_BINARY_DIR}/include/generated"
)

target_compile_definitions(app PRIVATE
  CONFIG_SCREEN_COLOR_DEPTH_BITS=8
)

if(BOARD STREQUAL "pt2")
  target_compile_definitions(app PRIVATE
    CONFIG_BOARD_OBELIX_PVT=1
    CONFIG_PLATFORM_EMERY=1
    CONFIG_SOC_SF32LB52=1
  )
endif()

target_compile_options(app PRIVATE
  -include string.h
  -Wno-address-of-packed-member
)

target_sources(app PRIVATE
  src/display_push.c
  src/main.c
  src/port_stubs.c

  "${GFX}/8_bit/bitblt_private.c"
  "${GFX}/8_bit/framebuffer.c"
  "${GFX}/arabic_shaping.c"
  "${GFX}/bitblt.c"
  "${GFX}/framebuffer.c"
  "${GFX}/gbitmap.c"
  "${GFX}/gcolor_definitions.c"
  "${GFX}/graphics.c"
  "${GFX}/graphics_circle.c"
  "${GFX}/graphics_line.c"
  "${GFX}/graphics_private.c"
  "${GFX}/graphics_private_raw.c"
  "${GFX}/gtransform.c"
  "${GFX}/gtypes.c"
  "${GFX}/perimeter.c"
  "${GFX}/rtl_support.c"
  "${GFX}/text_layout.c"
  "${GFX}/text_render.c"
  "${GFX}/text_resources.c"
  "${GFX}/utf8.c"
  "${PEBBLEOS_ROOT}/src/fw/applib/fonts/codepoint.c"
  "${PEBBLEOS_ROOT}/lib/util/crc32.c"
  "${PEBBLEOS_ROOT}/lib/util/iterator.c"
  "${PEBBLEOS_ROOT}/lib/util/keyed_circular_cache.c"
  "${PEBBLEOS_ROOT}/lib/util/trig.c"
)

generate_inc_file_for_target(app
  "${PEBBLEOS_ROOT}/resources/normal/base/pbf/LECO_60_NUMBERS_AM_PM.pbf"
  "${CMAKE_BINARY_DIR}/include/generated/leco_60_numbers.pbf.inc"
)
```

## prj.conf
```kconfig
CONFIG_ASSERT=y
CONFIG_BOOT_BANNER=n
CONFIG_CONSOLE=y
CONFIG_HEAP_MEM_POOL_SIZE=16384
CONFIG_MAIN_STACK_SIZE=8192
CONFIG_PRINTK=y
CONFIG_SERIAL=y
CONFIG_UART_CONSOLE=y
```

## src/main.c
```c
/* SPDX-License-Identifier: Apache-2.0 */

#include <stdbool.h>
#include <stddef.h>
#include <stdint.h>

#include <zephyr/sys/printk.h>

#include "applib/fonts/fonts_private.h"
#include "applib/graphics/framebuffer.h"
#include "applib/graphics/gcontext.h"
#include "applib/graphics/graphics.h"
#include "applib/graphics/text.h"
#include "applib/graphics/text_resources.h"
#include "pbl/util/crc32.h"

#define GFX_WIDTH PBL_DISPLAY_WIDTH
#define GFX_HEIGHT PBL_DISPLAY_HEIGHT
#define GFX_FONT_RESOURCE_ID 1u

#define PREVIEW_X 0
#define PREVIEW_Y 72
#define PREVIEW_WIDTH 200
#define PREVIEW_HEIGHT 80
#define PREVIEW_COLS 50
#define PREVIEW_ROWS 20

static FrameBuffer s_framebuffer;
static GContext s_context;
static FontInfo s_font;

void gfx_port_set_context(GContext *context);

static bool prv_render(void) {
  const GSize size = GSize(GFX_WIDTH, GFX_HEIGHT);
  framebuffer_init(&s_framebuffer, &size);
  graphics_context_init(&s_context, &s_framebuffer, GContextInitializationMode_System);
  gfx_port_set_context(&s_context);

  graphics_context_set_fill_color(&s_context, GColorOxfordBlue);
  graphics_fill_rect(&s_context, &GRect(0, 0, GFX_WIDTH, GFX_HEIGHT));

  graphics_context_set_fill_color(&s_context, GColorDarkCandyAppleRed);
  graphics_fill_rect(&s_context, &GRect(8, 8, GFX_WIDTH - 16, 10));

  graphics_context_set_fill_color(&s_context, GColorIslamicGreen);
  graphics_fill_rect(&s_context, &GRect(8, GFX_HEIGHT - 18, GFX_WIDTH - 16, 10));

  if (!text_resources_init_font(SYSTEM_APP, GFX_FONT_RESOURCE_ID, 0, &s_font)) {
    printk("GFX_FONT_ERROR\n");
    return false;
  }

  graphics_context_set_text_color(&s_context, GColorWhite);
  graphics_draw_text(&s_context, "12:34", &s_font,
                     GRect(0, PREVIEW_Y, GFX_WIDTH, PREVIEW_HEIGHT),
                     GTextOverflowModeTrailingEllipsis, GTextAlignmentCenter, NULL);
  return true;
}

static void prv_print_preview(void) {
  printk("GFX_PREVIEW %dx%d crop=%d,%d+%dx%d\n", PREVIEW_COLS, PREVIEW_ROWS,
         PREVIEW_X, PREVIEW_Y, PREVIEW_WIDTH, PREVIEW_HEIGHT);

  for (int row = 0; row < PREVIEW_ROWS; ++row) {
    const int y0 = PREVIEW_Y + row * PREVIEW_HEIGHT / PREVIEW_ROWS;
    const int y1 = PREVIEW_Y + (row + 1) * PREVIEW_HEIGHT / PREVIEW_ROWS;
    printk("|");
    for (int col = 0; col < PREVIEW_COLS; ++col) {
      const int x0 = PREVIEW_X + col * PREVIEW_WIDTH / PREVIEW_COLS;
      const int x1 = PREVIEW_X + (col + 1) * PREVIEW_WIDTH / PREVIEW_COLS;
      bool text_pixel = false;
      for (int y = y0; y < y1 && !text_pixel; ++y) {
        const uint8_t *line = framebuffer_get_line(&s_framebuffer, y);
        for (int x = x0; x < x1; ++x) {
          if (line[x] == GColorWhite.argb) {
            text_pixel = true;
            break;
          }
        }
      }
      printk("%c", text_pixel ? '#' : ' ');
    }
    printk("|\n");
  }
}

void gfx_port_push_frame(const void *buffer, size_t buf_size, uint16_t width, uint16_t height);

int main(void) {
  if (!prv_render()) {
    return 1;
  }

  const size_t framebuffer_size = framebuffer_get_size_bytes(&s_framebuffer);
  const uint32_t framebuffer_crc = crc32(CRC32_INIT, s_framebuffer.buffer, framebuffer_size);

  printk("GFX_CRC 0x%08x %dx%d 8bpp\n", framebuffer_crc, GFX_WIDTH, GFX_HEIGHT);
  prv_print_preview();
  gfx_port_push_frame(s_framebuffer.buffer, framebuffer_size, GFX_WIDTH, GFX_HEIGHT);
  printk("GFX_DONE\n");
  return 0;
}
```

## src/display_push.c
```c
/* SPDX-License-Identifier: Apache-2.0 */

/* Kept separate from main.c: zephyr/drivers/display.h and the Pebble applib
 * headers both define display_clear/sign_extend.
 */

#include <stddef.h>
#include <stdint.h>

#include <zephyr/devicetree.h>
#include <zephyr/sys/printk.h>

#if defined(CONFIG_DISPLAY) && DT_HAS_CHOSEN(zephyr_display)

#include <zephyr/device.h>
#include <zephyr/drivers/display.h>

void gfx_port_push_frame(const void *buffer, size_t buf_size, uint16_t width, uint16_t height) {
  const struct device *display = DEVICE_DT_GET(DT_CHOSEN(zephyr_display));
  const struct display_buffer_descriptor desc = {
      .buf_size = buf_size,
      .width = width,
      .height = height,
      .pitch = width,
  };

  if (!device_is_ready(display)) {
    printk("GFX_DISPLAY_FAIL %d\n", -ENODEV);
    return;
  }

  int ret = display_blanking_off(display);
  if (ret == 0) {
    ret = display_write(display, 0U, 0U, &desc, buffer);
  }
  if (ret != 0) {
    printk("GFX_DISPLAY_FAIL %d\n", ret);
    return;
  }
  printk("GFX_DISPLAY_PUSH ok\n");
}

#else

void gfx_port_push_frame(const void *buffer, size_t buf_size, uint16_t width, uint16_t height) {
  (void)buffer;
  (void)buf_size;
  (void)width;
  (void)height;
}

#endif
```

## src/port_stubs.c
```c
/* SPDX-License-Identifier: Apache-2.0 */

#include <stdarg.h>
#include <stdbool.h>
#include <stddef.h>
#include <stdint.h>
#include <string.h>

#define sign_extend zephyr_sign_extend
#include <zephyr/kernel.h>
#undef sign_extend
#include <zephyr/sys/printk.h>

#include "applib/graphics/gcontext.h"
#include "process_state/app_state/app_state.h"
#include "resource/resource.h"
#include "system/passert.h"

#define GFX_FONT_RESOURCE_ID 1u

static const uint8_t s_font_data[] __aligned(4) = {
#include "leco_60_numbers.pbf.inc"
};

static GContext *s_context;
static TextRenderState s_text_render_state;
static bool s_perimeter_debugging_enabled;

void gfx_port_set_context(GContext *context) {
  s_context = context;
}

void *applib_malloc(size_t size) {
  return k_malloc(size);
}

void *applib_zalloc(size_t size) {
  return k_calloc(1, size);
}

void applib_free(void *ptr) {
  k_free(ptr);
}

void *kernel_zalloc(size_t size) {
  return k_calloc(1, size);
}

void kernel_free(void *ptr) {
  k_free(ptr);
}

bool process_manager_compiled_with_legacy2_sdk(void) {
  return false;
}

GContext *app_state_get_graphics_context(void) {
  return s_context;
}

GContext *kernel_ui_get_graphics_context(void) {
  return s_context;
}

GContext *graphics_context_get_current_context(void) {
  return s_context;
}

TextRenderState *app_state_get_text_render_state(void) {
  return &s_text_render_state;
}

bool app_state_get_text_perimeter_debugging_enabled(void) {
  return s_perimeter_debugging_enabled;
}

void app_state_set_text_perimeter_debugging_enabled(bool enabled) {
  s_perimeter_debugging_enabled = enabled;
}

GBitmap *app_state_legacy2_get_2bit_framebuffer(void) {
  return NULL;
}

Heap *app_state_get_heap(void) {
  return NULL;
}

bool heap_is_allocated(Heap *heap, void *ptr) {
  ARG_UNUSED(heap);
  ARG_UNUSED(ptr);
  return false;
}

bool sys_resource_is_valid(ResAppNum app_num, uint32_t resource_id) {
  return app_num == SYSTEM_APP && resource_id == GFX_FONT_RESOURCE_ID;
}

size_t sys_resource_size(ResAppNum app_num, uint32_t resource_id) {
  return sys_resource_is_valid(app_num, resource_id) ? sizeof(s_font_data) : 0;
}

size_t sys_resource_load_range(ResAppNum app_num, uint32_t resource_id,
                               uint32_t start_bytes, uint8_t *buffer, size_t num_bytes) {
  const size_t resource_size = sys_resource_size(app_num, resource_id);
  if (start_bytes >= resource_size) {
    return 0;
  }
  const size_t available = resource_size - start_bytes;
  const size_t copy_size = MIN(num_bytes, available);
  memcpy(buffer, &s_font_data[start_bytes], copy_size);
  return copy_size;
}

uint32_t sys_resource_get_and_cache(ResAppNum app_num, uint32_t resource_id) {
  return sys_resource_is_valid(app_num, resource_id) ? resource_id : 0;
}

const uint8_t *sys_resource_read_only_bytes(ResAppNum app_num, uint32_t resource_id,
                                            size_t *num_bytes_out) {
  if (!sys_resource_is_valid(app_num, resource_id)) {
    return NULL;
  }
  if (num_bytes_out) {
    *num_bytes_out = sizeof(s_font_data);
  }
  return s_font_data;
}

bool sys_resource_bytes_are_readonly(void *bytes) {
  return bytes >= (void *)s_font_data && bytes < (void *)(s_font_data + sizeof(s_font_data));
}

ResAppNum sys_get_current_resource_num(void) {
  return SYSTEM_APP;
}

GFont sys_font_get_system_font(const char *font_key) {
  ARG_UNUSED(font_key);
  return NULL;
}

void sys_font_reload_font(FontInfo *font_info) {
  ARG_UNUSED(font_info);
}

FontInfo *fonts_get_system_emoji_font_for_size(unsigned int font_height) {
  ARG_UNUSED(font_height);
  return NULL;
}

uint8_t fonts_get_font_height(GFont font) {
  return font ? font->max_height : 0;
}

int16_t fonts_get_font_cap_offset(GFont font) {
  return font ? (int16_t)((int16_t)font->max_height * 22 / 100) : 0;
}

ResourceCallbackHandle resource_watch(ResAppNum app_num, uint32_t resource_id,
                                      ResourceChangedCallback callback, void *data) {
  ARG_UNUSED(app_num);
  ARG_UNUSED(resource_id);
  ARG_UNUSED(callback);
  ARG_UNUSED(data);
  return NULL;
}

bool applib_resource_track_mmapped(const void *bytes) {
  ARG_UNUSED(bytes);
  return false;
}

bool applib_resource_is_mmapped(const void *bytes) {
  ARG_UNUSED(bytes);
  return false;
}

bool applib_resource_munmap(const void *bytes) {
  ARG_UNUSED(bytes);
  return false;
}

void *applib_resource_mmap_or_load(ResAppNum app_num, uint32_t resource_id,
                                   size_t offset, size_t length, bool use_aligned) {
  ARG_UNUSED(use_aligned);
  if (offset > sys_resource_size(app_num, resource_id) ||
      length > sys_resource_size(app_num, resource_id) - offset) {
    return NULL;
  }
  return (void *)&s_font_data[offset];
}

void applib_resource_munmap_or_free(void *bytes) {
  ARG_UNUSED(bytes);
}

NORETURN passert_failed(const char *filename, int line_number, const char *message, ...) {
  printk("GFX_ASSERT %s:%d %s\n", filename, line_number, message);
  k_panic();
  for (;;) {}
}

NORETURN passert_failed_no_message(const char *filename, int line_number) {
  printk("GFX_ASSERT %s:%d\n", filename, line_number);
  k_panic();
  for (;;) {}
}

NORETURN passert_failed_no_message_with_lr(const char *filename, int line_number, uint32_t lr) {
  printk("GFX_ASSERT %s:%d lr=%08x\n", filename, line_number, lr);
  k_panic();
  for (;;) {}
}

NORETURN wtf(void) {
  printk("GFX_ASSERT WTF\n");
  k_panic();
  for (;;) {}
}

NORETURN util_assertion_failed(const char *filename, int line) {
  printk("GFX_ASSERT %s:%d\n", filename, line);
  k_panic();
  for (;;) {}
}
```
