## prj.conf
```kconfig
CONFIG_ASSERT=y
CONFIG_BOOT_BANNER=n
CONFIG_CONSOLE=y
CONFIG_HEAP_MEM_POOL_SIZE=8192
CONFIG_MAIN_STACK_SIZE=2048
CONFIG_PRINTK=y
CONFIG_RTC=y
CONFIG_SERIAL=y
CONFIG_UART_CONSOLE=y

# PebbleOS has its own concise UART markers in this bring-up app.
CONFIG_LOG=n
```

## src/main.c
```c
/* SPDX-FileCopyrightText: 2026 Core Devices LLC */
/* SPDX-License-Identifier: Apache-2.0 */

#include <time.h>

#include <zephyr/kernel.h>
#include <zephyr/sys/printk.h>
#include <zephyr/sys/timeutil.h>

#include "applib/tick_timer_service.h"
#include "applib/tick_timer_service_private.h"
#include "kernel/events.h"
#include "kernel/kernel_applib_state.h"
#include "pbl/services/new_timer/new_timer_service.h"
#include "pbl/services/regular_timer.h"

#define KERNEL_STACK_SIZE 3072
#define KERNEL_PRIORITY 5

static struct k_thread s_kernel_thread;
static K_THREAD_STACK_DEFINE(s_kernel_stack, KERNEL_STACK_SIZE);

void kernel_runtime_set_kernel_thread(struct k_thread *thread);
bool kernel_runtime_take_event(PebbleEvent *event);
void kernel_runtime_dispatch_event(PebbleEvent *event);

static void prv_tick_handler(struct tm *tick_time, TimeUnits units_changed) {
  ARG_UNUSED(units_changed);
  time_t timestamp = timeutil_timegm(tick_time);
  printk("TICK %lld %02d:%02d:%02d\n", (long long)timestamp, tick_time->tm_hour,
         tick_time->tm_min, tick_time->tm_sec);
}

static void prv_kernel_main(void *arg1, void *arg2, void *arg3) {
  ARG_UNUSED(arg1);
  ARG_UNUSED(arg2);
  ARG_UNUSED(arg3);

  TickTimerServiceState *state = kernel_applib_get_tick_timer_service_state();
  tick_timer_service_state_init(state);
  tick_timer_service_init();
  tick_timer_service_subscribe(SECOND_UNIT, prv_tick_handler);

  printk("KERNEL_UP\n");

  while (true) {
    PebbleEvent event;
    if (kernel_runtime_take_event(&event)) {
      kernel_runtime_dispatch_event(&event);
    }
  }
}

int main(void) {
  new_timer_service_init();
  regular_timer_init();

  kernel_runtime_set_kernel_thread(&s_kernel_thread);
  k_thread_create(&s_kernel_thread, s_kernel_stack, K_THREAD_STACK_SIZEOF(s_kernel_stack),
                  prv_kernel_main, NULL, NULL, NULL, KERNEL_PRIORITY, 0, K_NO_WAIT);
  k_thread_name_set(&s_kernel_thread, "KernelMain");
  return 0;
}
```

## include/FreeRTOS.h
```c
/* SPDX-License-Identifier: Apache-2.0 */

#pragma once

#include <stdint.h>

#include <zephyr/kernel.h>

typedef int BaseType_t;
typedef unsigned int UBaseType_t;
typedef void *QueueHandle_t;
typedef void *SemaphoreHandle_t;
typedef void *TaskHandle_t;
typedef uint32_t TickType_t;

#define pdFALSE 0
#define pdTRUE 1
#define pdFAIL 0
#define pdPASS 1

#define configTICK_RATE_HZ CONFIG_SYS_CLOCK_TICKS_PER_SEC
#define portMAX_DELAY UINT32_MAX

void pebble_zephyr_semaphore_give(SemaphoreHandle_t semaphore);

static inline BaseType_t xSemaphoreGive(SemaphoreHandle_t semaphore) {
  pebble_zephyr_semaphore_give(semaphore);
  return pdTRUE;
}
```

## include/event_service_client.h
```c
/* SPDX-License-Identifier: Apache-2.0 */

#pragma once

#include "applib/event_service_client.h"
```

## include/portmacro.h
```c
/* SPDX-License-Identifier: Apache-2.0 */

#pragma once

#include "FreeRTOS.h"

typedef BaseType_t portBASE_TYPE;
```

## include/queue.h
```c
/* SPDX-License-Identifier: Apache-2.0 */

#pragma once

#include "FreeRTOS.h"
```

## include/tick_timer_service.h
```c
/* SPDX-License-Identifier: Apache-2.0 */

#pragma once

#include "applib/tick_timer_service.h"
```

## include/tick_timer_service_private.h
```c
/* SPDX-License-Identifier: Apache-2.0 */

#pragma once

#include "applib/tick_timer_service_private.h"
```

## src/new_timer_zephyr.c
```c
/* SPDX-FileCopyrightText: 2026 Core Devices LLC */
/* SPDX-License-Identifier: Apache-2.0 */

#include <stdint.h>

#include <zephyr/kernel.h>

#include "kernel/task_timer.h"
#include "kernel/task_timer_manager.h"
#include "pbl/os/semaphore.h"
#include "pbl/os/tick.h"
#include "pbl/services/new_timer/new_timer.h"

#define NEW_TIMER_STACK_SIZE 2048
#define NEW_TIMER_PRIORITY 2
#define NEW_TIMER_WORK_ITEMS 5

typedef struct {
  NewTimerWorkCallback callback;
  void *data;
} NewTimerWorkItem;

static TaskTimerManager s_manager;
static PebbleSemaphore *s_wake_semaphore;
static struct k_timer s_deadline_timer;
static struct k_thread s_thread;
static K_THREAD_STACK_DEFINE(s_stack, NEW_TIMER_STACK_SIZE);
K_MSGQ_DEFINE(s_work_queue, sizeof(NewTimerWorkItem), NEW_TIMER_WORK_ITEMS, sizeof(void *));

void pebble_zephyr_semaphore_give(SemaphoreHandle_t semaphore) {
  semaphore_give((PebbleSemaphore *)semaphore);
}

static void prv_deadline_expired(struct k_timer *timer) {
  ARG_UNUSED(timer);
  semaphore_give(s_wake_semaphore);
}

static void prv_service_loop(void *arg1, void *arg2, void *arg3) {
  ARG_UNUSED(arg1);
  ARG_UNUSED(arg2);
  ARG_UNUSED(arg3);

  while (true) {
    TickType_t ticks_to_wait = task_timer_manager_execute_expired_timers(&s_manager);
    if (ticks_to_wait == portMAX_DELAY) {
      semaphore_take(s_wake_semaphore);
    } else {
      // task_timer deadlines are in Zephyr ticks. Keep them in that domain so
      // the 10 kHz pt2 clock does not lose sub-millisecond wakeups.
      k_timer_start(&s_deadline_timer, K_TICKS(ticks_to_wait - 1), K_NO_WAIT);
      semaphore_take(s_wake_semaphore);
      k_timer_stop(&s_deadline_timer);
    }

    NewTimerWorkItem work;
    while (k_msgq_get(&s_work_queue, &work, K_NO_WAIT) == 0) {
      work.callback(work.data);
    }
  }
}

void new_timer_service_init(void) {
  s_wake_semaphore = semaphore_create();
  k_timer_init(&s_deadline_timer, prv_deadline_expired, NULL);
  task_timer_manager_init(&s_manager, (SemaphoreHandle_t)s_wake_semaphore);
  k_thread_create(&s_thread, s_stack, K_THREAD_STACK_SIZEOF(s_stack), prv_service_loop, NULL, NULL,
                  NULL, NEW_TIMER_PRIORITY, 0, K_NO_WAIT);
  k_thread_name_set(&s_thread, "NewTimer");
}

TimerID new_timer_create(void) {
  return task_timer_create(&s_manager);
}

bool new_timer_start(TimerID timer, uint32_t timeout_ms, NewTimerCallback callback, void *data,
                     uint32_t flags) {
  return task_timer_start(&s_manager, timer, timeout_ms, callback, data, flags);
}

bool new_timer_stop(TimerID timer) {
  return task_timer_stop(&s_manager, timer);
}

bool new_timer_scheduled(TimerID timer, uint32_t *expire_ms) {
  return task_timer_scheduled(&s_manager, timer, expire_ms);
}

void new_timer_delete(TimerID timer) {
  task_timer_delete(&s_manager, timer);
}

void *new_timer_debug_get_current_callback(void) {
  return task_timer_manager_get_current_cb(&s_manager);
}

bool new_timer_add_work_callback(NewTimerWorkCallback callback, void *data) {
  NewTimerWorkItem work = {.callback = callback, .data = data};
  if (k_msgq_put(&s_work_queue, &work, K_MSEC(50)) != 0) {
    return false;
  }
  semaphore_give(s_wake_semaphore);
  return true;
}

bool new_timer_add_work_callback_from_isr(NewTimerWorkCallback callback, void *data) {
  NewTimerWorkItem work = {.callback = callback, .data = data};
  if (k_msgq_put(&s_work_queue, &work, K_NO_WAIT) != 0) {
    return false;
  }
  semaphore_give(s_wake_semaphore);
  return true;
}
```

## src/runtime_zephyr.c
```c
/* SPDX-FileCopyrightText: 2026 Core Devices LLC */
/* SPDX-License-Identifier: Apache-2.0 */

#include <stdarg.h>
#include <stdbool.h>
#include <stdint.h>
#include <time.h>

#include <zephyr/kernel.h>
#include <zephyr/sys/printk.h>

#include "applib/event_service_client.h"
#include "applib/tick_timer_service_private.h"
#include "kernel/events.h"
#include "kernel/kernel_applib_state.h"
#include "kernel/pebble_tasks.h"
#include "pbl/drivers/rtc.h"
#include "pbl/services/event_service.h"
#include "pbl/util/attributes.h"

#define EVENT_QUEUE_DEPTH 8

static EventServiceInfo *s_event_client;
static EventServiceAddSubscriberCallback s_add_subscriber;
static EventServiceRemoveSubscriberCallback s_remove_subscriber;
static struct k_thread *s_kernel_thread;

K_MSGQ_DEFINE(s_event_queue, sizeof(PebbleEvent), EVENT_QUEUE_DEPTH, sizeof(uint32_t));

time_t kernel_wall_clock_get(void);

RtcTicks rtc_get_ticks(void) {
  return k_uptime_ticks();
}

time_t rtc_get_time(void) {
  return kernel_wall_clock_get();
}

void rtc_get_time_ms(time_t *seconds, uint16_t *milliseconds) {
  *seconds = rtc_get_time();
  *milliseconds = k_uptime_get_32() % 1000;
}

struct tm *sys_localtime_r(const time_t *timep, struct tm *result) {
  return gmtime_r(timep, result);
}

bool clock_is_24h_style(void) {
  return true;
}

bool sys_app_is_watchface(void) {
  return false;
}

PebbleTask pebble_task_get_current(void) {
  return k_current_get() == s_kernel_thread ? PebbleTask_KernelMain : PebbleTask_NewTimers;
}

TaskHandle_t pebble_task_get_handle_for_task(PebbleTask task) {
  if (task == PebbleTask_KernelMain) {
    return s_kernel_thread;
  }
  return NULL;
}

void kernel_runtime_set_kernel_thread(struct k_thread *thread) {
  s_kernel_thread = thread;
}

TickTimerServiceState *kernel_applib_get_tick_timer_service_state(void) {
  static TickTimerServiceState state;
  return &state;
}

TickTimerServiceState *app_state_get_tick_timer_service_state(void) {
  return kernel_applib_get_tick_timer_service_state();
}

TickTimerServiceState *worker_state_get_tick_timer_service_state(void) {
  return kernel_applib_get_tick_timer_service_state();
}

void event_service_init(PebbleEventType type, EventServiceAddSubscriberCallback add_subscriber,
                        EventServiceRemoveSubscriberCallback remove_subscriber) {
  if (type == PEBBLE_TICK_EVENT) {
    s_add_subscriber = add_subscriber;
    s_remove_subscriber = remove_subscriber;
  }
}

void event_service_client_subscribe(EventServiceInfo *service_info) {
  s_event_client = service_info;
  if (s_add_subscriber != NULL) {
    s_add_subscriber(PebbleTask_KernelMain);
  }
}

void event_service_client_unsubscribe(EventServiceInfo *service_info) {
  if (s_event_client != service_info) {
    return;
  }
  if (s_remove_subscriber != NULL) {
    s_remove_subscriber(PebbleTask_KernelMain);
  }
  s_event_client = NULL;
}

void event_put(PebbleEvent *event) {
  if (k_msgq_put(&s_event_queue, event, K_MSEC(3000)) != 0) {
    printk("EVENT_QUEUE_FULL\n");
    k_panic();
  }
}

bool kernel_runtime_take_event(PebbleEvent *event) {
  return k_msgq_get(&s_event_queue, event, K_FOREVER) == 0;
}

void kernel_runtime_dispatch_event(PebbleEvent *event) {
  if (s_event_client != NULL && s_event_client->type == event->type) {
    s_event_client->handler(event, s_event_client->context);
  }
}

NORETURN passert_failed(const char *filename, int line_number, const char *message, ...) {
  ARG_UNUSED(message);
  printk("PASSERT %s:%d\n", filename, line_number);
  k_panic();
  CODE_UNREACHABLE;
}

NORETURN passert_failed_no_message(const char *filename, int line_number) {
  printk("PASSERT %s:%d\n", filename, line_number);
  k_panic();
  CODE_UNREACHABLE;
}

NORETURN passert_failed_no_message_with_lr(const char *filename, int line_number, uint32_t lr) {
  printk("PASSERT %s:%d lr=%#x\n", filename, line_number, lr);
  k_panic();
  CODE_UNREACHABLE;
}

NORETURN wtf(void) {
  printk("WTF\n");
  k_panic();
  CODE_UNREACHABLE;
}
```

## src/wall_clock_zephyr.c
```c
/* SPDX-FileCopyrightText: 2026 Core Devices LLC */
/* SPDX-License-Identifier: Apache-2.0 */

#include <stdbool.h>
#include <time.h>

#include <zephyr/device.h>
#include <zephyr/devicetree.h>
#include <zephyr/drivers/rtc.h>
#include <zephyr/kernel.h>
#include <zephyr/sys/timeutil.h>

static const struct device *const s_rtc = DEVICE_DT_GET(DT_NODELABEL(rtc));

#define SF32LB_RTC_RESET_EPOCH 946684800

static bool s_wall_clock_initialized;
static time_t s_wall_clock_offset;

static bool prv_read_rtc(time_t *timestamp) {
  struct rtc_time rtc_time;
  if (!device_is_ready(s_rtc) || rtc_get_time(s_rtc, &rtc_time) != 0) {
    return false;
  }

  struct tm now = *rtc_time_to_tm(&rtc_time);

  // The current SF32LB driver exposes the peripheral's two-digit year and
  // one-based month directly. Normalize them to struct tm semantics here.
  // Zephyr-compliant drivers (e.g. qemu pebble,rtc) already return tm values.
  if (now.tm_year >= 0 && now.tm_year < 100) {
    now.tm_year += 100;
  }
#if DT_NODE_HAS_COMPAT(DT_NODELABEL(rtc), sifli_sf32lb_rtc)
  if (now.tm_mon >= 1 && now.tm_mon <= 12) {
    now.tm_mon -= 1;
  }
#endif

  if (now.tm_year < 100 || now.tm_year > 137 || now.tm_mon < 0 || now.tm_mon > 11 ||
      now.tm_mday < 1 || now.tm_mday > 31) {
    return false;
  }

  *timestamp = timeutil_timegm(&now);
  return true;
}

time_t kernel_wall_clock_get(void) {
  const time_t uptime_seconds = k_uptime_get() / 1000;

  if (!s_wall_clock_initialized) {
#ifdef KERNEL_DEMO_EPOCH
    // Demo override: stage a known displayed time for recording. The face
    // formats time as UTC in this port, so KERNEL_DEMO_EPOCH is the desired
    // displayed local time expressed as a UTC epoch.
    s_wall_clock_offset = (time_t)KERNEL_DEMO_EPOCH - uptime_seconds;
#else
    time_t rtc_time;
    if (prv_read_rtc(&rtc_time) && rtc_time != SF32LB_RTC_RESET_EPOCH) {
      s_wall_clock_offset = rtc_time - uptime_seconds;
    } else {
      s_wall_clock_offset = KERNEL_BUILD_EPOCH;
    }
#endif
    s_wall_clock_initialized = true;
  }

  return s_wall_clock_offset + uptime_seconds;
}
```
